AUTOSAR XML (schema 00044)
package /AUTOSAR_Det
  bsw module description Det: category=BSW_MODULE, module-id=15
    bsw internal behavior BswInternalBehavior_0
      bsw called entity Det_ReportError: reentrancy-level=SINGLE-CORE-REENTRANT, implemented-entry=Det_ReportError
      bsw called entity Det_ReportRuntimeError: reentrancy-level=SINGLE-CORE-REENTRANT, implemented-entry=Det_ReportRuntimeError
package /AUTOSAR_Det/BSWModuleEntry
  bsw module entry Det_ReportError: service-id=1, is-reentrant=true, call-type=REGULAR, execution-context=UNSPECIFIED, sw-service-impl-policy=STANDARD, bsw-entry-kind=ABSTRACT
  bsw module entry Det_ReportRuntimeError: service-id=4, is-reentrant=true, is-synchronous=true, call-type=REGULAR, execution-context=UNSPECIFIED, sw-service-impl-policy=STANDARD, bsw-entry-kind=ABSTRACT
