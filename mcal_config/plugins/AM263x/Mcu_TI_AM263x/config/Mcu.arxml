AUTOSAR XML (schema 00044)
package /TI_AM263x
  module definition Mcu: refined-module-def=Mcu, variants post-build/pre-compile  # Configuration of the Mcu (Microcontroller Unit) module.
    container McuGeneralConfiguration  # This container contains the configuration (parameters) of the MCU driver.
      boolean McuDevErrorDetect: set at pre-compile, default-value=true  # Pre-processor switch for enabling the development error detection and reporting.
      boolean McuIntrCrossbarEnable: origin=Texas Instruments, set at post-build in variant post-build / pre-compile in variant pre-compile, default-value=false  # Pre-processor switch for enabling the Mcu Interrupt Crossbar.
      boolean McuInputCrossbarEnable: origin=Texas Instruments, set at post-build in variant post-build / pre-compile in variant pre-compile, default-value=false  # Pre-processor switch for enabling the Mcu Input Crossbar.
      boolean McuGetRamStateApi: set at pre-compile, default-value=true  # Pre-processor switch to enable/disable the API Mcu_GetRamState.
      boolean McuInitClock: set at pre-compile, default-value=true  # If this parameter is set to FALSE, the clock initialization has to be disabled from the MCU driver. This concept applies when there are some write once clock registers and a bootloader is present. If this parameter is set to TRUE, the MCU driver is responsible of the clock initialization.
      boolean McuNoPll: set at pre-compile, default-value=true  # This parameter shall be set True, if the H/W does not have a PLL or the PLL circuitry is enabled after the power on without S/W intervention. In this case MCU_DistributePllClock has to be disabled and MCU_GetPllStatus has to return MCU_PLL_STATUS_UNDEFINED. Otherwise this parameters has to be set False
      boolean McuPerformResetApi: set at pre-compile, default-value=false  # Pre-processor switch to enable / disable the use of the function Mcu_PerformReset()
      boolean McuVersionInfoApi: set at pre-compile, default-value=true  # Pre-processor switch to enable / disable the API to read out the modules version information.
      boolean McuInitRamApi: origin=Texas Instruments, set at pre-compile, default-value=true  # Pre-processor switch to enable / disable the API to initialize RAM section.
      boolean McuRegisterReadbackApi: origin=Texas Instruments, set at pre-compile, default-value=true  # Pre-processor switch to enable / disable the API to read MCU registers.
      boolean McuPBISTTestEnable: origin=Texas Instruments, set at pre-compile, default-value=false  # Pre-processor switch to enable / disable the PBIST test.
      integer McuDefaultOSCounterId: 0..16, origin=Texas Instruments, set at pre-compile, default-value=0  # Default Os Counter Id if node reference to OsCounter ref McuOsCounterRef is not set
      integer McuTimeoutDuration: 1..4294967295, origin=Texas Instruments, set at pre-compile, default-value=32000  # MCU timeout
      integer McuPllTimeoutDuration: 1..4294967295, origin=Texas Instruments, set at pre-compile, default-value=6600  # PLL timeout - used in Pll initialization. Unit is in clock ticks. Configure the timeout according to r5f clock frequency(400MHz/200MHz)
      integer McuPMICFreqAccuModeSel: 0..1, origin=Texas Instruments, set at pre-compile, default-value=0  # PMIC_CLKOUT Frequency accumulation Mode selection 0: Continuous mode 1: Staircase mode . Bit 8 of DCDCCTL1
      integer McuPMICFreqSlopeVal: 0..134217727, origin=Texas Instruments, set at pre-compile, default-value=0  # 26 bit PMIC_CLKOUT Frequency slope value. BIT [26:0] of DCDCCTL0
      integer McuPMICFreqThresMin: 0..255, origin=Texas Instruments, set at pre-compile, default-value=0  # PMIC_CLKOUT Minimum frequency threshold value.Bit [23:16] of DCDCCTL1
      integer McuPMICFreqThresMax: 0..255, origin=Texas Instruments, set at pre-compile, default-value=0  # PMIC_CLKOUT Maximum frequency threshold value.Bit [31:24] of DCDCCTL1
      integer McuPMICClkEn: 0..1, origin=Texas Instruments, set at pre-compile, default-value=0  # PMIC_CLKOUT Enable Multi-bit. BIT 1 of DCDCCTL1
      integer McuPMICDiterCtrl: 0..1, origin=Texas Instruments, set at pre-compile, default-value=0  # PMIC_CLKOUT dithering control block reset .BIT 0 of DCDCCTL1
      reference McuOsCounterRef [0..1]: multiplicity set at pre-compile, origin=Texas Instruments, set at pre-compile, destination=OsCounter  # This parameter contains a reference to the OsCounter, which is used by the MCU driver.
    container McuModuleConfiguration  # This container contains the configuration (parameters) of the MCU driver
      enumeration McuClockSrcFailureNotification: {DISABLED, ENABLED}, set at post-build in variant post-build / pre-compile in variant pre-compile, default-value=DISABLED  # Enables/Disables clock failure notification. In case this feature is not supported by HW the setting should be disabled.
      integer McuNumberOfMcuModes [0..0]: 1..255, set at post-build in variant post-build / pre-compile in variant pre-compile  # This parameter shall represent the number of Modes available for the MCU.
      integer McuRamSectors: 1..4294967295, set at post-build in variant post-build / pre-compile in variant pre-compile, default-value=1  # This parameter shall represent the number of RAM sectors available for the MCU.
      integer McuResetSetting [0..1]: 1..255, multiplicity set at pre-compile, set at pre-compile, default-value=5  # This parameter relates to the MCU specific reset configuration. This applies to the function Mcu_PerformReset, which performs a microcontroller reset using the hardware feature of the microcontroller.
      enumeration McuResetMode: {MCU_PERFORM_RESET_MODE_WARM}, origin=Texas Instruments, set at post-build in variant post-build / pre-compile in variant pre-compile, default-value=MCU_PERFORM_RESET_MODE_WARM  # Reset mode enum which can be used in Mcu_PerformReset
      container McuClockSettingConfig [0..*]: requires-index=true  # This container contains the configuration (parameters) for the Clock settings of the MCU. Please see MCU031 for more information on the MCU clock settings.
        integer McuClockSettingId: 0..255, set at post-build in variant post-build / pre-compile in variant pre-compile, symbolic-name-value=true, default-value=200  # The Id of this McuClockSettingConfig to be used as argument for the API call "Mcu_InitClock".
        enumeration McuClockModuleId: {MCU_CLKSRC_MODULE_ID_MCAN0, MCU_CLKSRC_MODULE_ID_MCAN1, MCU_CLKSRC_MODULE_ID_MCAN2, MCU_CLKSRC_MODULE_ID_MCAN3, MCU_CLKSRC_MODULE_ID_RTI0, MCU_CLKSRC_MODULE_ID_RTI1, MCU_CLKSRC_MODULE_ID_RTI2, MCU_CLKSRC_MODULE_ID_RTI3, MCU_CLKSRC_MODULE_ID_WDT0, MCU_CLKSRC_MODULE_ID_WDT1, MCU_CLKSRC_MODULE_ID_WDT2, MCU_CLKSRC_MODULE_ID_WDT3, MCU_CLKSRC_MODULE_ID_QSPI, MCU_CLKSRC_MODULE_ID_MCSPI0, MCU_CLKSRC_MODULE_ID_MCSPI1, MCU_CLKSRC_MODULE_ID_MCSPI2, MCU_CLKSRC_MODULE_ID_MCSPI3, MCU_CLKSRC_MODULE_ID_MCSPI4, MCU_CLKSRC_MODULE_ID_I2C, MCU_CLKSRC_MODULE_ID_SCI0, MCU_CLKSRC_MODULE_ID_SCI1, MCU_CLKSRC_MODULE_ID_SCI2, MCU_CLKSRC_MODULE_ID_SCI3, MCU_CLKSRC_MODULE_ID_SCI4, MCU_CLKSRC_MODULE_ID_SCI5, MCU_CLKSRC_MODULE_ID_CPTS, MCU_CLKSRC_MODULE_ID_PMIC_CLKOUT, MCU_CLKSRC_MODULE_ID_MCU_CLKOUT0, MCU_CLKSRC_MODULE_ID_MCU_CLKOUT1, MCU_CLKSRC_MODULE_ID_MII100_CLK, MCU_CLKSRC_MODULE_ID_MII10_CLK, MCU_CLKSRC_MODULE_ID_RGMI_CLK, MCU_CLKSRC_MODULE_ID_CONTROLSS_CLK}, origin=Texas Instruments, set at post-build in variant post-build / pre-compile in variant pre-compile, default-value=MCU_CLKSRC_MODULE_ID_QSPI  # ModuleId for which clock setting to be applied.
        enumeration McuClockSourceId: {MCU_CLKSRC_0, MCU_CLKSRC_1, MCU_CLKSRC_2, MCU_CLKSRC_3, MCU_CLKSRC_4, MCU_CLKSRC_5, MCU_CLKSRC_6, MCU_CLKSRC_7}, origin=Texas Instruments, set at post-build in variant post-build / pre-compile in variant pre-compile, default-value=MCU_CLKSRC_0  # Clock source Id for selected module
        integer McuClockDivId: 0..255, origin=Texas Instruments, set at post-build in variant post-build / pre-compile in variant pre-compile, default-value=3  # McuClockDivider value should be less than or equal to 255 as per hardware limitation for MII10 and it should be less than or equal to 15 for all other modules.
        boolean McuClockInitializationConfigFlag: origin=Texas Instruments, set at pre-compile in variant pre-compile / post-build in variant post-build, default-value=true  # Switch for enabling and disabling clock of the modules
        container McuClockReferencePoint [1..*]  # This container defines a reference point in the Mcu Clock tree. It defines the frequency which then can be used by other modules as an input value. Lower multiplicity is 1, as even in the simplest case (only one frequency is used), there is one frequency to be defined.
          float McuClockReferencePointFrequency: 0.0..INF, scope=ECU, set at post-build in variant post-build / pre-compile in variant pre-compile, default-value=1.0  # This is the frequency for the specific instance of the McuClockReferencePoint container. It shall be given in Hz.
        container McuClockSourceOptions  # Supported clock sources for different peripherals
          enumeration McuFRCClockSourceId [0..1]: {MCU_CLKSRC_0, MCU_CLKSRC_1, MCU_CLKSRC_2, MCU_CLKSRC_3, MCU_CLKSRC_4, MCU_CLKSRC_5, MCU_CLKSRC_6, MCU_CLKSRC_7}, multiplicity set at post-build in variant post-build / pre-compile in variant pre-compile, origin=Texas Instruments, set at post-build in variant post-build / pre-compile in variant pre-compile, default-value=MCU_CLKSRC_0  # Clock source Id for Free running counter FRC
          enumeration McuWDTClockSourceId [0..1]: {MCU_CLKSRC_0, MCU_CLKSRC_1, MCU_CLKSRC_2, MCU_CLKSRC_3, MCU_CLKSRC_4, MCU_CLKSRC_5, MCU_CLKSRC_6, MCU_CLKSRC_7}, multiplicity set at post-build in variant post-build / pre-compile in variant pre-compile, origin=Texas Instruments, set at post-build in variant post-build / pre-compile in variant pre-compile, default-value=MCU_CLKSRC_2  # Clock source Id for Watch dog timer
          enumeration McuRTIClockSourceId [0..1]: {MCU_CLKSRC_0, MCU_CLKSRC_1, MCU_CLKSRC_2, MCU_CLKSRC_3, MCU_CLKSRC_4, MCU_CLKSRC_5, MCU_CLKSRC_6, MCU_CLKSRC_7}, multiplicity set at post-build in variant post-build / pre-compile in variant pre-compile, origin=Texas Instruments, set at post-build in variant post-build / pre-compile in variant pre-compile, default-value=MCU_CLKSRC_2  # Clock source Id for RTI
          enumeration McuDCANClockSourceId [0..1]: {MCU_CLKSRC_0, MCU_CLKSRC_1, MCU_CLKSRC_2, MCU_CLKSRC_3, MCU_CLKSRC_4, MCU_CLKSRC_5, MCU_CLKSRC_6, MCU_CLKSRC_7}, multiplicity set at post-build in variant post-build / pre-compile in variant pre-compile, origin=Texas Instruments, set at post-build in variant post-build / pre-compile in variant pre-compile, default-value=MCU_CLKSRC_4  # Clock source Id for DCAN
          enumeration McuQSPIClockSourceId [0..1]: {MCU_CLKSRC_0, MCU_CLKSRC_1, MCU_CLKSRC_2, MCU_CLKSRC_3, MCU_CLKSRC_4, MCU_CLKSRC_5, MCU_CLKSRC_6, MCU_CLKSRC_7}, multiplicity set at post-build in variant post-build / pre-compile in variant pre-compile, origin=Texas Instruments, set at post-build in variant post-build / pre-compile in variant pre-compile, default-value=MCU_CLKSRC_4  # Clock source Id for QSPI
          enumeration McuFDCANClockSourceId [0..1]: {MCU_CLKSRC_0, MCU_CLKSRC_1, MCU_CLKSRC_2, MCU_CLKSRC_3, MCU_CLKSRC_4, MCU_CLKSRC_5, MCU_CLKSRC_6, MCU_CLKSRC_7}, multiplicity set at post-build in variant post-build / pre-compile in variant pre-compile, origin=Texas Instruments, set at post-build in variant post-build / pre-compile in variant pre-compile, default-value=MCU_CLKSRC_4  # Clock source Id for FDCAN
      container McuXbarChannelTriggerConfiguration [0..*]: requires-index=true  # This container contains the Xbar Channel Trigger condition.
        enumeration McuInterruptChannelXbar: {MCU_INTRXBAR0_OUT_0, MCU_INTRXBAR0_OUT_1, MCU_INTRXBAR0_OUT_2, MCU_INTRXBAR0_OUT_3, MCU_INTRXBAR0_OUT_4, MCU_INTRXBAR0_OUT_5, MCU_INTRXBAR0_OUT_6, MCU_INTRXBAR0_OUT_7, MCU_INTRXBAR0_OUT_8, MCU_INTRXBAR0_OUT_9, MCU_INTRXBAR0_OUT_10, MCU_INTRXBAR0_OUT_11, MCU_INTRXBAR0_OUT_12, MCU_INTRXBAR0_OUT_13, MCU_INTRXBAR0_OUT_14, MCU_INTRXBAR0_OUT_15, MCU_INTRXBAR0_OUT_16, MCU_INTRXBAR0_OUT_17, MCU_INTRXBAR0_OUT_18, MCU_INTRXBAR0_OUT_19, MCU_INTRXBAR0_OUT_20, MCU_INTRXBAR0_OUT_21, MCU_INTRXBAR0_OUT_22, MCU_INTRXBAR0_OUT_23, MCU_INTRXBAR0_OUT_24, MCU_INTRXBAR0_OUT_25, MCU_INTRXBAR0_OUT_26, MCU_INTRXBAR0_OUT_27, MCU_INTRXBAR0_OUT_28, MCU_INTRXBAR0_OUT_29, MCU_INTRXBAR0_OUT_30, MCU_INTRXBAR0_OUT_31}, origin=Texas Instruments, set at pre-compile, default-value=MCU_INTRXBAR0_OUT_0  # Cross Bar.
        enumeration McuInterruptChannelXbarMap: {MCU_INT_XBAR_EPWM0_INT, MCU_INT_XBAR_EPWM1_INT, MCU_INT_XBAR_EPWM2_INT, MCU_INT_XBAR_EPWM3_INT, MCU_INT_XBAR_EPWM4_INT, MCU_INT_XBAR_EPWM5_INT, MCU_INT_XBAR_EPWM6_INT, MCU_INT_XBAR_EPWM7_INT, MCU_INT_XBAR_EPWM8_INT, MCU_INT_XBAR_EPWM9_INT, MCU_INT_XBAR_EPWM10_INT, MCU_INT_XBAR_EPWM11_INT, MCU_INT_XBAR_EPWM12_INT, MCU_INT_XBAR_EPWM13_INT, MCU_INT_XBAR_EPWM14_INT, MCU_INT_XBAR_EPWM15_INT, MCU_INT_XBAR_EPWM16_INT, MCU_INT_XBAR_EPWM17_INT, MCU_INT_XBAR_EPWM18_INT, MCU_INT_XBAR_EPWM19_INT, MCU_INT_XBAR_EPWM20_INT, MCU_INT_XBAR_EPWM21_INT, MCU_INT_XBAR_EPWM22_INT, MCU_INT_XBAR_EPWM23_INT, MCU_INT_XBAR_EPWM24_INT, MCU_INT_XBAR_EPWM25_INT, MCU_INT_XBAR_EPWM26_INT, MCU_INT_XBAR_EPWM27_INT, MCU_INT_XBAR_EPWM28_INT, MCU_INT_XBAR_EPWM29_INT, MCU_INT_XBAR_EPWM30_INT, MCU_INT_XBAR_EPWM31_INT, MCU_INT_XBAR_EPWM0_TZINT, MCU_INT_XBAR_EPWM1_TZINT, MCU_INT_XBAR_EPWM2_TZINT, MCU_INT_XBAR_EPWM3_TZINT, MCU_INT_XBAR_EPWM4_TZINT, MCU_INT_XBAR_EPWM5_TZINT, MCU_INT_XBAR_EPWM6_TZINT, MCU_INT_XBAR_EPWM7_TZINT, MCU_INT_XBAR_EPWM8_TZINT, MCU_INT_XBAR_EPWM9_TZINT, MCU_INT_XBAR_EPWM10_TZINT, MCU_INT_XBAR_EPWM11_TZINT, MCU_INT_XBAR_EPWM12_TZINT, MCU_INT_XBAR_EPWM13_TZINT, MCU_INT_XBAR_EPWM14_TZINT, MCU_INT_XBAR_EPWM15_TZINT, MCU_INT_XBAR_EPWM16_TZINT, MCU_INT_XBAR_EPWM17_TZINT, MCU_INT_XBAR_EPWM18_TZINT, MCU_INT_XBAR_EPWM19_TZINT, MCU_INT_XBAR_EPWM20_TZINT, MCU_INT_XBAR_EPWM21_TZINT, MCU_INT_XBAR_EPWM22_TZINT, MCU_INT_XBAR_EPWM23_TZINT, MCU_INT_XBAR_EPWM24_TZINT, MCU_INT_XBAR_EPWM25_TZINT, MCU_INT_XBAR_EPWM26_TZINT, MCU_INT_XBAR_EPWM27_TZINT, MCU_INT_XBAR_EPWM28_TZINT, MCU_INT_XBAR_EPWM29_TZINT, MCU_INT_XBAR_EPWM30_TZINT, MCU_INT_XBAR_EPWM31_TZINT, MCU_INT_XBAR_ADC0_INT1, MCU_INT_XBAR_ADC0_INT2, MCU_INT_XBAR_ADC0_INT3, MCU_INT_XBAR_ADC0_INT4, MCU_INT_XBAR_ADC0_EVTINT, MCU_INT_XBAR_ADC1_INT1, MCU_INT_XBAR_ADC1_INT2, MCU_INT_XBAR_ADC1_INT3, MCU_INT_XBAR_ADC1_INT4, MCU_INT_XBAR_ADC1_EVTINT, MCU_INT_XBAR_ADC2_INT1, MCU_INT_XBAR_ADC2_INT2, MCU_INT_XBAR_ADC2_INT3, MCU_INT_XBAR_ADC2_INT4, MCU_INT_XBAR_ADC2_EVTINT, MCU_INT_XBAR_ADC3_INT1, MCU_INT_XBAR_ADC3_INT2, MCU_INT_XBAR_ADC3_INT3, MCU_INT_XBAR_ADC3_INT4, MCU_INT_XBAR_ADC3_EVTINT, MCU_INT_XBAR_ADC4_INT1, MCU_INT_XBAR_ADC4_INT2, MCU_INT_XBAR_ADC4_INT3, MCU_INT_XBAR_ADC4_INT4, MCU_INT_XBAR_ADC4_EVTINT, MCU_INT_XBAR_FSIRX0_INT1N, MCU_INT_XBAR_FSIRX0_INT2N, MCU_INT_XBAR_FSIRX1_INT1N, MCU_INT_XBAR_FSIRX1_INT2N, MCU_INT_XBAR_FSIRX2_INT1N, MCU_INT_XBAR_FSIRX2_INT2N, MCU_INT_XBAR_FSIRX3_INT1N, MCU_INT_XBAR_FSIRX3_INT2N, MCU_INT_XBAR_FSITX0_INT1N, MCU_INT_XBAR_FSITX0_INT2N, MCU_INT_XBAR_FSITX1_INT1N, MCU_INT_XBAR_FSITX1_INT2N, MCU_INT_XBAR_FSITX2_INT1N, MCU_INT_XBAR_FSITX2_INT2N, MCU_INT_XBAR_FSITX3_INT1N, MCU_INT_XBAR_FSITX3_INT2N, MCU_INT_XBAR_SD0_ERR, MCU_INT_XBAR_SD0_FILT0_DRINT, MCU_INT_XBAR_SD0_FILT1_DRINT, MCU_INT_XBAR_SD0_FILT2_DRINT, MCU_INT_XBAR_SD0_FILT3_DRINT, MCU_INT_XBAR_SD1_ERR, MCU_INT_XBAR_SD1_FILT0_DRINT, MCU_INT_XBAR_SD1_FILT1_DRINT, MCU_INT_XBAR_SD1_FILT2_DRINT, MCU_INT_XBAR_SD1_FILT3_DRINT, MCU_INT_XBAR_ECAP0_INT, MCU_INT_XBAR_ECAP1_INT, MCU_INT_XBAR_ECAP2_INT, MCU_INT_XBAR_ECAP3_INT, MCU_INT_XBAR_ECAP4_INT, MCU_INT_XBAR_ECAP5_INT, MCU_INT_XBAR_ECAP6_INT, MCU_INT_XBAR_ECAP7_INT, MCU_INT_XBAR_ECAP8_INT, MCU_INT_XBAR_ECAP9_INT, MCU_INT_XBAR_EQEP0_INT, MCU_INT_XBAR_EQEP1_INT, MCU_INT_XBAR_EQEP2_INT}, origin=Texas Instruments, set at pre-compile, default-value=MCU_INT_XBAR_EPWM0_INT  # Cross Bar.
      container McuInputXbarChannelTriggerConfiguration [0..*]: requires-index=true  # This container contains the Xbar Channel Trigger condition.
        enumeration McuInputChannelXbar: {MCU_INPUT_XBAR0_OUT_0, MCU_INPUT_XBAR0_OUT_1, MCU_INPUT_XBAR0_OUT_2, MCU_INPUT_XBAR0_OUT_3, MCU_INPUT_XBAR0_OUT_4, MCU_INPUT_XBAR0_OUT_5, MCU_INPUT_XBAR0_OUT_6, MCU_INPUT_XBAR0_OUT_7, MCU_INPUT_XBAR0_OUT_8, MCU_INPUT_XBAR0_OUT_9, MCU_INPUT_XBAR0_OUT_10, MCU_INPUT_XBAR0_OUT_11, MCU_INPUT_XBAR0_OUT_12, MCU_INPUT_XBAR0_OUT_13, MCU_INPUT_XBAR0_OUT_14, MCU_INPUT_XBAR0_OUT_15, MCU_INPUT_XBAR0_OUT_16, MCU_INPUT_XBAR0_OUT_17, MCU_INPUT_XBAR0_OUT_18, MCU_INPUT_XBAR0_OUT_19, MCU_INPUT_XBAR0_OUT_20, MCU_INPUT_XBAR0_OUT_21, MCU_INPUT_XBAR0_OUT_22, MCU_INPUT_XBAR0_OUT_23, MCU_INPUT_XBAR0_OUT_24, MCU_INPUT_XBAR0_OUT_25, MCU_INPUT_XBAR0_OUT_26, MCU_INPUT_XBAR0_OUT_27, MCU_INPUT_XBAR0_OUT_28, MCU_INPUT_XBAR0_OUT_29, MCU_INPUT_XBAR0_OUT_30, MCU_INPUT_XBAR0_OUT_31}, origin=Texas Instruments, set at pre-compile, default-value=MCU_INPUT_XBAR0_OUT_0  # Cross Bar.
        enumeration McuInputChannelXbarMap: {MCU_INPUT_XBAR_GPIO0, MCU_INPUT_XBAR_GPIO1, MCU_INPUT_XBAR_GPIO2, MCU_INPUT_XBAR_GPIO3, MCU_INPUT_XBAR_GPIO4, MCU_INPUT_XBAR_GPIO5, MCU_INPUT_XBAR_GPIO6, MCU_INPUT_XBAR_GPIO7, MCU_INPUT_XBAR_GPIO8, MCU_INPUT_XBAR_GPIO9, MCU_INPUT_XBAR_GPIO10, MCU_INPUT_XBAR_GPIO11, MCU_INPUT_XBAR_GPIO12, MCU_INPUT_XBAR_GPIO13, MCU_INPUT_XBAR_GPIO14, MCU_INPUT_XBAR_GPIO15, MCU_INPUT_XBAR_GPIO16, MCU_INPUT_XBAR_GPIO17, MCU_INPUT_XBAR_GPIO18, MCU_INPUT_XBAR_GPIO19, MCU_INPUT_XBAR_GPIO20, MCU_INPUT_XBAR_GPIO21, MCU_INPUT_XBAR_GPIO22, MCU_INPUT_XBAR_GPIO23, MCU_INPUT_XBAR_GPIO24, MCU_INPUT_XBAR_GPIO25, MCU_INPUT_XBAR_GPIO26, MCU_INPUT_XBAR_GPIO27, MCU_INPUT_XBAR_GPIO28, MCU_INPUT_XBAR_GPIO29, MCU_INPUT_XBAR_GPIO30, MCU_INPUT_XBAR_GPIO31, MCU_INPUT_XBAR_GPIO32, MCU_INPUT_XBAR_GPIO33, MCU_INPUT_XBAR_GPIO34, MCU_INPUT_XBAR_GPIO35, MCU_INPUT_XBAR_GPIO36, MCU_INPUT_XBAR_GPIO37, MCU_INPUT_XBAR_GPIO38, MCU_INPUT_XBAR_GPIO39, MCU_INPUT_XBAR_GPIO40, MCU_INPUT_XBAR_GPIO41, MCU_INPUT_XBAR_GPIO42, MCU_INPUT_XBAR_GPIO43, MCU_INPUT_XBAR_GPIO44, MCU_INPUT_XBAR_GPIO45, MCU_INPUT_XBAR_GPIO46, MCU_INPUT_XBAR_GPIO47, MCU_INPUT_XBAR_GPIO48, MCU_INPUT_XBAR_GPIO49, MCU_INPUT_XBAR_GPIO50, MCU_INPUT_XBAR_GPIO51, MCU_INPUT_XBAR_GPIO52, MCU_INPUT_XBAR_GPIO53, MCU_INPUT_XBAR_GPIO54, MCU_INPUT_XBAR_GPIO55, MCU_INPUT_XBAR_GPIO56, MCU_INPUT_XBAR_GPIO57, MCU_INPUT_XBAR_GPIO58, MCU_INPUT_XBAR_GPIO59, MCU_INPUT_XBAR_GPIO60, MCU_INPUT_XBAR_GPIO61, MCU_INPUT_XBAR_GPIO62, MCU_INPUT_XBAR_GPIO63, MCU_INPUT_XBAR_GPIO64, MCU_INPUT_XBAR_GPIO65, MCU_INPUT_XBAR_GPIO66, MCU_INPUT_XBAR_GPIO67, MCU_INPUT_XBAR_GPIO68, MCU_INPUT_XBAR_GPIO69, MCU_INPUT_XBAR_GPIO70, MCU_INPUT_XBAR_GPIO71, MCU_INPUT_XBAR_GPIO72, MCU_INPUT_XBAR_GPIO73, MCU_INPUT_XBAR_GPIO74, MCU_INPUT_XBAR_GPIO75, MCU_INPUT_XBAR_GPIO76, MCU_INPUT_XBAR_GPIO77, MCU_INPUT_XBAR_GPIO78, MCU_INPUT_XBAR_GPIO79, MCU_INPUT_XBAR_GPIO80, MCU_INPUT_XBAR_GPIO81, MCU_INPUT_XBAR_GPIO82, MCU_INPUT_XBAR_GPIO83, MCU_INPUT_XBAR_GPIO84, MCU_INPUT_XBAR_GPIO85, MCU_INPUT_XBAR_GPIO86, MCU_INPUT_XBAR_GPIO87, MCU_INPUT_XBAR_GPIO88, MCU_INPUT_XBAR_GPIO89, MCU_INPUT_XBAR_GPIO90, MCU_INPUT_XBAR_GPIO91, MCU_INPUT_XBAR_GPIO92, MCU_INPUT_XBAR_GPIO93, MCU_INPUT_XBAR_GPIO94, MCU_INPUT_XBAR_GPIO95, MCU_INPUT_XBAR_GPIO96, MCU_INPUT_XBAR_GPIO97, MCU_INPUT_XBAR_GPIO98, MCU_INPUT_XBAR_GPIO99, MCU_INPUT_XBAR_GPIO100, MCU_INPUT_XBAR_GPIO101, MCU_INPUT_XBAR_GPIO102, MCU_INPUT_XBAR_GPIO103, MCU_INPUT_XBAR_GPIO104, MCU_INPUT_XBAR_GPIO105, MCU_INPUT_XBAR_GPIO106, MCU_INPUT_XBAR_GPIO107, MCU_INPUT_XBAR_GPIO108, MCU_INPUT_XBAR_GPIO109, MCU_INPUT_XBAR_GPIO110, MCU_INPUT_XBAR_GPIO111, MCU_INPUT_XBAR_GPIO112, MCU_INPUT_XBAR_GPIO113, MCU_INPUT_XBAR_GPIO114, MCU_INPUT_XBAR_GPIO115, MCU_INPUT_XBAR_GPIO116, MCU_INPUT_XBAR_GPIO117, MCU_INPUT_XBAR_GPIO118, MCU_INPUT_XBAR_GPIO119, MCU_INPUT_XBAR_GPIO120, MCU_INPUT_XBAR_GPIO121, MCU_INPUT_XBAR_GPIO122, MCU_INPUT_XBAR_GPIO123, MCU_INPUT_XBAR_GPIO124, MCU_INPUT_XBAR_GPIO125, MCU_INPUT_XBAR_GPIO126, MCU_INPUT_XBAR_GPIO127, MCU_INPUT_XBAR_GPIO128, MCU_INPUT_XBAR_GPIO129, MCU_INPUT_XBAR_GPIO130, MCU_INPUT_XBAR_GPIO131, MCU_INPUT_XBAR_GPIO132, MCU_INPUT_XBAR_GPIO133, MCU_INPUT_XBAR_GPIO134, MCU_INPUT_XBAR_GPIO135, MCU_INPUT_XBAR_GPIO136, MCU_INPUT_XBAR_GPIO137, MCU_INPUT_XBAR_GPIO138, MCU_INPUT_XBAR_GPIO139, MCU_INPUT_XBAR_GPIO140, MCU_INPUT_XBAR_GPIO141, MCU_INPUT_XBAR_GPIO142, MCU_INPUT_XBAR_GPIO143, MCU_INPUT_XBAR_ICSSGPO0_PORT0, MCU_INPUT_XBAR_ICSSGPO1_PORT0, MCU_INPUT_XBAR_ICSSGPO2_PORT0, MCU_INPUT_XBAR_ICSSGPO3_PORT0, MCU_INPUT_XBAR_ICSSGPO4_PORT0, MCU_INPUT_XBAR_ICSSGPO5_PORT0, MCU_INPUT_XBAR_ICSSGPO6_PORT0, MCU_INPUT_XBAR_ICSSGPO7_PORT0, MCU_INPUT_XBAR_ICSSGPO8_PORT0, MCU_INPUT_XBAR_ICSSGPO9_PORT0, MCU_INPUT_XBAR_ICSSGPO10_PORT0, MCU_INPUT_XBAR_ICSSGPO11_PORT0, MCU_INPUT_XBAR_ICSSGPO12_PORT0, MCU_INPUT_XBAR_ICSSGPO13_PORT0, MCU_INPUT_XBAR_ICSSGPO14_PORT0, MCU_INPUT_XBAR_ICSSGPO15_PORT0, MCU_INPUT_XBAR_ICSSGPO0_PORT1, MCU_INPUT_XBAR_ICSSGPO1_PORT1, MCU_INPUT_XBAR_ICSSGPO2_PORT1, MCU_INPUT_XBAR_ICSSGPO3_PORT1, MCU_INPUT_XBAR_ICSSGPO4_PORT1, MCU_INPUT_XBAR_ICSSGPO5_PORT1, MCU_INPUT_XBAR_ICSSGPO6_PORT1, MCU_INPUT_XBAR_ICSSGPO7_PORT1, MCU_INPUT_XBAR_ICSSGPO8_PORT1, MCU_INPUT_XBAR_ICSSGPO9_PORT1, MCU_INPUT_XBAR_ICSSGPO10_PORT1, MCU_INPUT_XBAR_ICSSGPO11_PORT1, MCU_INPUT_XBAR_ICSSGPO12_PORT1, MCU_INPUT_XBAR_ICSSGPO13_PORT1, MCU_INPUT_XBAR_ICSSGPO14_PORT1, MCU_INPUT_XBAR_ICSSGPO15_PORT1}, origin=Texas Instruments, set at pre-compile, default-value=MCU_INPUT_XBAR_GPIO0  # Cross Bar.
      container McuGpioXbarIntrConfiguration [0..*]: requires-index=true  # This container contains channel/bank selection for each output pin of GPIO_XBAR_INTRTR0 routing module
        enumeration McuGpioIntrXbar: {MCU_GPIO_0, MCU_GPIO_1, MCU_GPIO_2, MCU_GPIO_3, MCU_GPIO_4, MCU_GPIO_5, MCU_GPIO_6, MCU_GPIO_7, MCU_GPIO_8, MCU_GPIO_9, MCU_GPIO_10, MCU_GPIO_11, MCU_GPIO_12, MCU_GPIO_13, MCU_GPIO_14, MCU_GPIO_15, MCU_GPIO_16, MCU_GPIO_17, MCU_GPIO_18, MCU_GPIO_19, MCU_GPIO_20, MCU_GPIO_21, MCU_GPIO_22, MCU_GPIO_23, MCU_GPIO_24, MCU_GPIO_25, MCU_GPIO_26, MCU_GPIO_27, MCU_GPIO_28, MCU_GPIO_29, MCU_GPIO_30, MCU_GPIO_31, MCU_GPIO_32, MCU_GPIO_33, MCU_GPIO_34, MCU_GPIO_35, MCU_GPIO_36, MCU_GPIO_37, MCU_GPIO_38, MCU_GPIO_39, MCU_GPIO_40, MCU_GPIO_41, MCU_GPIO_42, MCU_GPIO_43, MCU_GPIO_44, MCU_GPIO_45, MCU_GPIO_46, MCU_GPIO_47, MCU_GPIO_48, MCU_GPIO_49, MCU_GPIO_50, MCU_GPIO_51, MCU_GPIO_52, MCU_GPIO_53, MCU_GPIO_54, MCU_GPIO_55, MCU_GPIO_56, MCU_GPIO_57, MCU_GPIO_58, MCU_GPIO_59, MCU_GPIO_60, MCU_GPIO_61, MCU_GPIO_62, MCU_GPIO_63, MCU_GPIO_64, MCU_GPIO_65, MCU_GPIO_66, MCU_GPIO_67, MCU_GPIO_68, MCU_GPIO_69, MCU_GPIO_70, MCU_GPIO_71, MCU_GPIO_72, MCU_GPIO_73, MCU_GPIO_74, MCU_GPIO_75, MCU_GPIO_76, MCU_GPIO_77, MCU_GPIO_78, MCU_GPIO_79, MCU_GPIO_80, MCU_GPIO_81, MCU_GPIO_82, MCU_GPIO_83, MCU_GPIO_84, MCU_GPIO_85, MCU_GPIO_86, MCU_GPIO_87, MCU_GPIO_88, MCU_GPIO_89, MCU_GPIO_90, MCU_GPIO_91, MCU_GPIO_92, MCU_GPIO_93, MCU_GPIO_94, MCU_GPIO_95, MCU_GPIO_96, MCU_GPIO_97, MCU_GPIO_98, MCU_GPIO_99, MCU_GPIO_100, MCU_GPIO_101, MCU_GPIO_102, MCU_GPIO_103, MCU_GPIO_104, MCU_GPIO_105, MCU_GPIO_106, MCU_GPIO_107, MCU_GPIO_108, MCU_GPIO_109, MCU_GPIO_110, MCU_GPIO_111, MCU_GPIO_112, MCU_GPIO_113, MCU_GPIO_114, MCU_GPIO_115, MCU_GPIO_116, MCU_GPIO_117, MCU_GPIO_118, MCU_GPIO_119, MCU_GPIO_120, MCU_GPIO_121, MCU_GPIO_122, MCU_GPIO_123, MCU_GPIO_124, MCU_GPIO_125, MCU_GPIO_126, MCU_GPIO_127, MCU_GPIO_128, MCU_GPIO_129, MCU_GPIO_130, MCU_GPIO_131, MCU_GPIO_132, MCU_GPIO_133, MCU_GPIO_134, MCU_GPIO_135, MCU_GPIO_136, MCU_GPIO_137, MCU_GPIO_138, MCU_GPIO_0_BANK_INTR_0, MCU_GPIO_0_BANK_INTR_1, MCU_GPIO_0_BANK_INTR_2, MCU_GPIO_0_BANK_INTR_3, MCU_GPIO_0_BANK_INTR_4, MCU_GPIO_0_BANK_INTR_5, MCU_GPIO_0_BANK_INTR_6, MCU_GPIO_0_BANK_INTR_7, MCU_GPIO_0_BANK_INTR_8, MCU_GPIO_1_BANK_INTR_0, MCU_GPIO_1_BANK_INTR_1, MCU_GPIO_1_BANK_INTR_2, MCU_GPIO_1_BANK_INTR_3, MCU_GPIO_1_BANK_INTR_4, MCU_GPIO_1_BANK_INTR_5, MCU_GPIO_1_BANK_INTR_6, MCU_GPIO_1_BANK_INTR_7, MCU_GPIO_1_BANK_INTR_8, MCU_GPIO_2_BANK_INTR_0, MCU_GPIO_2_BANK_INTR_1, MCU_GPIO_2_BANK_INTR_2, MCU_GPIO_2_BANK_INTR_3, MCU_GPIO_2_BANK_INTR_4, MCU_GPIO_2_BANK_INTR_5, MCU_GPIO_2_BANK_INTR_6, MCU_GPIO_2_BANK_INTR_7, MCU_GPIO_2_BANK_INTR_8, MCU_GPIO_3_BANK_INTR_0, MCU_GPIO_3_BANK_INTR_1, MCU_GPIO_3_BANK_INTR_2, MCU_GPIO_3_BANK_INTR_3, MCU_GPIO_3_BANK_INTR_4, MCU_GPIO_3_BANK_INTR_5, MCU_GPIO_3_BANK_INTR_6, MCU_GPIO_3_BANK_INTR_7, MCU_GPIO_3_BANK_INTR_8}, origin=Texas Instruments, set at pre-compile, default-value=MCU_GPIO_0  # GPIO xbar Intr.
        enumeration McuGpioXbarOutMap: {MCU_GPIO_INT_XBAR_ICSS_XBAR_0, MCU_GPIO_INT_XBAR_ICSS_XBAR_1, MCU_GPIO_INT_XBAR_ICSS_XBAR_2, MCU_GPIO_INT_XBAR_ICSS_XBAR_3, MCU_GPIO_INT_XBAR_DMA_TRIG_XBAR_0, MCU_GPIO_INT_XBAR_DMA_TRIG_XBAR_1, MCU_GPIO_INT_XBAR_DMA_TRIG_XBAR_2, MCU_GPIO_INT_XBAR_DMA_TRIG_XBAR_3, MCU_GPIO_INT_XBAR_SOC_TIMESYNC_XBAR1_0, MCU_GPIO_INT_XBAR_SOC_TIMESYNC_XBAR1_1, MCU_GPIO_INT_XBAR_SOC_TIMESYNC_XBAR1_2, MCU_GPIO_INT_XBAR_SOC_TIMESYNC_XBAR1_3, MCU_GPIO_INT_XBAR_SOC_TIMESYNC_XBAR1_4, MCU_GPIO_INT_XBAR_SOC_TIMESYNC_XBAR1_5, MCU_GPIO_INT_XBAR_VIM_MODULE0_0, MCU_GPIO_INT_XBAR_VIM_MODULE0_1, MCU_GPIO_INT_XBAR_VIM_MODULE0_2, MCU_GPIO_INT_XBAR_VIM_MODULE0_3, MCU_GPIO_INT_XBAR_VIM_MODULE1_0, MCU_GPIO_INT_XBAR_VIM_MODULE1_1, MCU_GPIO_INT_XBAR_VIM_MODULE1_2, MCU_GPIO_INT_XBAR_VIM_MODULE1_3, MCU_GPIO_INT_XBAR_VIM_MODULE2_0, MCU_GPIO_INT_XBAR_VIM_MODULE2_1, MCU_GPIO_INT_XBAR_VIM_MODULE2_2, MCU_GPIO_INT_XBAR_VIM_MODULE2_3, MCU_GPIO_INT_XBAR_VIM_MODULE3_0, MCU_GPIO_INT_XBAR_VIM_MODULE3_1, MCU_GPIO_INT_XBAR_VIM_MODULE3_2, MCU_GPIO_INT_XBAR_VIM_MODULE3_3}, origin=Texas Instruments, set at pre-compile, default-value=MCU_GPIO_INT_XBAR_VIM_MODULE0_0  # Gpio xbar output pin mapping
      container McuPwmConfiguration [0..*]: requires-index=true  # This container contains the PWM clock configuration.
        symbolic name reference McuPwmChannelId [0..1]: multiplicity set at pre-compile, origin=Texas Instruments, set at pre-compile, destination=PwmChannel  # PwmChannelId
        symbolic name reference McuPwmGroupId [0..1]: multiplicity set at pre-compile, origin=Texas Instruments, set at pre-compile, destination=PwmChannel  # PwmGroupId
      container McuCddPwmConfiguration [0..*]: requires-index=true  # This container contains the PWM clock configuration.
        symbolic name reference McuCddPwmChannelId [0..1]: multiplicity set at pre-compile, origin=Texas Instruments, set at pre-compile, destination=CddPwmChannel  # CddPwmChannelId
      container McuAdcConfiguration [0..*]: requires-index=true  # This container contains the ADC buffer control configuration.
        symbolic name reference McuAdcHWUnitId [0..1]: multiplicity set at pre-compile, origin=Texas Instruments, set at pre-compile, destination=AdcHwUnit  # AdcHwUnit
      container McuEthConfiguration [0..*]: requires-index=true  # This container contains the Eth CPSW Control configuration.
        symbolic name reference McuEthCtrConfig [0..1]: multiplicity set at pre-compile, origin=Texas Instruments, set at pre-compile, destination=EthCtrlConfig
      container McuDemEventParameterRefs [0..1]  # Container for the references to DemEventParameter elements which shall be invoked using the API Dem_ReportErrorStatus API in case the corresponding error occurs. The EventId is taken from the referenced DemEventParameter's DemEventId value. The standardized errors are provided in the container and can be extended by vendor specific error references.
        symbolic name reference MCU_E_CLOCK_FAILURE [0..1]: multiplicity set at pre-compile, set at pre-compile, destination=DemEventParameter  # Reference to configured DEM event to report "Clock source failure".
        symbolic name reference MCU_E_MODE_FAILURE [0..1]: multiplicity set at pre-compile, origin=Texas Instruments, set at pre-compile, destination=DemEventParameter  # Reference to the DemEventParameter which shall be issued when the error "Timeout on blocking API call occurs " has occurred.
        symbolic name reference MCU_E_HARDWARE_ERROR [0..1]: multiplicity set at pre-compile, origin=Texas Instruments, set at pre-compile, destination=DemEventParameter  # Reference to the DemEventParameter which shall be issued when the error "Timeout on blocking API call occurs " has occurred.
      container McuModeSettingConf [1..*]  # This container contains the configuration (parameters) for the Mode setting of the MCU.
        integer McuMode: 0..255, set at post-build in variant post-build / pre-compile in variant pre-compile, symbolic-name-value=true, default-value=200  # The parameter represents the MCU Mode settings.
      container McuRamSectorSettingConf [0..*]  # This container contains the configuration (parameters) for the RAM Sector setting. Please see MCU030 for more information on RAM sec-tor settings.
        integer McuRamDefaultValue: 0..255, set at post-build in variant post-build / pre-compile in variant pre-compile, default-value=0  # This parameter shall represent the Data pre-setting to be initialized
        integer McuRamSectionBaseAddress: 1..4294967295, set at post-build in variant post-build / pre-compile in variant pre-compile, default-value=1879048192  # This parameter shall represent the MCU RAM section base address
        integer McuRamSectionSize: 0..4294967295, set at post-build in variant post-build / pre-compile in variant pre-compile, default-value=256  # This parameter represents the MCU RAM Section size in bytes.
        integer McuRamSectionWriteSize: 0..4294967295, set at post-build in variant post-build / pre-compile in variant pre-compile, default-value=8  # This parameter shall define the size in bytes of data which can be written into RAM at once.
    container McuPublishedInformation: requires-index=true  # Container holding all MCU specific published information parameters
      enumeration McuDeviceVariant [0..1]: {AM263x}, origin=Texas Instruments, set at published-information, default-value=AM263x  # Select SOC variant .This parameter shall be used by driver to impose device specific constraints. The user guide shall detail the device specific constraints
      container McuResetReasonConf [1..*]: requires-index=true  # This container contains the configuration for the different type of reset reason that can be retrieved from Mcu_GetResetReason Api.
        integer McuResetReason: 0..255, scope=ECU, requires-index=true, set at pre-compile, symbolic-name-value=true  # The parameter represents the different type of reset that a Micro supports. This parameter is referenced by the parameter EcuMResetReason in the ECU State manager module.
