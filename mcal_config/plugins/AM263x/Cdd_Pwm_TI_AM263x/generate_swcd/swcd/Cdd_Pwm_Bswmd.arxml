[part 1 of 4]
<?xml version="1.0" encoding="UTF-8"?>
[!AUTOSPACING!][!//
<AUTOSAR xmlns="http://autosar.org/schema/r4.0" xmlns:xsi="http://www.w3.org/2001/XMLSchema-instance" xsi:schemaLocation="http://autosar.org/schema/r4.0 AUTOSAR_00044.xsd">
  <AR-PACKAGES>
    <AR-PACKAGE UUID="f2cab962-338a-4318-8bb9-fe3ee1334c32">
      <SHORT-NAME>Cdd_Pwm_TI_AM263x</SHORT-NAME>
      <ELEMENTS>
        <BSW-MODULE-DESCRIPTION UUID="f10365d7-7bbc-479a-8d68-b489f92a46d9">
          <SHORT-NAME>Cdd_Pwm</SHORT-NAME>
          <CATEGORY>BSW_MODULE</CATEGORY>
          <IMPLEMENTED-ENTRYS>
          [!IF "as:modconf('Cdd_Pwm')[1]/CddPwmGeneral/CddPwmChopperEnable = 'true'"!][!//
            <BSW-MODULE-ENTRY-REF-CONDITIONAL>
              <BSW-MODULE-ENTRY-REF DEST="BSW-MODULE-ENTRY">/Cdd_Pwm_TI_AM263x/Cdd_Pwm_ModuleEntry/Cdd_Pwm_ChopperCfg</BSW-MODULE-ENTRY-REF>
            </BSW-MODULE-ENTRY-REF-CONDITIONAL>
            <BSW-MODULE-ENTRY-REF-CONDITIONAL>
              <BSW-MODULE-ENTRY-REF DEST="BSW-MODULE-ENTRY">/Cdd_Pwm_TI_AM263x/Cdd_Pwm_ModuleEntry/Cdd_Pwm_ChopperEnable</BSW-MODULE-ENTRY-REF>
            </BSW-MODULE-ENTRY-REF-CONDITIONAL>
          [!ENDIF!][!//
          [!IF "as:modconf('Cdd_Pwm')[1]/CddPwmConfigurationOfOptionalApis/CddPwmGetCounterStatus"!][!//
            <BSW-MODULE-ENTRY-REF-CONDITIONAL>
              <BSW-MODULE-ENTRY-REF DEST="BSW-MODULE-ENTRY">/Cdd_Pwm_TI_AM263x/Cdd_Pwm_ModuleEntry/Cdd_Pwm_ClearCounterStatus</BSW-MODULE-ENTRY-REF>
            </BSW-MODULE-ENTRY-REF-CONDITIONAL>
          [!ENDIF!][!//
          [!IF "as:modconf('Cdd_Pwm')[1]/CddPwmConfigurationOfOptionalApis/CddPwmCounterComparatorCfg"!][!//
            <BSW-MODULE-ENTRY-REF-CONDITIONAL>
              <BSW-MODULE-ENTRY-REF DEST="BSW-MODULE-ENTRY">/Cdd_Pwm_TI_AM263x/Cdd_Pwm_ModuleEntry/Cdd_Pwm_CounterComparatorCfg</BSW-MODULE-ENTRY-REF>
            </BSW-MODULE-ENTRY-REF-CONDITIONAL>
          [!ENDIF!][!//
          [!IF "as:modconf('Cdd_Pwm')[1]/CddPwmConfigurationOfOptionalApis/CddPwmDeInitApi"!][!//
            <BSW-MODULE-ENTRY-REF-CONDITIONAL>
              <BSW-MODULE-ENTRY-REF DEST="BSW-MODULE-ENTRY">/Cdd_Pwm_TI_AM263x/Cdd_Pwm_ModuleEntry/Cdd_Pwm_DeInit</BSW-MODULE-ENTRY-REF>
            </BSW-MODULE-ENTRY-REF-CONDITIONAL>
          [!ENDIF!][!//
          [!IF "as:modconf('Cdd_Pwm')[1]/CddPwmGeneral/CddPwmDeadBandEnable"!][!//
            <BSW-MODULE-ENTRY-REF-CONDITIONAL>
              <BSW-MODULE-ENTRY-REF DEST="BSW-MODULE-ENTRY">/Cdd_Pwm_TI_AM263x/Cdd_Pwm_ModuleEntry/Cdd_Pwm_DeadbandBypass</BSW-MODULE-ENTRY-REF>
            </BSW-MODULE-ENTRY-REF-CONDITIONAL>
            <BSW-MODULE-ENTRY-REF-CONDITIONAL>
              <BSW-MODULE-ENTRY-REF DEST="BSW-MODULE-ENTRY">/Cdd_Pwm_TI_AM263x/Cdd_Pwm_ModuleEntry/Cdd_Pwm_DeadbandCfg</BSW-MODULE-ENTRY-REF>
            </BSW-MODULE-ENTRY-REF-CONDITIONAL>
			<BSW-MODULE-ENTRY-REF-CONDITIONAL>
              <BSW-MODULE-ENTRY-REF DEST="BSW-MODULE-ENTRY">/Cdd_Pwm_TI_AM263x/Cdd_Pwm_ModuleEntry/Cdd_Pwm_SetRisingEdgeDelay</BSW-MODULE-ENTRY-REF>
            </BSW-MODULE-ENTRY-REF-CONDITIONAL>
            <BSW-MODULE-ENTRY-REF-CONDITIONAL>
              <BSW-MODULE-ENTRY-REF DEST="BSW-MODULE-ENTRY">/Cdd_Pwm_TI_AM263x/Cdd_Pwm_ModuleEntry/Cdd_Pwm_SetFallingEdgeDelay</BSW-MODULE-ENTRY-REF>
            </BSW-MODULE-ENTRY-REF-CONDITIONAL>
			<BSW-MODULE-ENTRY-REF-CONDITIONAL>
              <BSW-MODULE-ENTRY-REF DEST="BSW-MODULE-ENTRY">/Cdd_Pwm_TI_AM263x/Cdd_Pwm_ModuleEntry/Cdd_Pwm_SetMinDeadbandDelay</BSW-MODULE-ENTRY-REF>
            </BSW-MODULE-ENTRY-REF-CONDITIONAL>
			<BSW-MODULE-ENTRY-REF-CONDITIONAL>
              <BSW-MODULE-ENTRY-REF DEST="BSW-MODULE-ENTRY">/Cdd_Pwm_TI_AM263x/Cdd_Pwm_ModuleEntry/Cdd_Pwm_HrSetRisingEdgeDelay</BSW-MODULE-ENTRY-REF>
            </BSW-MODULE-ENTRY-REF-CONDITIONAL>
            <BSW-MODULE-ENTRY-REF-CONDITIONAL>
              <BSW-MODULE-ENTRY-REF DEST="BSW-MODULE-ENTRY">/Cdd_Pwm_TI_AM263x/Cdd_Pwm_ModuleEntry/Cdd_Pwm_HrSetFallingEdgeDelay</BSW-MODULE-ENTRY-REF>
            </BSW-MODULE-ENTRY-REF-CONDITIONAL>
          [!ENDIF!][!//
          [!IF "as:modconf('Cdd_Pwm')[1]/CddPwmConfigurationOfOptionalApis/CddPwmNotificationSupported"!][!//
            <BSW-MODULE-ENTRY-REF-CONDITIONAL>
              <BSW-MODULE-ENTRY-REF DEST="BSW-MODULE-ENTRY">/Cdd_Pwm_TI_AM263x/Cdd_Pwm_ModuleEntry/Cdd_Pwm_DisableNotification</BSW-MODULE-ENTRY-REF>
            </BSW-MODULE-ENTRY-REF-CONDITIONAL>
            <BSW-MODULE-ENTRY-REF-CONDITIONAL>
              <BSW-MODULE-ENTRY-REF DEST="BSW-MODULE-ENTRY">/Cdd_Pwm_TI_AM263x/Cdd_Pwm_ModuleEntry/Cdd_Pwm_EnableNotification</BSW-MODULE-ENTRY-REF>
            </BSW-MODULE-ENTRY-REF-CONDITIONAL>
          [!ENDIF!][!//
            <BSW-MODULE-ENTRY-REF-CONDITIONAL>
              <BSW-MODULE-ENTRY-REF DEST="BSW-MODULE-ENTRY">/Cdd_Pwm_TI_AM263x/Cdd_Pwm_ModuleEntry/Cdd_Pwm_EtGetEventCount</BSW-MODULE-ENTRY-REF>
            </BSW-MODULE-ENTRY-REF-CONDITIONAL>
            <BSW-MODULE-ENTRY-REF-CONDITIONAL>
              <BSW-MODULE-ENTRY-REF DEST="BSW-MODULE-ENTRY">/Cdd_Pwm_TI_AM263x/Cdd_Pwm_ModuleEntry/Cdd_Pwm_EtIntrClear</BSW-MODULE-ENTRY-REF>
            </BSW-MODULE-ENTRY-REF-CONDITIONAL>
            <BSW-MODULE-ENTRY-REF-CONDITIONAL>
              <BSW-MODULE-ENTRY-REF DEST="BSW-MODULE-ENTRY">/Cdd_Pwm_TI_AM263x/Cdd_Pwm_ModuleEntry/Cdd_Pwm_EtIntrStatus</BSW-MODULE-ENTRY-REF>
            </BSW-MODULE-ENTRY-REF-CONDITIONAL>
          [!LOOP "as:modconf('Cdd_Pwm')[1]/CddPwmConfigSet/*/CddPwmChannel/*"!]
          [!VAR "Group" = "(num:i(substring-after(CddPwmGroupUnit,'CDD_PWM_CONTROLSS_G')))"!]
          [!VAR "Channel" = "(num:i(substring-after(CddPwmHwChannel,'CDD_PWM_CHANNEL_')))"!]
          [!IF "num:i($Group) = '0'"!][!//
          [!IF "num:i($Channel) = '0'"!][!//
            <BSW-MODULE-ENTRY-REF-CONDITIONAL>
              <BSW-MODULE-ENTRY-REF DEST="BSW-MODULE-ENTRY">/Cdd_Pwm_TI_AM263x/Cdd_Pwm_ModuleEntry/Cdd_Pwm_G0_Ch0Isr</BSW-MODULE-ENTRY-REF>
            </BSW-MODULE-ENTRY-REF-CONDITIONAL>
          [!ENDIF!][!//
          [!IF "num:i($Channel) = '10'"!][!//
            <BSW-MODULE-ENTRY-REF-CONDITIONAL>
              <BSW-MODULE-ENTRY-REF DEST="BSW-MODULE-ENTRY">/Cdd_Pwm_TI_AM263x/Cdd_Pwm_ModuleEntry/Cdd_Pwm_G0_Ch10Isr</BSW-MODULE-ENTRY-REF>
            </BSW-MODULE-ENTRY-REF-CONDITIONAL>
          [!ENDIF!][!//
          [!IF "num:i($Channel) = '11'"!][!//
            <BSW-MODULE-ENTRY-REF-CONDITIONAL>
              <BSW-MODULE-ENTRY-REF DEST="BSW-MODULE-ENTRY">/Cdd_Pwm_TI_AM263x/Cdd_Pwm_ModuleEntry/Cdd_Pwm_G0_Ch11Isr</BSW-MODULE-ENTRY-REF>
            </BSW-MODULE-ENTRY-REF-CONDITIONAL>
          [!ENDIF!][!//
          [!IF "num:i($Channel) = '12'"!][!//
            <BSW-MODULE-ENTRY-REF-CONDITIONAL>
              <BSW-MODULE-ENTRY-REF DEST="BSW-MODULE-ENTRY">/Cdd_Pwm_TI_AM263x/Cdd_Pwm_ModuleEntry/Cdd_Pwm_G0_Ch12Isr</BSW-MODULE-ENTRY-REF>
            </BSW-MODULE-ENTRY-REF-CONDITIONAL>
          [!ENDIF!][!//
          [!IF "num:i($Channel) = '13'"!][!//
            <BSW-MODULE-ENTRY-REF-CONDITIONAL>
              <BSW-MODULE-ENTRY-REF DEST="BSW-MODULE-ENTRY">/Cdd_Pwm_TI_AM263x/Cdd_Pwm_ModuleEntry/Cdd_Pwm_G0_Ch13Isr</BSW-MODULE-ENTRY-REF>
            </BSW-MODULE-ENTRY-REF-CONDITIONAL>
          [!ENDIF!][!//
          [!IF "num:i($Channel) = '14'"!][!//
            <BSW-MODULE-ENTRY-REF-CONDITIONAL>
              <BSW-MODULE-ENTRY-REF DEST="BSW-MODULE-ENTRY">/Cdd_Pwm_TI_AM263x/Cdd_Pwm_ModuleEntry/Cdd_Pwm_G0_Ch14Isr</BSW-MODULE-ENTRY-REF>
            </BSW-MODULE-ENTRY-REF-CONDITIONAL>
          [!ENDIF!][!//
          [!IF "num:i($Channel) = '15'"!][!//
            <BSW-MODULE-ENTRY-REF-CONDITIONAL>
              <BSW-MODULE-ENTRY-REF DEST="BSW-MODULE-ENTRY">/Cdd_Pwm_TI_AM263x/Cdd_Pwm_ModuleEntry/Cdd_Pwm_G0_Ch15Isr</BSW-MODULE-ENTRY-REF>
            </BSW-MODULE-ENTRY-REF-CONDITIONAL>
          [!ENDIF!][!//
          [!IF "num:i($Channel) = '16'"!][!//
            <BSW-MODULE-ENTRY-REF-CONDITIONAL>
              <BSW-MODULE-ENTRY-REF DEST="BSW-MODULE-ENTRY">/Cdd_Pwm_TI_AM263x/Cdd_Pwm_ModuleEntry/Cdd_Pwm_G0_Ch16Isr</BSW-MODULE-ENTRY-REF>
            </BSW-MODULE-ENTRY-REF-CONDITIONAL>
          [!ENDIF!][!//
          [!IF "num:i($Channel) = '17'"!][!//
            <BSW-MODULE-ENTRY-REF-CONDITIONAL>
              <BSW-MODULE-ENTRY-REF DEST="BSW-MODULE-ENTRY">/Cdd_Pwm_TI_AM263x/Cdd_Pwm_ModuleEntry/Cdd_Pwm_G0_Ch17Isr</BSW-MODULE-ENTRY-REF>
            </BSW-MODULE-ENTRY-REF-CONDITIONAL>
          [!ENDIF!][!//
          [!IF "num:i($Channel) = '18'"!][!//
            <BSW-MODULE-ENTRY-REF-CONDITIONAL>
              <BSW-MODULE-ENTRY-REF DEST="BSW-MODULE-ENTRY">/Cdd_Pwm_TI_AM263x/Cdd_Pwm_ModuleEntry/Cdd_Pwm_G0_Ch18Isr</BSW-MODULE-ENTRY-REF>
            </BSW-MODULE-ENTRY-REF-CONDITIONAL>
          [!ENDIF!][!//
          [!IF "num:i($Channel) = '19'"!][!//
            <BSW-MODULE-ENTRY-REF-CONDITIONAL>
              <BSW-MODULE-ENTRY-REF DEST="BSW-MODULE-ENTRY">/Cdd_Pwm_TI_AM263x/Cdd_Pwm_ModuleEntry/Cdd_Pwm_G0_Ch19Isr</BSW-MODULE-ENTRY-REF>
            </BSW-MODULE-ENTRY-REF-CONDITIONAL>
          [!ENDIF!][!//
          [!IF "num:i($Channel) = '1'"!][!//
            <BSW-MODULE-ENTRY-REF-CONDITIONAL>
              <BSW-MODULE-ENTRY-REF DEST="BSW-MODULE-ENTRY">/Cdd_Pwm_TI_AM263x/Cdd_Pwm_ModuleEntry/Cdd_Pwm_G0_Ch1Isr</BSW-MODULE-ENTRY-REF>
            </BSW-MODULE-ENTRY-REF-CONDITIONAL>
          [!ENDIF!][!//
          [!IF "num:i($Channel) = '20'"!][!//
            <BSW-MODULE-ENTRY-REF-CONDITIONAL>
              <BSW-MODULE-ENTRY-REF DEST="BSW-MODULE-ENTRY">/Cdd_Pwm_TI_AM263x/Cdd_Pwm_ModuleEntry/Cdd_Pwm_G0_Ch20Isr</BSW-MODULE-ENTRY-REF>
            </BSW-MODULE-ENTRY-REF-CONDITIONAL>
          [!ENDIF!][!//
          [!IF "num:i($Channel) = '21'"!][!//
            <BSW-MODULE-ENTRY-REF-CONDITIONAL>
              <BSW-MODULE-ENTRY-REF DEST="BSW-MODULE-ENTRY">/Cdd_Pwm_TI_AM263x/Cdd_Pwm_ModuleEntry/Cdd_Pwm_G0_Ch21Isr</BSW-MODULE-ENTRY-REF>
            </BSW-MODULE-ENTRY-REF-CONDITIONAL>
          [!ENDIF!][!//
          [!IF "num:i($Channel) = '22'"!][!//
            <BSW-MODULE-ENTRY-REF-CONDITIONAL>
              <BSW-MODULE-ENTRY-REF DEST="BSW-MODULE-ENTRY">/Cdd_Pwm_TI_AM263x/Cdd_Pwm_ModuleEntry/Cdd_Pwm_G0_Ch22Isr</BSW-MODULE-ENTRY-REF>
            </BSW-MODULE-ENTRY-REF-CONDITIONAL>
          [!ENDIF!][!//
          [!IF "num:i($Channel) = '23'"!][!//
            <BSW-MODULE-ENTRY-REF-CONDITIONAL>
              <BSW-MODULE-ENTRY-REF DEST="BSW-MODULE-ENTRY">/Cdd_Pwm_TI_AM263x/Cdd_Pwm_ModuleEntry/Cdd_Pwm_G0_Ch23Isr</BSW-MODULE-ENTRY-REF>
            </BSW-MODULE-ENTRY-REF-CONDITIONAL>
          [!ENDIF!][!//
          [!IF "num:i($Channel) = '24'"!][!//
            <BSW-MODULE-ENTRY-REF-CONDITIONAL>
              <BSW-MODULE-ENTRY-REF DEST="BSW-MODULE-ENTRY">/Cdd_Pwm_TI_AM263x/Cdd_Pwm_ModuleEntry/Cdd_Pwm_G0_Ch24Isr</BSW-MODULE-ENTRY-REF>
            </BSW-MODULE-ENTRY-REF-CONDITIONAL>
          [!ENDIF!][!//
          [!IF "num:i($Channel) = '25'"!][!//
            <BSW-MODULE-ENTRY-REF-CONDITIONAL>
              <BSW-MODULE-ENTRY-REF DEST="BSW-MODULE-ENTRY">/Cdd_Pwm_TI_AM263x/Cdd_Pwm_ModuleEntry/Cdd_Pwm_G0_Ch25Isr</BSW-MODULE-ENTRY-REF>
            </BSW-MODULE-ENTRY-REF-CONDITIONAL>
          [!ENDIF!][!//
          [!IF "num:i($Channel) = '26'"!][!//
            <BSW-MODULE-ENTRY-REF-CONDITIONAL>
              <BSW-MODULE-ENTRY-REF DEST="BSW-MODULE-ENTRY">/Cdd_Pwm_TI_AM263x/Cdd_Pwm_ModuleEntry/Cdd_Pwm_G0_Ch26Isr</BSW-MODULE-ENTRY-REF>
            </BSW-MODULE-ENTRY-REF-CONDITIONAL>
          [!ENDIF!][!//
          [!IF "num:i($Channel) = '27'"!][!//
            <BSW-MODULE-ENTRY-REF-CONDITIONAL>
              <BSW-MODULE-ENTRY-REF DEST="BSW-MODULE-ENTRY">/Cdd_Pwm_TI_AM263x/Cdd_Pwm_ModuleEntry/Cdd_Pwm_G0_Ch27Isr</BSW-MODULE-ENTRY-REF>
            </BSW-MODULE-ENTRY-REF-CONDITIONAL>
          [!ENDIF!][!//
          [!IF "num:i($Channel) = '28'"!][!//
            <BSW-MODULE-ENTRY-REF-CONDITIONAL>
              <BSW-MODULE-ENTRY-REF DEST="BSW-MODULE-ENTRY">/Cdd_Pwm_TI_AM263x/Cdd_Pwm_ModuleEntry/Cdd_Pwm_G0_Ch28Isr</BSW-MODULE-ENTRY-REF>
            </BSW-MODULE-ENTRY-REF-CONDITIONAL>
          [!ENDIF!][!//
          [!IF "num:i($Channel) = '29'"!][!//
            <BSW-MODULE-ENTRY-REF-CONDITIONAL>
              <BSW-MODULE-ENTRY-REF DEST="BSW-MODULE-ENTRY">/Cdd_Pwm_TI_AM263x/Cdd_Pwm_ModuleEntry/Cdd_Pwm_G0_Ch29Isr</BSW-MODULE-ENTRY-REF>
            </BSW-MODULE-ENTRY-REF-CONDITIONAL>
          [!ENDIF!][!//
          [!IF "num:i($Channel) = '2'"!][!//
            <BSW-MODULE-ENTRY-REF-CONDITIONAL>
              <BSW-MODULE-ENTRY-REF DEST="BSW-MODULE-ENTRY">/Cdd_Pwm_TI_AM263x/Cdd_Pwm_ModuleEntry/Cdd_Pwm_G0_Ch2Isr</BSW-MODULE-ENTRY-REF>
            </BSW-MODULE-ENTRY-REF-CONDITIONAL>
          [!ENDIF!][!//
          [!IF "num:i($Channel) = '30'"!][!//
            <BSW-MODULE-ENTRY-REF-CONDITIONAL>
              <BSW-MODULE-ENTRY-REF DEST="BSW-MODULE-ENTRY">/Cdd_Pwm_TI_AM263x/Cdd_Pwm_ModuleEntry/Cdd_Pwm_G0_Ch30Isr</BSW-MODULE-ENTRY-REF>
            </BSW-MODULE-ENTRY-REF-CONDITIONAL>
          [!ENDIF!][!//
          [!IF "num:i($Channel) = '31'"!][!//
            <BSW-MODULE-ENTRY-REF-CONDITIONAL>
              <BSW-MODULE-ENTRY-REF DEST="BSW-MODULE-ENTRY">/Cdd_Pwm_TI_AM263x/Cdd_Pwm_ModuleEntry/Cdd_Pwm_G0_Ch31Isr</BSW-MODULE-ENTRY-REF>
            </BSW-MODULE-ENTRY-REF-CONDITIONAL>
          [!ENDIF!][!//
          [!IF "num:i($Channel) = '3'"!][!//
            <BSW-MODULE-ENTRY-REF-CONDITIONAL>
              <BSW-MODULE-ENTRY-REF DEST="BSW-MODULE-ENTRY">/Cdd_Pwm_TI_AM263x/Cdd_Pwm_ModuleEntry/Cdd_Pwm_G0_Ch3Isr</BSW-MODULE-ENTRY-REF>
            </BSW-MODULE-ENTRY-REF-CONDITIONAL>
          [!ENDIF!][!//
          [!IF "num:i($Channel) = '4'"!][!//
            <BSW-MODULE-ENTRY-REF-CONDITIONAL>
              <BSW-MODULE-ENTRY-REF DEST="BSW-MODULE-ENTRY">/Cdd_Pwm_TI_AM263x/Cdd_Pwm_ModuleEntry/Cdd_Pwm_G0_Ch4Isr</BSW-MODULE-ENTRY-REF>
            </BSW-MODULE-ENTRY-REF-CONDITIONAL>
          [!ENDIF!][!//
          [!IF "num:i($Channel) = '5'"!][!//
            <BSW-MODULE-ENTRY-REF-CONDITIONAL>
              <BSW-MODULE-ENTRY-REF DEST="BSW-MODULE-ENTRY">/Cdd_Pwm_TI_AM263x/Cdd_Pwm_ModuleEntry/Cdd_Pwm_G0_Ch5Isr</BSW-MODULE-ENTRY-REF>
            </BSW-MODULE-ENTRY-REF-CONDITIONAL>
          [!ENDIF!][!//
          [!IF "num:i($Channel) = '6'"!][!//
            <BSW-MODULE-ENTRY-REF-CONDITIONAL>
              <BSW-MODULE-ENTRY-REF DEST="BSW-MODULE-ENTRY">/Cdd_Pwm_TI_AM263x/Cdd_Pwm_ModuleEntry/Cdd_Pwm_G0_Ch6Isr</BSW-MODULE-ENTRY-REF>
            </BSW-MODULE-ENTRY-REF-CONDITIONAL>
          [!ENDIF!][!//
          [!IF "num:i($Channel) = '7'"!][!//
            <BSW-MODULE-ENTRY-REF-CONDITIONAL>
              <BSW-MODULE-ENTRY-REF DEST="BSW-MODULE-ENTRY">/Cdd_Pwm_TI_AM263x/Cdd_Pwm_ModuleEntry/Cdd_Pwm_G0_Ch7Isr</BSW-MODULE-ENTRY-REF>
            </BSW-MODULE-ENTRY-REF-CONDITIONAL>
          [!ENDIF!][!//
          [!IF "num:i($Channel) = '8'"!][!//
            <BSW-MODULE-ENTRY-REF-CONDITIONAL>
              <BSW-MODULE-ENTRY-REF DEST="BSW-MODULE-ENTRY">/Cdd_Pwm_TI_AM263x/Cdd_Pwm_ModuleEntry/Cdd_Pwm_G0_Ch8Isr</BSW-MODULE-ENTRY-REF>
            </BSW-MODULE-ENTRY-REF-CONDITIONAL>
          [!ENDIF!][!//
          [!IF "num:i($Channel) = '9'"!][!//
            <BSW-MODULE-ENTRY-REF-CONDITIONAL>
              <BSW-MODULE-ENTRY-REF DEST="BSW-MODULE-ENTRY">/Cdd_Pwm_TI_AM263x/Cdd_Pwm_ModuleEntry/Cdd_Pwm_G0_Ch9Isr</BSW-MODULE-ENTRY-REF>
            </BSW-MODULE-ENTRY-REF-CONDITIONAL>
          [!ENDIF!][!//
          [!IF "num:i($Channel) = '0'"!][!//
            <BSW-MODULE-ENTRY-REF-CONDITIONAL>
              <BSW-MODULE-ENTRY-REF DEST="BSW-MODULE-ENTRY">/Cdd_Pwm_TI_AM263x/Cdd_Pwm_ModuleEntry/Cdd_Pwm_G0_TzCh0Isr</BSW-MODULE-ENTRY-REF>
            </BSW-MODULE-ENTRY-REF-CONDITIONAL>
          [!ENDIF!][!//
          [!IF "num:i($Channel) = '10'"!][!//
            <BSW-MODULE-ENTRY-REF-CONDITIONAL>
              <BSW-MODULE-ENTRY-REF DEST="BSW-MODULE-ENTRY">/Cdd_Pwm_TI_AM263x/Cdd_Pwm_ModuleEntry/Cdd_Pwm_G0_TzCh10Isr</BSW-MODULE-ENTRY-REF>
            </BSW-MODULE-ENTRY-REF-CONDITIONAL>
          [!ENDIF!][!//
          [!IF "num:i($Channel) = '11'"!][!//
            <BSW-MODULE-ENTRY-REF-CONDITIONAL>
              <BSW-MODULE-ENTRY-REF DEST="BSW-MODULE-ENTRY">/Cdd_Pwm_TI_AM263x/Cdd_Pwm_ModuleEntry/Cdd_Pwm_G0_TzCh11Isr</BSW-MODULE-ENTRY-REF>
            </BSW-MODULE-ENTRY-REF-CONDITIONAL>
          [!ENDIF!][!//
          [!IF "num:i($Channel) = '12'"!][!//
            <BSW-MODULE-ENTRY-REF-CONDITIONAL>
              <BSW-MODULE-ENTRY-REF DEST="BSW-MODULE-ENTRY">/Cdd_Pwm_TI_AM263x/Cdd_Pwm_ModuleEntry/Cdd_Pwm_G0_TzCh12Isr</BSW-MODULE-ENTRY-REF>
            </BSW-MODULE-ENTRY-REF-CONDITIONAL>
          [!ENDIF!][!//
          [!IF "num:i($Channel) = '13'"!][!//
            <BSW-MODULE-ENTRY-REF-CONDITIONAL>
              <BSW-MODULE-ENTRY-REF DEST="BSW-MODULE-ENTRY">/Cdd_Pwm_TI_AM263x/Cdd_Pwm_ModuleEntry/Cdd_Pwm_G0_TzCh13Isr</BSW-MODULE-ENTRY-REF>
            </BSW-MODULE-ENTRY-REF-CONDITIONAL>
          [!ENDIF!][!//
          [!IF "num:i($Channel) = '14'"!][!//
            <BSW-MODULE-ENTRY-REF-CONDITIONAL>
              <BSW-MODULE-ENTRY-REF DEST="BSW-MODULE-ENTRY">/Cdd_Pwm_TI_AM263x/Cdd_Pwm_ModuleEntry/Cdd_Pwm_G0_TzCh14Isr</BSW-MODULE-ENTRY-REF>
            </BSW-MODULE-ENTRY-REF-CONDITIONAL>
          [!ENDIF!][!//
          [!IF "num:i($Channel) = '15'"!][!//
            <BSW-MODULE-ENTRY-REF-CONDITIONAL>
              <BSW-MODULE-ENTRY-REF DEST="BSW-MODULE-ENTRY">/Cdd_Pwm_TI_AM263x/Cdd_Pwm_ModuleEntry/Cdd_Pwm_G0_TzCh15Isr</BSW-MODULE-ENTRY-REF>
            </BSW-MODULE-ENTRY-REF-CONDITIONAL>
          [!ENDIF!][!//
          [!IF "num:i($Channel) = '16'"!][!//
            <BSW-MODULE-ENTRY-REF-CONDITIONAL>
              <BSW-MODULE-ENTRY-REF DEST="BSW-MODULE-ENTRY">/Cdd_Pwm_TI_AM263x/Cdd_Pwm_ModuleEntry/Cdd_Pwm_G0_TzCh16Isr</BSW-MODULE-ENTRY-REF>
            </BSW-MODULE-ENTRY-REF-CONDITIONAL>
          [!ENDIF!][!//
          [!IF "num:i($Channel) = '17'"!][!//
            <BSW-MODULE-ENTRY-REF-CONDITIONAL>
              <BSW-MODULE-ENTRY-REF DEST="BSW-MODULE-ENTRY">/Cdd_Pwm_TI_AM263x/Cdd_Pwm_ModuleEntry/Cdd_Pwm_G0_TzCh17Isr</BSW-MODULE-ENTRY-REF>
            </BSW-MODULE-ENTRY-REF-CONDITIONAL>
          [!ENDIF!][!//
          [!IF "num:i($Channel) = '18'"!][!//
            <BSW-MODULE-ENTRY-REF-CONDITIONAL>
              <BSW-MODULE-ENTRY-REF DEST="BSW-MODULE-ENTRY">/Cdd_Pwm_TI_AM263x/Cdd_Pwm_ModuleEntry/Cdd_Pwm_G0_TzCh18Isr</BSW-MODULE-ENTRY-REF>
            </BSW-MODULE-ENTRY-REF-CONDITIONAL>
          [!ENDIF!][!//
          [!IF "num:i($Channel) = '19'"!][!//
            <BSW-MODULE-ENTRY-REF-CONDITIONAL>
              <BSW-MODULE-ENTRY-REF DEST="BSW-MODULE-ENTRY">/Cdd_Pwm_TI_AM263x/Cdd_Pwm_ModuleEntry/Cdd_Pwm_G0_TzCh19Isr</BSW-MODULE-ENTRY-REF>
            </BSW-MODULE-ENTRY-REF-CONDITIONAL>
          [!ENDIF!][!//
          [!IF "num:i($Channel) = '1'"!][!//
            <BSW-MODULE-ENTRY-REF-CONDITIONAL>
              <BSW-MODULE-ENTRY-REF DEST="BSW-MODULE-ENTRY">/Cdd_Pwm_TI_AM263x/Cdd_Pwm_ModuleEntry/Cdd_Pwm_G0_TzCh1Isr</BSW-MODULE-ENTRY-REF>
            </BSW-MODULE-ENTRY-REF-CONDITIONAL>
          [!ENDIF!][!//
          [!IF "num:i($Channel) = '20'"!][!//
            <BSW-MODULE-ENTRY-REF-CONDITIONAL>
              <BSW-MODULE-ENTRY-REF DEST="BSW-MODULE-ENTRY">/Cdd_Pwm_TI_AM263x/Cdd_Pwm_ModuleEntry/Cdd_Pwm_G0_TzCh20Isr</BSW-MODULE-ENTRY-REF>
            </BSW-MODULE-ENTRY-REF-CONDITIONAL>
          [!ENDIF!][!//
          [!IF "num:i($Channel) = '21'"!][!//
            <BSW-MODULE-ENTRY-REF-CONDITIONAL>
              <BSW-MODULE-ENTRY-REF DEST="BSW-MODULE-ENTRY">/Cdd_Pwm_TI_AM263x/Cdd_Pwm_ModuleEntry/Cdd_Pwm_G0_TzCh21Isr</BSW-MODULE-ENTRY-REF>
            </BSW-MODULE-ENTRY-REF-CONDITIONAL>
          [!ENDIF!][!//
          [!IF "num:i($Channel) = '22'"!][!//
            <BSW-MODULE-ENTRY-REF-CONDITIONAL>
              <BSW-MODULE-ENTRY-REF DEST="BSW-MODULE-ENTRY">/Cdd_Pwm_TI_AM263x/Cdd_Pwm_ModuleEntry/Cdd_Pwm_G0_TzCh22Isr</BSW-MODULE-ENTRY-REF>
            </BSW-MODULE-ENTRY-REF-CONDITIONAL>
          [!ENDIF!][!//
          [!IF "num:i($Channel) = '23'"!][!//
            <BSW-MODULE-ENTRY-REF-CONDITIONAL>
              <BSW-MODULE-ENTRY-REF DEST="BSW-MODULE-ENTRY">/Cdd_Pwm_TI_AM263x/Cdd_Pwm_ModuleEntry/Cdd_Pwm_G0_TzCh23Isr</BSW-MODULE-ENTRY-REF>
            </BSW-MODULE-ENTRY-REF-CONDITIONAL>
          [!ENDIF!][!//
          [!IF "num:i($Channel) = '24'"!][!//
            <BSW-MODULE-ENTRY-REF-CONDITIONAL>
              <BSW-MODULE-ENTRY-REF DEST="BSW-MODULE-ENTRY">/Cdd_Pwm_TI_AM263x/Cdd_Pwm_ModuleEntry/Cdd_Pwm_G0_TzCh24Isr</BSW-MODULE-ENTRY-REF>
            </BSW-MODULE-ENTRY-REF-CONDITIONAL>
          [!ENDIF!][!//
          [!IF "num:i($Channel) = '25'"!][!//
            <BSW-MODULE-ENTRY-REF-CONDITIONAL>
              <BSW-MODULE-ENTRY-REF DEST="BSW-MODULE-ENTRY">/Cdd_Pwm_TI_AM263x/Cdd_Pwm_ModuleEntry/Cdd_Pwm_G0_TzCh25Isr</BSW-MODULE-ENTRY-REF>
            </BSW-MODULE-ENTRY-REF-CONDITIONAL>
          [!ENDIF!][!//
          [!IF "num:i($Channel) = '26'"!][!//
            <BSW-MODULE-ENTRY-REF-CONDITIONAL>
              <BSW-MODULE-ENTRY-REF DEST="BSW-MODULE-ENTRY">/Cdd_Pwm_TI_AM263x/Cdd_Pwm_ModuleEntry/Cdd_Pwm_G0_TzCh26Isr</BSW-MODULE-ENTRY-REF>
            </BSW-MODULE-ENTRY-REF-CONDITIONAL>
          [!ENDIF!][!//
          [!IF "num:i($Channel) = '27'"!][!//
            <BSW-MODULE-ENTRY-REF-CONDITIONAL>
              <BSW-MODULE-ENTRY-REF DEST="BSW-MODULE-ENTRY">/Cdd_Pwm_TI_AM263x/Cdd_Pwm_ModuleEntry/Cdd_Pwm_G0_TzCh27Isr</BSW-MODULE-ENTRY-REF>
            </BSW-MODULE-ENTRY-REF-CONDITIONAL>
          [!ENDIF!][!//
          [!IF "num:i($Channel) = '28'"!][!//
            <BSW-MODULE-ENTRY-REF-CONDITIONAL>
              <BSW-MODULE-ENTRY-REF DEST="BSW-MODULE-ENTRY">/Cdd_Pwm_TI_AM263x/Cdd_Pwm_ModuleEntry/Cdd_Pwm_G0_TzCh28Isr</BSW-MODULE-ENTRY-REF>
            </BSW-MODULE-ENTRY-REF-CONDITIONAL>
          [!ENDIF!][!//
          [!IF "num:i($Channel) = '29'"!][!//
            <BSW-MODULE-ENTRY-REF-CONDITIONAL>
              <BSW-MODULE-ENTRY-REF DEST="BSW-MODULE-ENTRY">/Cdd_Pwm_TI_AM263x/Cdd_Pwm_ModuleEntry/Cdd_Pwm_G0_TzCh29Isr</BSW-MODULE-ENTRY-REF>
            </BSW-MODULE-ENTRY-REF-CONDITIONAL>
          [!ENDIF!][!//
          [!IF "num:i($Channel) = '2'"!][!//
            <BSW-MODULE-ENTRY-REF-CONDITIONAL>
              <BSW-MODULE-ENTRY-REF DEST="BSW-MODULE-ENTRY">/Cdd_Pwm_TI_AM263x/Cdd_Pwm_ModuleEntry/Cdd_Pwm_G0_TzCh2Isr</BSW-MODULE-ENTRY-REF>
            </BSW-MODULE-ENTRY-REF-CONDITIONAL>
          [!ENDIF!][!//
          [!IF "num:i($Channel) = '30'"!][!//
            <BSW-MODULE-ENTRY-REF-CONDITIONAL>
              <BSW-MODULE-ENTRY-REF DEST="BSW-MODULE-ENTRY">/Cdd_Pwm_TI_AM263x/Cdd_Pwm_ModuleEntry/Cdd_Pwm_G0_TzCh30Isr</BSW-MODULE-ENTRY-REF>
            </BSW-MODULE-ENTRY-REF-CONDITIONAL>
          [!ENDIF!][!//
          [!IF "num:i($Channel) = '31'"!][!//
            <BSW-MODULE-ENTRY-REF-CONDITIONAL>
              <BSW-MODULE-ENTRY-REF DEST="BSW-MODULE-ENTRY">/Cdd_Pwm_TI_AM263x/Cdd_Pwm_ModuleEntry/Cdd_Pwm_G0_TzCh31Isr</BSW-MODULE-ENTRY-REF>
            </BSW-MODULE-ENTRY-REF-CONDITIONAL>
          [!ENDIF!][!//
          [!IF "num:i($Channel) = '3'"!][!//
            <BSW-MODULE-ENTRY-REF-CONDITIONAL>
              <BSW-MODULE-ENTRY-REF DEST="BSW-MODULE-ENTRY">/Cdd_Pwm_TI_AM263x/Cdd_Pwm_ModuleEntry/Cdd_Pwm_G0_TzCh3Isr</BSW-MODULE-ENTRY-REF>
            </BSW-MODULE-ENTRY-REF-CONDITIONAL>
          [!ENDIF!][!//
          [!IF "num:i($Channel) = '4'"!][!//
            <BSW-MODULE-ENTRY-REF-CONDITIONAL>
              <BSW-MODULE-ENTRY-REF DEST="BSW-MODULE-ENTRY">/Cdd_Pwm_TI_AM263x/Cdd_Pwm_ModuleEntry/Cdd_Pwm_G0_TzCh4Isr</BSW-MODULE-ENTRY-REF>
            </BSW-MODULE-ENTRY-REF-CONDITIONAL>
          [!ENDIF!][!//
          [!IF "num:i($Channel) = '5'"!][!//
            <BSW-MODULE-ENTRY-REF-CONDITIONAL>
              <BSW-MODULE-ENTRY-REF DEST="BSW-MODULE-ENTRY">/Cdd_Pwm_TI_AM263x/Cdd_Pwm_ModuleEntry/Cdd_Pwm_G0_TzCh5Isr</BSW-MODULE-ENTRY-REF>
            </BSW-MODULE-ENTRY-REF-CONDITIONAL>
          [!ENDIF!][!//
          [!IF "num:i($Channel) = '6'"!][!//
            <BSW-MODULE-ENTRY-REF-CONDITIONAL>
              <BSW-MODULE-ENTRY-REF DEST="BSW-MODULE-ENTRY">/Cdd_Pwm_TI_AM263x/Cdd_Pwm_ModuleEntry/Cdd_Pwm_G0_TzCh6Isr</BSW-MODULE-ENTRY-REF>
            </BSW-MODULE-ENTRY-REF-CONDITIONAL>
          [!ENDIF!][!//
          [!IF "num:i($Channel) = '7'"!][!//
            <BSW-MODULE-ENTRY-REF-CONDITIONAL>
              <BSW-MODULE-ENTRY-REF DEST="BSW-MODULE-ENTRY">/Cdd_Pwm_TI_AM263x/Cdd_Pwm_ModuleEntry/Cdd_Pwm_G0_TzCh7Isr</BSW-MODULE-ENTRY-REF>
            </BSW-MODULE-ENTRY-REF-CONDITIONAL>
          [!ENDIF!][!//
          [!IF "num:i($Channel) = '8'"!][!//
            <BSW-MODULE-ENTRY-REF-CONDITIONAL>
              <BSW-MODULE-ENTRY-REF DEST="BSW-MODULE-ENTRY">/Cdd_Pwm_TI_AM263x/Cdd_Pwm_ModuleEntry/Cdd_Pwm_G0_TzCh8Isr</BSW-MODULE-ENTRY-REF>
            </BSW-MODULE-ENTRY-REF-CONDITIONAL>
          [!ENDIF!][!//
          [!IF "num:i($Channel) = '9'"!][!//
            <BSW-MODULE-ENTRY-REF-CONDITIONAL>
              <BSW-MODULE-ENTRY-REF DEST="BSW-MODULE-ENTRY">/Cdd_Pwm_TI_AM263x/Cdd_Pwm_ModuleEntry/Cdd_Pwm_G0_TzCh9Isr</BSW-MODULE-ENTRY-REF>
            </BSW-MODULE-ENTRY-REF-CONDITIONAL>
          [!ENDIF!][!//
          [!ELSEIF "num:i($Group) = '1'"!][!//
          [!IF "num:i($Channel) = '0'"!][!//
            <BSW-MODULE-ENTRY-REF-CONDITIONAL>
              <BSW-MODULE-ENTRY-REF DEST="BSW-MODULE-ENTRY">/Cdd_Pwm_TI_AM263x/Cdd_Pwm_ModuleEntry/Cdd_Pwm_G1_Ch0Isr</BSW-MODULE-ENTRY-REF>
            </BSW-MODULE-ENTRY-REF-CONDITIONAL>
          [!ENDIF!][!//
          [!IF "num:i($Channel) = '10'"!][!//
            <BSW-MODULE-ENTRY-REF-CONDITIONAL>
              <BSW-MODULE-ENTRY-REF DEST="BSW-MODULE-ENTRY">/Cdd_Pwm_TI_AM263x/Cdd_Pwm_ModuleEntry/Cdd_Pwm_G1_Ch10Isr</BSW-MODULE-ENTRY-REF>
            </BSW-MODULE-ENTRY-REF-CONDITIONAL>
          [!ENDIF!][!//
          [!IF "num:i($Channel) = '11'"!][!//
            <BSW-MODULE-ENTRY-REF-CONDITIONAL>
              <BSW-MODULE-ENTRY-REF DEST="BSW-MODULE-ENTRY">/Cdd_Pwm_TI_AM263x/Cdd_Pwm_ModuleEntry/Cdd_Pwm_G1_Ch11Isr</BSW-MODULE-ENTRY-REF>
            </BSW-MODULE-ENTRY-REF-CONDITIONAL>
          [!ENDIF!][!//
          [!IF "num:i($Channel) = '12'"!][!//
            <BSW-MODULE-ENTRY-REF-CONDITIONAL>
              <BSW-MODULE-ENTRY-REF DEST="BSW-MODULE-ENTRY">/Cdd_Pwm_TI_AM263x/Cdd_Pwm_ModuleEntry/Cdd_Pwm_G1_Ch12Isr</BSW-MODULE-ENTRY-REF>
            </BSW-MODULE-ENTRY-REF-CONDITIONAL>
          [!ENDIF!][!//
          [!IF "num:i($Channel) = '13'"!][!//
            <BSW-MODULE-ENTRY-REF-CONDITIONAL>
              <BSW-MODULE-ENTRY-REF DEST="BSW-MODULE-ENTRY">/Cdd_Pwm_TI_AM263x/Cdd_Pwm_ModuleEntry/Cdd_Pwm_G1_Ch13Isr</BSW-MODULE-ENTRY-REF>
            </BSW-MODULE-ENTRY-REF-CONDITIONAL>
          [!ENDIF!][!//
          [!IF "num:i($Channel) = '14'"!][!//
            <BSW-MODULE-ENTRY-REF-CONDITIONAL>
              <BSW-MODULE-ENTRY-REF DEST="BSW-MODULE-ENTRY">/Cdd_Pwm_TI_AM263x/Cdd_Pwm_ModuleEntry/Cdd_Pwm_G1_Ch14Isr</BSW-MODULE-ENTRY-REF>
            </BSW-MODULE-ENTRY-REF-CONDITIONAL>
          [!ENDIF!][!//
          [!IF "num:i($Channel) = '15'"!][!//
            <BSW-MODULE-ENTRY-REF-CONDITIONAL>
              <BSW-MODULE-ENTRY-REF DEST="BSW-MODULE-ENTRY">/Cdd_Pwm_TI_AM263x/Cdd_Pwm_ModuleEntry/Cdd_Pwm_G1_Ch15Isr</BSW-MODULE-ENTRY-REF>
            </BSW-MODULE-ENTRY-REF-CONDITIONAL>
          [!ENDIF!][!//
          [!IF "num:i($Channel) = '16'"!][!//
            <BSW-MODULE-ENTRY-REF-CONDITIONAL>
              <BSW-MODULE-ENTRY-REF DEST="BSW-MODULE-ENTRY">/Cdd_Pwm_TI_AM263x/Cdd_Pwm_ModuleEntry/Cdd_Pwm_G1_Ch16Isr</BSW-MODULE-ENTRY-REF>
            </BSW-MODULE-ENTRY-REF-CONDITIONAL>
          [!ENDIF!][!//
          [!IF "num:i($Channel) = '17'"!][!//
            <BSW-MODULE-ENTRY-REF-CONDITIONAL>
              <BSW-MODULE-ENTRY-REF DEST="BSW-MODULE-ENTRY">/Cdd_Pwm_TI_AM263x/Cdd_Pwm_ModuleEntry/Cdd_Pwm_G1_Ch17Isr</BSW-MODULE-ENTRY-REF>
            </BSW-MODULE-ENTRY-REF-CONDITIONAL>
          [!ENDIF!][!//
          [!IF "num:i($Channel) = '18'"!][!//
            <BSW-MODULE-ENTRY-REF-CONDITIONAL>
              <BSW-MODULE-ENTRY-REF DEST="BSW-MODULE-ENTRY">/Cdd_Pwm_TI_AM263x/Cdd_Pwm_ModuleEntry/Cdd_Pwm_G1_Ch18Isr</BSW-MODULE-ENTRY-REF>
            </BSW-MODULE-ENTRY-REF-CONDITIONAL>
          [!ENDIF!][!//
          [!IF "num:i($Channel) = '19'"!][!//
            <BSW-MODULE-ENTRY-REF-CONDITIONAL>
              <BSW-MODULE-ENTRY-REF DEST="BSW-MODULE-ENTRY">/Cdd_Pwm_TI_AM263x/Cdd_Pwm_ModuleEntry/Cdd_Pwm_G1_Ch19Isr</BSW-MODULE-ENTRY-REF>
            </BSW-MODULE-ENTRY-REF-CONDITIONAL>
          [!ENDIF!][!//
          [!IF "num:i($Channel) = '1'"!][!//
            <BSW-MODULE-ENTRY-REF-CONDITIONAL>
              <BSW-MODULE-ENTRY-REF DEST="BSW-MODULE-ENTRY">/Cdd_Pwm_TI_AM263x/Cdd_Pwm_ModuleEntry/Cdd_Pwm_G1_Ch1Isr</BSW-MODULE-ENTRY-REF>
            </BSW-MODULE-ENTRY-REF-CONDITIONAL>
          [!ENDIF!][!//
          [!IF "num:i($Channel) = '20'"!][!//
            <BSW-MODULE-ENTRY-REF-CONDITIONAL>
              <BSW-MODULE-ENTRY-REF DEST="BSW-MODULE-ENTRY">/Cdd_Pwm_TI_AM263x/Cdd_Pwm_ModuleEntry/Cdd_Pwm_G1_Ch20Isr</BSW-MODULE-ENTRY-REF>
            </BSW-MODULE-ENTRY-REF-CONDITIONAL>
          [!ENDIF!][!//
          [!IF "num:i($Channel) = '21'"!][!//
            <BSW-MODULE-ENTRY-REF-CONDITIONAL>
              <BSW-MODULE-ENTRY-REF DEST="BSW-MODULE-ENTRY">/Cdd_Pwm_TI_AM263x/Cdd_Pwm_ModuleEntry/Cdd_Pwm_G1_Ch21Isr</BSW-MODULE-ENTRY-REF>
            </BSW-MODULE-ENTRY-REF-CONDITIONAL>
          [!ENDIF!][!//
          [!IF "num:i($Channel) = '22'"!][!//
            <BSW-MODULE-ENTRY-REF-CONDITIONAL>
              <BSW-MODULE-ENTRY-REF DEST="BSW-MODULE-ENTRY">/Cdd_Pwm_TI_AM263x/Cdd_Pwm_ModuleEntry/Cdd_Pwm_G1_Ch22Isr</BSW-MODULE-ENTRY-REF>
            </BSW-MODULE-ENTRY-REF-CONDITIONAL>
          [!ENDIF!][!//
          [!IF "num:i($Channel) = '23'"!][!//
            <BSW-MODULE-ENTRY-REF-CONDITIONAL>
              <BSW-MODULE-ENTRY-REF DEST="BSW-MODULE-ENTRY">/Cdd_Pwm_TI_AM263x/Cdd_Pwm_ModuleEntry/Cdd_Pwm_G1_Ch23Isr</BSW-MODULE-ENTRY-REF>
            </BSW-MODULE-ENTRY-REF-CONDITIONAL>
          [!ENDIF!][!//
          [!IF "num:i($Channel) = '24'"!][!//
            <BSW-MODULE-ENTRY-REF-CONDITIONAL>
              <BSW-MODULE-ENTRY-REF DEST="BSW-MODULE-ENTRY">/Cdd_Pwm_TI_AM263x/Cdd_Pwm_ModuleEntry/Cdd_Pwm_G1_Ch24Isr</BSW-MODULE-ENTRY-REF>
            </BSW-MODULE-ENTRY-REF-CONDITIONAL>
          [!ENDIF!][!//
          [!IF "num:i($Channel) = '25'"!][!//
            <BSW-MODULE-ENTRY-REF-CONDITIONAL>
              <BSW-MODULE-ENTRY-REF DEST="BSW-MODULE-ENTRY">/Cdd_Pwm_TI_AM263x/Cdd_Pwm_ModuleEntry/Cdd_Pwm_G1_Ch25Isr</BSW-MODULE-ENTRY-REF>
            </BSW-MODULE-ENTRY-REF-CONDITIONAL>
          [!ENDIF!][!//
          [!IF "num:i($Channel) = '26'"!][!//
            <BSW-MODULE-ENTRY-REF-CONDITIONAL>
              <BSW-MODULE-ENTRY-REF DEST="BSW-MODULE-ENTRY">/Cdd_Pwm_TI_AM263x/Cdd_Pwm_ModuleEntry/Cdd_Pwm_G1_Ch26Isr</BSW-MODULE-ENTRY-REF>
            </BSW-MODULE-ENTRY-REF-CONDITIONAL>
          [!ENDIF!][!//
          [!IF "num:i($Channel) = '27'"!][!//
            <BSW-MODULE-ENTRY-REF-CONDITIONAL>
              <BSW-MODULE-ENTRY-REF DEST="BSW-MODULE-ENTRY">/Cdd_Pwm_TI_AM263x/Cdd_Pwm_ModuleEntry/Cdd_Pwm_G1_Ch27Isr</BSW-MODULE-ENTRY-REF>
            </BSW-MODULE-ENTRY-REF-CONDITIONAL>
          [!ENDIF!][!//
          [!IF "num:i($Channel) = '28'"!][!//
            <BSW-MODULE-ENTRY-REF-CONDITIONAL>
              <BSW-MODULE-ENTRY-REF DEST="BSW-MODULE-ENTRY">/Cdd_Pwm_TI_AM263x/Cdd_Pwm_ModuleEntry/Cdd_Pwm_G1_Ch28Isr</BSW-MODULE-ENTRY-REF>
            </BSW-MODULE-ENTRY-REF-CONDITIONAL>
          [!ENDIF!][!//
          [!IF "num:i($Channel) = '29'"!][!//
            <BSW-MODULE-ENTRY-REF-CONDITIONAL>
              <BSW-MODULE-ENTRY-REF DEST="BSW-MODULE-ENTRY">/Cdd_Pwm_TI_AM263x/Cdd_Pwm_ModuleEntry/Cdd_Pwm_G1_Ch29Isr</BSW-MODULE-ENTRY-REF>
            </BSW-MODULE-ENTRY-REF-CONDITIONAL>
          [!ENDIF!][!//
          [!IF "num:i($Channel) = '2'"!][!//
            <BSW-MODULE-ENTRY-REF-CONDITIONAL>
              <BSW-MODULE-ENTRY-REF DEST="BSW-MODULE-ENTRY">/Cdd_Pwm_TI_AM263x/Cdd_Pwm_ModuleEntry/Cdd_Pwm_G1_Ch2Isr</BSW-MODULE-ENTRY-REF>
            </BSW-MODULE-ENTRY-REF-CONDITIONAL>
          [!ENDIF!][!//
          [!IF "num:i($Channel) = '30'"!][!//
            <BSW-MODULE-ENTRY-REF-CONDITIONAL>
              <BSW-MODULE-ENTRY-REF DEST="BSW-MODULE-ENTRY">/Cdd_Pwm_TI_AM263x/Cdd_Pwm_ModuleEntry/Cdd_Pwm_G1_Ch30Isr</BSW-MODULE-ENTRY-REF>
            </BSW-MODULE-ENTRY-REF-CONDITIONAL>
          [!ENDIF!][!//
          [!IF "num:i($Channel) = '31'"!][!//
            <BSW-MODULE-ENTRY-REF-CONDITIONAL>
              <BSW-MODULE-ENTRY-REF DEST="BSW-MODULE-ENTRY">/Cdd_Pwm_TI_AM263x/Cdd_Pwm_ModuleEntry/Cdd_Pwm_G1_Ch31Isr</BSW-MODULE-ENTRY-REF>
            </BSW-MODULE-ENTRY-REF-CONDITIONAL>
          [!ENDIF!][!//
          [!IF "num:i($Channel) = '3'"!][!//
            <BSW-MODULE-ENTRY-REF-CONDITIONAL>
              <BSW-MODULE-ENTRY-REF DEST="BSW-MODULE-ENTRY">/Cdd_Pwm_TI_AM263x/Cdd_Pwm_ModuleEntry/Cdd_Pwm_G1_Ch3Isr</BSW-MODULE-ENTRY-REF>
            </BSW-MODULE-ENTRY-REF-CONDITIONAL>
          [!ENDIF!][!//
          [!IF "num:i($Channel) = '4'"!][!//
            <BSW-MODULE-ENTRY-REF-CONDITIONAL>
              <BSW-MODULE-ENTRY-REF DEST="BSW-MODULE-ENTRY">/Cdd_Pwm_TI_AM263x/Cdd_Pwm_ModuleEntry/Cdd_Pwm_G1_Ch4Isr</BSW-MODULE-ENTRY-REF>
            </BSW-MODULE-ENTRY-REF-CONDITIONAL>
          [!ENDIF!][!//
          [!IF "num:i($Channel) = '5'"!][!//
            <BSW-MODULE-ENTRY-REF-CONDITIONAL>
              <BSW-MODULE-ENTRY-REF DEST="BSW-MODULE-ENTRY">/Cdd_Pwm_TI_AM263x/Cdd_Pwm_ModuleEntry/Cdd_Pwm_G1_Ch5Isr</BSW-MODULE-ENTRY-REF>
            </BSW-MODULE-ENTRY-REF-CONDITIONAL>
          [!ENDIF!][!//
          [!IF "num:i($Channel) = '6'"!][!//
            <BSW-MODULE-ENTRY-REF-CONDITIONAL>
              <BSW-MODULE-ENTRY-REF DEST="BSW-MODULE-ENTRY">/Cdd_Pwm_TI_AM263x/Cdd_Pwm_ModuleEntry/Cdd_Pwm_G1_Ch6Isr</BSW-MODULE-ENTRY-REF>
            </BSW-MODULE-ENTRY-REF-CONDITIONAL>
          [!ENDIF!][!//
          [!IF "num:i($Channel) = '7'"!][!//
            <BSW-MODULE-ENTRY-REF-CONDITIONAL>
              <BSW-MODULE-ENTRY-REF DEST="BSW-MODULE-ENTRY">/Cdd_Pwm_TI_AM263x/Cdd_Pwm_ModuleEntry/Cdd_Pwm_G1_Ch7Isr</BSW-MODULE-ENTRY-REF>
            </BSW-MODULE-ENTRY-REF-CONDITIONAL>
          [!ENDIF!][!//
          [!IF "num:i($Channel) = '8'"!][!//
            <BSW-MODULE-ENTRY-REF-CONDITIONAL>
              <BSW-MODULE-ENTRY-REF DEST="BSW-MODULE-ENTRY">/Cdd_Pwm_TI_AM263x/Cdd_Pwm_ModuleEntry/Cdd_Pwm_G1_Ch8Isr</BSW-MODULE-ENTRY-REF>
            </BSW-MODULE-ENTRY-REF-CONDITIONAL>
          [!ENDIF!][!//
          [!IF "num:i($Channel) = '9'"!][!//
            <BSW-MODULE-ENTRY-REF-CONDITIONAL>
              <BSW-MODULE-ENTRY-REF DEST="BSW-MODULE-ENTRY">/Cdd_Pwm_TI_AM263x/Cdd_Pwm_ModuleEntry/Cdd_Pwm_G1_Ch9Isr</BSW-MODULE-ENTRY-REF>
            </BSW-MODULE-ENTRY-REF-CONDITIONAL>
          [!ENDIF!][!//
          [!IF "num:i($Channel) = '0'"!][!//
            <BSW-MODULE-ENTRY-REF-CONDITIONAL>
              <BSW-MODULE-ENTRY-REF DEST="BSW-MODULE-ENTRY">/Cdd_Pwm_TI_AM263x/Cdd_Pwm_ModuleEntry/Cdd_Pwm_G1_TzCh0Isr</BSW-MODULE-ENTRY-REF>
            </BSW-MODULE-ENTRY-REF-CONDITIONAL>
          [!ENDIF!][!//
          [!IF "num:i($Channel) = '10'"!][!//
            <BSW-MODULE-ENTRY-REF-CONDITIONAL>
              <BSW-MODULE-ENTRY-REF DEST="BSW-MODULE-ENTRY">/Cdd_Pwm_TI_AM263x/Cdd_Pwm_ModuleEntry/Cdd_Pwm_G1_TzCh10Isr</BSW-MODULE-ENTRY-REF>
            </BSW-MODULE-ENTRY-REF-CONDITIONAL>
          [!ENDIF!][!//
          [!IF "num:i($Channel) = '11'"!][!//
            <BSW-MODULE-ENTRY-REF-CONDITIONAL>
              <BSW-MODULE-ENTRY-REF DEST="BSW-MODULE-ENTRY">/Cdd_Pwm_TI_AM263x/Cdd_Pwm_ModuleEntry/Cdd_Pwm_G1_TzCh11Isr</BSW-MODULE-ENTRY-REF>
            </BSW-MODULE-ENTRY-REF-CONDITIONAL>
          [!ENDIF!][!//
          [!IF "num:i($Channel) = '12'"!][!//
            <BSW-MODULE-ENTRY-REF-CONDITIONAL>
              <BSW-MODULE-ENTRY-REF DEST="BSW-MODULE-ENTRY">/Cdd_Pwm_TI_AM263x/Cdd_Pwm_ModuleEntry/Cdd_Pwm_G1_TzCh12Isr</BSW-MODULE-ENTRY-REF>
            </BSW-MODULE-ENTRY-REF-CONDITIONAL>
          [!ENDIF!][!//
          [!IF "num:i($Channel) = '13'"!][!//
            <BSW-MODULE-ENTRY-REF-CONDITIONAL>
              <BSW-MODULE-ENTRY-REF DEST="BSW-MODULE-ENTRY">/Cdd_Pwm_TI_AM263x/Cdd_Pwm_ModuleEntry/Cdd_Pwm_G1_TzCh13Isr</BSW-MODULE-ENTRY-REF>
            </BSW-MODULE-ENTRY-REF-CONDITIONAL>
          [!ENDIF!][!//
          [!IF "num:i($Channel) = '14'"!][!//
            <BSW-MODULE-ENTRY-REF-CONDITIONAL>
              <BSW-MODULE-ENTRY-REF DEST="BSW-MODULE-ENTRY">/Cdd_Pwm_TI_AM263x/Cdd_Pwm_ModuleEntry/Cdd_Pwm_G1_TzCh14Isr</BSW-MODULE-ENTRY-REF>
            </BSW-MODULE-ENTRY-REF-CONDITIONAL>
          [!ENDIF!][!//
          [!IF "num:i($Channel) = '15'"!][!//
            <BSW-MODULE-ENTRY-REF-CONDITIONAL>
              <BSW-MODULE-ENTRY-REF DEST="BSW-MODULE-ENTRY">/Cdd_Pwm_TI_AM263x/Cdd_Pwm_ModuleEntry/Cdd_Pwm_G1_TzCh15Isr</BSW-MODULE-ENTRY-REF>
            </BSW-MODULE-ENTRY-REF-CONDITIONAL>
          [!ENDIF!][!//
          [!IF "num:i($Channel) = '16'"!][!//
            <BSW-MODULE-ENTRY-REF-CONDITIONAL>
              <BSW-MODULE-ENTRY-REF DEST="BSW-MODULE-ENTRY">/Cdd_Pwm_TI_AM263x/Cdd_Pwm_ModuleEntry/Cdd_Pwm_G1_TzCh16Isr</BSW-MODULE-ENTRY-REF>
            </BSW-MODULE-ENTRY-REF-CONDITIONAL>
          [!ENDIF!][!//
          [!IF "num:i($Channel) = '17'"!][!//
            <BSW-MODULE-ENTRY-REF-CONDITIONAL>
              <BSW-MODULE-ENTRY-REF DEST="BSW-MODULE-ENTRY">/Cdd_Pwm_TI_AM263x/Cdd_Pwm_ModuleEntry/Cdd_Pwm_G1_TzCh17Isr</BSW-MODULE-ENTRY-REF>
            </BSW-MODULE-ENTRY-REF-CONDITIONAL>
          [!ENDIF!][!//
          [!IF "num:i($Channel) = '18'"!][!//
            <BSW-MODULE-ENTRY-REF-CONDITIONAL>
              <BSW-MODULE-ENTRY-REF DEST="BSW-MODULE-ENTRY">/Cdd_Pwm_TI_AM263x/Cdd_Pwm_ModuleEntry/Cdd_Pwm_G1_TzCh18Isr</BSW-MODULE-ENTRY-REF>
            </BSW-MODULE-ENTRY-REF-CONDITIONAL>
          [!ENDIF!][!//
          [!IF "num:i($Channel) = '19'"!][!//
            <BSW-MODULE-ENTRY-REF-CONDITIONAL>
              <BSW-MODULE-ENTRY-REF DEST="BSW-MODULE-ENTRY">/Cdd_Pwm_TI_AM263x/Cdd_Pwm_ModuleEntry/Cdd_Pwm_G1_TzCh19Isr</BSW-MODULE-ENTRY-REF>
            </BSW-MODULE-ENTRY-REF-CONDITIONAL>
          [!ENDIF!][!//
          [!IF "num:i($Channel) = '1'"!][!//
            <BSW-MODULE-ENTRY-REF-CONDITIONAL>
              <BSW-MODULE-ENTRY-REF DEST="BSW-MODULE-ENTRY">/Cdd_Pwm_TI_AM263x/Cdd_Pwm_ModuleEntry/Cdd_Pwm_G1_TzCh1Isr</BSW-MODULE-ENTRY-REF>
            </BSW-MODULE-ENTRY-REF-CONDITIONAL>
          [!ENDIF!][!//
          [!IF "num:i($Channel) = '20'"!][!//
            <BSW-MODULE-ENTRY-REF-CONDITIONAL>
              <BSW-MODULE-ENTRY-REF DEST="BSW-MODULE-ENTRY">/Cdd_Pwm_TI_AM263x/Cdd_Pwm_ModuleEntry/Cdd_Pwm_G1_TzCh20Isr</BSW-MODULE-ENTRY-REF>
            </BSW-MODULE-ENTRY-REF-CONDITIONAL>
          [!ENDIF!][!//
          [!IF "num:i($Channel) = '21'"!][!//
            <BSW-MODULE-ENTRY-REF-CONDITIONAL>
              <BSW-MODULE-ENTRY-REF DEST="BSW-MODULE-ENTRY">/Cdd_Pwm_TI_AM263x/Cdd_Pwm_ModuleEntry/Cdd_Pwm_G1_TzCh21Isr</BSW-MODULE-ENTRY-REF>
            </BSW-MODULE-ENTRY-REF-CONDITIONAL>
          [!ENDIF!][!//
          [!IF "num:i($Channel) = '22'"!][!//
            <BSW-MODULE-ENTRY-REF-CONDITIONAL>
              <BSW-MODULE-ENTRY-REF DEST="BSW-MODULE-ENTRY">/Cdd_Pwm_TI_AM263x/Cdd_Pwm_ModuleEntry/Cdd_Pwm_G1_TzCh22Isr</BSW-MODULE-ENTRY-REF>
            </BSW-MODULE-ENTRY-REF-CONDITIONAL>
          [!ENDIF!][!//
          [!IF "num:i($Channel) = '23'"!][!//
            <BSW-MODULE-ENTRY-REF-CONDITIONAL>
              <BSW-MODULE-ENTRY-REF DEST="BSW-MODULE-ENTRY">/Cdd_Pwm_TI_AM263x/Cdd_Pwm_ModuleEntry/Cdd_Pwm_G1_TzCh23Isr</BSW-MODULE-ENTRY-REF>
            </BSW-MODULE-ENTRY-REF-CONDITIONAL>
          [!ENDIF!][!//
          [!IF "num:i($Channel) = '24'"!][!//
            <BSW-MODULE-ENTRY-REF-CONDITIONAL>
              <BSW-MODULE-ENTRY-REF DEST="BSW-MODULE-ENTRY">/Cdd_Pwm_TI_AM263x/Cdd_Pwm_ModuleEntry/Cdd_Pwm_G1_TzCh24Isr</BSW-MODULE-ENTRY-REF>
            </BSW-MODULE-ENTRY-REF-CONDITIONAL>
          [!ENDIF!][!//
          [!IF "num:i($Channel) = '25'"!][!//
            <BSW-MODULE-ENTRY-REF-CONDITIONAL>
              <BSW-MODULE-ENTRY-REF DEST="BSW-MODULE-ENTRY">/Cdd_Pwm_TI_AM263x/Cdd_Pwm_ModuleEntry/Cdd_Pwm_G1_TzCh25Isr</BSW-MODULE-ENTRY-REF>
            </BSW-MODULE-ENTRY-REF-CONDITIONAL>
          [!ENDIF!][!//
          [!IF "num:i($Channel) = '26'"!][!//
            <BSW-MODULE-ENTRY-REF-CONDITIONAL>
              <BSW-MODULE-ENTRY-REF DEST="BSW-MODULE-ENTRY">/Cdd_Pwm_TI_AM263x/Cdd_Pwm_ModuleEntry/Cdd_Pwm_G1_TzCh26Isr</BSW-MODULE-ENTRY-REF>
            </BSW-MODULE-ENTRY-REF-CONDITIONAL>
          [!ENDIF!][!//
          [!IF "num:i($Channel) = '27'"!][!//
            <BSW-MODULE-ENTRY-REF-CONDITIONAL>
              <BSW-MODULE-ENTRY-REF DEST="BSW-MODULE-ENTRY">/Cdd_Pwm_TI_AM263x/Cdd_Pwm_ModuleEntry/Cdd_Pwm_G1_TzCh27Isr</BSW-MODULE-ENTRY-REF>
            </BSW-MODULE-ENTRY-REF-CONDITIONAL>
          [!ENDIF!][!//
          [!IF "num:i($Channel) = '28'"!][!//
            <BSW-MODULE-ENTRY-REF-CONDITIONAL>
              <BSW-MODULE-ENTRY-REF DEST="BSW-MODULE-ENTRY">/Cdd_Pwm_TI_AM263x/Cdd_Pwm_ModuleEntry/Cdd_Pwm_G1_TzCh28Isr</BSW-MODULE-ENTRY-REF>
            </BSW-MODULE-ENTRY-REF-CONDITIONAL>
          [!ENDIF!][!//
          [!IF "num:i($Channel) = '29'"!][!//
            <BSW-MODULE-ENTRY-REF-CONDITIONAL>
              <BSW-MODULE-ENTRY-REF DEST="BSW-MODULE-ENTRY">/Cdd_Pwm_TI_AM263x/Cdd_Pwm_ModuleEntry/Cdd_Pwm_G1_TzCh29Isr</BSW-MODULE-ENTRY-REF>
            </BSW-MODULE-ENTRY-REF-CONDITIONAL>
          [!ENDIF!][!//
          [!IF "num:i($Channel) = '2'"!][!//
            <BSW-MODULE-ENTRY-REF-CONDITIONAL>
              <BSW-MODULE-ENTRY-REF DEST="BSW-MODULE-ENTRY">/Cdd_Pwm_TI_AM263x/Cdd_Pwm_ModuleEntry/Cdd_Pwm_G1_TzCh2Isr</BSW-MODULE-ENTRY-REF>
            </BSW-MODULE-ENTRY-REF-CONDITIONAL>
          [!ENDIF!][!//
          [!IF "num:i($Channel) = '30'"!][!//
            <BSW-MODULE-ENTRY-REF-CONDITIONAL>
              <BSW-MODULE-ENTRY-REF DEST="BSW-MODULE-ENTRY">/Cdd_Pwm_TI_AM263x/Cdd_Pwm_ModuleEntry/Cdd_Pwm_G1_TzCh30Isr</BSW-MODULE-ENTRY-REF>
            </BSW-MODULE-ENTRY-REF-CONDITIONAL>
          [!ENDIF!][!//
          [!IF "num:i($Channel) = '31'"!][!//
            <BSW-MODULE-ENTRY-REF-CONDITIONAL>
              <BSW-MODULE-ENTRY-REF DEST="BSW-MODULE-ENTRY">/Cdd_Pwm_TI_AM263x/Cdd_Pwm_ModuleEntry/Cdd_Pwm_G1_TzCh31Isr</BSW-MODULE-ENTRY-REF>
            </BSW-MODULE-ENTRY-REF-CONDITIONAL>
          [!ENDIF!][!//
          [!IF "num:i($Channel) = '3'"!][!//
            <BSW-MODULE-ENTRY-REF-CONDITIONAL>
              <BSW-MODULE-ENTRY-REF DEST="BSW-MODULE-ENTRY">/Cdd_Pwm_TI_AM263x/Cdd_Pwm_ModuleEntry/Cdd_Pwm_G1_TzCh3Isr</BSW-MODULE-ENTRY-REF>
            </BSW-MODULE-ENTRY-REF-CONDITIONAL>
          [!ENDIF!][!//
          [!IF "num:i($Channel) = '4'"!][!//
            <BSW-MODULE-ENTRY-REF-CONDITIONAL>
              <BSW-MODULE-ENTRY-REF DEST="BSW-MODULE-ENTRY">/Cdd_Pwm_TI_AM263x/Cdd_Pwm_ModuleEntry/Cdd_Pwm_G1_TzCh4Isr</BSW-MODULE-ENTRY-REF>
            </BSW-MODULE-ENTRY-REF-CONDITIONAL>
          [!ENDIF!][!//
          [!IF "num:i($Channel) = '5'"!][!//
            <BSW-MODULE-ENTRY-REF-CONDITIONAL>
              <BSW-MODULE-ENTRY-REF DEST="BSW-MODULE-ENTRY">/Cdd_Pwm_TI_AM263x/Cdd_Pwm_ModuleEntry/Cdd_Pwm_G1_TzCh5Isr</BSW-MODULE-ENTRY-REF>
            </BSW-MODULE-ENTRY-REF-CONDITIONAL>
          [!ENDIF!][!//
          [!IF "num:i($Channel) = '6'"!][!//
            <BSW-MODULE-ENTRY-REF-CONDITIONAL>
              <BSW-MODULE-ENTRY-REF DEST="BSW-MODULE-ENTRY">/Cdd_Pwm_TI_AM263x/Cdd_Pwm_ModuleEntry/Cdd_Pwm_G1_TzCh6Isr</BSW-MODULE-ENTRY-REF>
            </BSW-MODULE-ENTRY-REF-CONDITIONAL>
          [!ENDIF!][!//
          [!IF "num:i($Channel) = '7'"!][!//
            <BSW-MODULE-ENTRY-REF-CONDITIONAL>
              <BSW-MODULE-ENTRY-REF DEST="BSW-MODULE-ENTRY">/Cdd_Pwm_TI_AM263x/Cdd_Pwm_ModuleEntry/Cdd_Pwm_G1_TzCh7Isr</BSW-MODULE-ENTRY-REF>
            </BSW-MODULE-ENTRY-REF-CONDITIONAL>
          [!ENDIF!][!//
          [!IF "num:i($Channel) = '8'"!][!//
            <BSW-MODULE-ENTRY-REF-CONDITIONAL>
              <BSW-MODULE-ENTRY-REF DEST="BSW-MODULE-ENTRY">/Cdd_Pwm_TI_AM263x/Cdd_Pwm_ModuleEntry/Cdd_Pwm_G1_TzCh8Isr</BSW-MODULE-ENTRY-REF>
            </BSW-MODULE-ENTRY-REF-CONDITIONAL>
          [!ENDIF!][!//
          [!IF "num:i($Channel) = '9'"!][!//
            <BSW-MODULE-ENTRY-REF-CONDITIONAL>
              <BSW-MODULE-ENTRY-REF DEST="BSW-MODULE-ENTRY">/Cdd_Pwm_TI_AM263x/Cdd_Pwm_ModuleEntry/Cdd_Pwm_G1_TzCh9Isr</BSW-MODULE-ENTRY-REF>
            </BSW-MODULE-ENTRY-REF-CONDITIONAL>
          [!ENDIF!][!//
          [!ELSEIF "num:i($Group) = '2'"!][!//
          [!IF "num:i($Channel) = '0'"!][!//
            <BSW-MODULE-ENTRY-REF-CONDITIONAL>
              <BSW-MODULE-ENTRY-REF DEST="BSW-MODULE-ENTRY">/Cdd_Pwm_TI_AM263x/Cdd_Pwm_ModuleEntry/Cdd_Pwm_G2_Ch0Isr</BSW-MODULE-ENTRY-REF>
            </BSW-MODULE-ENTRY-REF-CONDITIONAL>
          [!ENDIF!][!//
          [!IF "num:i($Channel) = '10'"!][!//
            <BSW-MODULE-ENTRY-REF-CONDITIONAL>
              <BSW-MODULE-ENTRY-REF DEST="BSW-MODULE-ENTRY">/Cdd_Pwm_TI_AM263x/Cdd_Pwm_ModuleEntry/Cdd_Pwm_G2_Ch10Isr</BSW-MODULE-ENTRY-REF>
            </BSW-MODULE-ENTRY-REF-CONDITIONAL>
          [!ENDIF!][!//
          [!IF "num:i($Channel) = '11'"!][!//
            <BSW-MODULE-ENTRY-REF-CONDITIONAL>
              <BSW-MODULE-ENTRY-REF DEST="BSW-MODULE-ENTRY">/Cdd_Pwm_TI_AM263x/Cdd_Pwm_ModuleEntry/Cdd_Pwm_G2_Ch11Isr</BSW-MODULE-ENTRY-REF>
            </BSW-MODULE-ENTRY-REF-CONDITIONAL>
          [!ENDIF!][!//
          [!IF "num:i($Channel) = '12'"!][!//
            <BSW-MODULE-ENTRY-REF-CONDITIONAL>
              <BSW-MODULE-ENTRY-REF DEST="BSW-MODULE-ENTRY">/Cdd_Pwm_TI_AM263x/Cdd_Pwm_ModuleEntry/Cdd_Pwm_G2_Ch12Isr</BSW-MODULE-ENTRY-REF>
            </BSW-MODULE-ENTRY-REF-CONDITIONAL>
          [!ENDIF!][!//
          [!IF "num:i($Channel) = '13'"!][!//
            <BSW-MODULE-ENTRY-REF-CONDITIONAL>
              <BSW-MODULE-ENTRY-REF DEST="BSW-MODULE-ENTRY">/Cdd_Pwm_TI_AM263x/Cdd_Pwm_ModuleEntry/Cdd_Pwm_G2_Ch13Isr</BSW-MODULE-ENTRY-REF>
            </BSW-MODULE-ENTRY-REF-CONDITIONAL>
          [!ENDIF!][!//
          [!IF "num:i($Channel) = '14'"!][!//
            <BSW-MODULE-ENTRY-REF-CONDITIONAL>
              <BSW-MODULE-ENTRY-REF DEST="BSW-MODULE-ENTRY">/Cdd_Pwm_TI_AM263x/Cdd_Pwm_ModuleEntry/Cdd_Pwm_G2_Ch14Isr</BSW-MODULE-ENTRY-REF>
            </BSW-MODULE-ENTRY-REF-CONDITIONAL>
          [!ENDIF!][!//
          [!IF "num:i($Channel) = '15'"!][!//
            <BSW-MODULE-ENTRY-REF-CONDITIONAL>
              <BSW-MODULE-ENTRY-REF DEST="BSW-MODULE-ENTRY">/Cdd_Pwm_TI_AM263x/Cdd_Pwm_ModuleEntry/Cdd_Pwm_G2_Ch15Isr</BSW-MODULE-ENTRY-REF>
            </BSW-MODULE-ENTRY-REF-CONDITIONAL>
          [!ENDIF!][!//
          [!IF "num:i($Channel) = '16'"!][!//
            <BSW-MODULE-ENTRY-REF-CONDITIONAL>
              <BSW-MODULE-ENTRY-REF DEST="BSW-MODULE-ENTRY">/Cdd_Pwm_TI_AM263x/Cdd_Pwm_ModuleEntry/Cdd_Pwm_G2_Ch16Isr</BSW-MODULE-ENTRY-REF>
            </BSW-MODULE-ENTRY-REF-CONDITIONAL>
          [!ENDIF!][!//
          [!IF "num:i($Channel) = '17'"!][!//
            <BSW-MODULE-ENTRY-REF-CONDITIONAL>
              <BSW-MODULE-ENTRY-REF DEST="BSW-MODULE-ENTRY">/Cdd_Pwm_TI_AM263x/Cdd_Pwm_ModuleEntry/Cdd_Pwm_G2_Ch17Isr</BSW-MODULE-ENTRY-REF>
            </BSW-MODULE-ENTRY-REF-CONDITIONAL>
          [!ENDIF!][!//
          [!IF "num:i($Channel) = '18'"!][!//
            <BSW-MODULE-ENTRY-REF-CONDITIONAL>
              <BSW-MODULE-ENTRY-REF DEST="BSW-MODULE-ENTRY">/Cdd_Pwm_TI_AM263x/Cdd_Pwm_ModuleEntry/Cdd_Pwm_G2_Ch18Isr</BSW-MODULE-ENTRY-REF>
            </BSW-MODULE-ENTRY-REF-CONDITIONAL>
          [!ENDIF!][!//
          [!IF "num:i($Channel) = '19'"!][!//
            <BSW-MODULE-ENTRY-REF-CONDITIONAL>
              <BSW-MODULE-ENTRY-REF DEST="BSW-MODULE-ENTRY">/Cdd_Pwm_TI_AM263x/Cdd_Pwm_ModuleEntry/Cdd_Pwm_G2_Ch19Isr</BSW-MODULE-ENTRY-REF>
            </BSW-MODULE-ENTRY-REF-CONDITIONAL>
          [!ENDIF!][!//
          [!IF "num:i($Channel) = '1'"!][!//
            <BSW-MODULE-ENTRY-REF-CONDITIONAL>
              <BSW-MODULE-ENTRY-REF DEST="BSW-MODULE-ENTRY">/Cdd_Pwm_TI_AM263x/Cdd_Pwm_ModuleEntry/Cdd_Pwm_G2_Ch1Isr</BSW-MODULE-ENTRY-REF>
            </BSW-MODULE-ENTRY-REF-CONDITIONAL>
          [!ENDIF!][!//
          [!IF "num:i($Channel) = '20'"!][!//
            <BSW-MODULE-ENTRY-REF-CONDITIONAL>
              <BSW-MODULE-ENTRY-REF DEST="BSW-MODULE-ENTRY">/Cdd_Pwm_TI_AM263x/Cdd_Pwm_ModuleEntry/Cdd_Pwm_G2_Ch20Isr</BSW-MODULE-ENTRY-REF>
            </BSW-MODULE-ENTRY-REF-CONDITIONAL>
          [!ENDIF!][!//
          [!IF "num:i($Channel) = '21'"!][!//
            <BSW-MODULE-ENTRY-REF-CONDITIONAL>
              <BSW-MODULE-ENTRY-REF DEST="BSW-MODULE-ENTRY">/Cdd_Pwm_TI_AM263x/Cdd_Pwm_ModuleEntry/Cdd_Pwm_G2_Ch21Isr</BSW-MODULE-ENTRY-REF>
            </BSW-MODULE-ENTRY-REF-CONDITIONAL>
          [!ENDIF!][!//
          [!IF "num:i($Channel) = '22'"!][!//
            <BSW-MODULE-ENTRY-REF-CONDITIONAL>
              <BSW-MODULE-ENTRY-REF DEST="BSW-MODULE-ENTRY">/Cdd_Pwm_TI_AM263x/Cdd_Pwm_ModuleEntry/Cdd_Pwm_G2_Ch22Isr</BSW-MODULE-ENTRY-REF>
            </BSW-MODULE-ENTRY-REF-CONDITIONAL>
          [!ENDIF!][!//
          [!IF "num:i($Channel) = '23'"!][!//
            <BSW-MODULE-ENTRY-REF-CONDITIONAL>
              <BSW-MODULE-ENTRY-REF DEST="BSW-MODULE-ENTRY">/Cdd_Pwm_TI_AM263x/Cdd_Pwm_ModuleEntry/Cdd_Pwm_G2_Ch23Isr</BSW-MODULE-ENTRY-REF>
            </BSW-MODULE-ENTRY-REF-CONDITIONAL>
          [!ENDIF!][!//
          [!IF "num:i($Channel) = '24'"!][!//
            <BSW-MODULE-ENTRY-REF-CONDITIONAL>
              <BSW-MODULE-ENTRY-REF DEST="BSW-MODULE-ENTRY">/Cdd_Pwm_TI_AM263x/Cdd_Pwm_ModuleEntry/Cdd_Pwm_G2_Ch24Isr</BSW-MODULE-ENTRY-REF>
            </BSW-MODULE-ENTRY-REF-CONDITIONAL>
          [!ENDIF!][!//
          [!IF "num:i($Channel) = '25'"!][!//
            <BSW-MODULE-ENTRY-REF-CONDITIONAL>
              <BSW-MODULE-ENTRY-REF DEST="BSW-MODULE-ENTRY">/Cdd_Pwm_TI_AM263x/Cdd_Pwm_ModuleEntry/Cdd_Pwm_G2_Ch25Isr</BSW-MODULE-ENTRY-REF>
            </BSW-MODULE-ENTRY-REF-CONDITIONAL>
          [!ENDIF!][!//
          [!IF "num:i($Channel) = '26'"!][!//
            <BSW-MODULE-ENTRY-REF-CONDITIONAL>
              <BSW-MODULE-ENTRY-REF DEST="BSW-MODULE-ENTRY">/Cdd_Pwm_TI_AM263x/Cdd_Pwm_ModuleEntry/Cdd_Pwm_G2_Ch26Isr</BSW-MODULE-ENTRY-REF>
            </BSW-MODULE-ENTRY-REF-CONDITIONAL>
          [!ENDIF!][!//
          [!IF "num:i($Channel) = '27'"!][!//
            <BSW-MODULE-ENTRY-REF-CONDITIONAL>
              <BSW-MODULE-ENTRY-REF DEST="BSW-MODULE-ENTRY">/Cdd_Pwm_TI_AM263x/Cdd_Pwm_ModuleEntry/Cdd_Pwm_G2_Ch27Isr</BSW-MODULE-ENTRY-REF>
            </BSW-MODULE-ENTRY-REF-CONDITIONAL>
          [!ENDIF!][!//
          [!IF "num:i($Channel) = '28'"!][!//
            <BSW-MODULE-ENTRY-REF-CONDITIONAL>
              <BSW-MODULE-ENTRY-REF DEST="BSW-MODULE-ENTRY">/Cdd_Pwm_TI_AM263x/Cdd_Pwm_ModuleEntry/Cdd_Pwm_G2_Ch28Isr</BSW-MODULE-ENTRY-REF>
            </BSW-MODULE-ENTRY-REF-CONDITIONAL>
          [!ENDIF!][!//
          [!IF "num:i($Channel) = '29'"!][!//
            <BSW-MODULE-ENTRY-REF-CONDITIONAL>
              <BSW-MODULE-ENTRY-REF DEST="BSW-MODULE-ENTRY">/Cdd_Pwm_TI_AM263x/Cdd_Pwm_ModuleEntry/Cdd_Pwm_G2_Ch29Isr</BSW-MODULE-ENTRY-REF>
            </BSW-MODULE-ENTRY-REF-CONDITIONAL>
          [!ENDIF!][!//
          [!IF "num:i($Channel) = '2'"!][!//
            <BSW-MODULE-ENTRY-REF-CONDITIONAL>
              <BSW-MODULE-ENTRY-REF DEST="BSW-MODULE-ENTRY">/Cdd_Pwm_TI_AM263x/Cdd_Pwm_ModuleEntry/Cdd_Pwm_G2_Ch2Isr</BSW-MODULE-ENTRY-REF>
            </BSW-MODULE-ENTRY-REF-CONDITIONAL>
          [!ENDIF!][!//
          [!IF "num:i($Channel) = '30'"!][!//
            <BSW-MODULE-ENTRY-REF-CONDITIONAL>
              <BSW-MODULE-ENTRY-REF DEST="BSW-MODULE-ENTRY">/Cdd_Pwm_TI_AM263x/Cdd_Pwm_ModuleEntry/Cdd_Pwm_G2_Ch30Isr</BSW-MODULE-ENTRY-REF>
            </BSW-MODULE-ENTRY-REF-CONDITIONAL>
          [!ENDIF!][!//
          [!IF "num:i($Channel) = '31'"!][!//
            <BSW-MODULE-ENTRY-REF-CONDITIONAL>
              <BSW-MODULE-ENTRY-REF DEST="BSW-MODULE-ENTRY">/Cdd_Pwm_TI_AM263x/Cdd_Pwm_ModuleEntry/Cdd_Pwm_G2_Ch31Isr</BSW-MODULE-ENTRY-REF>
            </BSW-MODULE-ENTRY-REF-CONDITIONAL>
          [!ENDIF!][!//
          [!IF "num:i($Channel) = '3'"!][!//
            <BSW-MODULE-ENTRY-REF-CONDITIONAL>
              <BSW-MODULE-ENTRY-REF DEST="BSW-MODULE-ENTRY">/Cdd_Pwm_TI_AM263x/Cdd_Pwm_ModuleEntry/Cdd_Pwm_G2_Ch3Isr</BSW-MODULE-ENTRY-REF>
            </BSW-MODULE-ENTRY-REF-CONDITIONAL>
          [!ENDIF!][!//
          [!IF "num:i($Channel) = '4'"!][!//
            <BSW-MODULE-ENTRY-REF-CONDITIONAL>
              <BSW-MODULE-ENTRY-REF DEST="BSW-MODULE-ENTRY">/Cdd_Pwm_TI_AM263x/Cdd_Pwm_ModuleEntry/Cdd_Pwm_G2_Ch4Isr</BSW-MODULE-ENTRY-REF>
            </BSW-MODULE-ENTRY-REF-CONDITIONAL>
          [!ENDIF!][!//
          [!IF "num:i($Channel) = '5'"!][!//
            <BSW-MODULE-ENTRY-REF-CONDITIONAL>
              <BSW-MODULE-ENTRY-REF DEST="BSW-MODULE-ENTRY">/Cdd_Pwm_TI_AM263x/Cdd_Pwm_ModuleEntry/Cdd_Pwm_G2_Ch5Isr</BSW-MODULE-ENTRY-REF>
            </BSW-MODULE-ENTRY-REF-CONDITIONAL>
          [!ENDIF!][!//
          [!IF "num:i($Channel) = '6'"!][!//
            <BSW-MODULE-ENTRY-REF-CONDITIONAL>
              <BSW-MODULE-ENTRY-REF DEST="BSW-MODULE-ENTRY">/Cdd_Pwm_TI_AM263x/Cdd_Pwm_ModuleEntry/Cdd_Pwm_G2_Ch6Isr</BSW-MODULE-ENTRY-REF>
            </BSW-MODULE-ENTRY-REF-CONDITIONAL>
          [!ENDIF!][!//
          [!IF "num:i($Channel) = '7'"!][!//
            <BSW-MODULE-ENTRY-REF-CONDITIONAL>
              <BSW-MODULE-ENTRY-REF DEST="BSW-MODULE-ENTRY">/Cdd_Pwm_TI_AM263x/Cdd_Pwm_ModuleEntry/Cdd_Pwm_G2_Ch7Isr</BSW-MODULE-ENTRY-REF>
            </BSW-MODULE-ENTRY-REF-CONDITIONAL>
          [!ENDIF!][!//
          [!IF "num:i($Channel) = '8'"!][!//
            <BSW-MODULE-ENTRY-REF-CONDITIONAL>
              <BSW-MODULE-ENTRY-REF DEST="BSW-MODULE-ENTRY">/Cdd_Pwm_TI_AM263x/Cdd_Pwm_ModuleEntry/Cdd_Pwm_G2_Ch8Isr</BSW-MODULE-ENTRY-REF>
            </BSW-MODULE-ENTRY-REF-CONDITIONAL>
          [!ENDIF!][!//
          [!IF "num:i($Channel) = '9'"!][!//
            <BSW-MODULE-ENTRY-REF-CONDITIONAL>
              <BSW-MODULE-ENTRY-REF DEST="BSW-MODULE-ENTRY">/Cdd_Pwm_TI_AM263x/Cdd_Pwm_ModuleEntry/Cdd_Pwm_G2_Ch9Isr</BSW-MODULE-ENTRY-REF>
            </BSW-MODULE-ENTRY-REF-CONDITIONAL>
          [!ENDIF!][!//
          [!IF "num:i($Channel) = '0'"!][!//
            <BSW-MODULE-ENTRY-REF-CONDITIONAL>
              <BSW-MODULE-ENTRY-REF DEST="BSW-MODULE-ENTRY">/Cdd_Pwm_TI_AM263x/Cdd_Pwm_ModuleEntry/Cdd_Pwm_G2_TzCh0Isr</BSW-MODULE-ENTRY-REF>
            </BSW-MODULE-ENTRY-REF-CONDITIONAL>
          [!ENDIF!][!//
          [!IF "num:i($Channel) = '10'"!][!//
            <BSW-MODULE-ENTRY-REF-CONDITIONAL>
              <BSW-MODULE-ENTRY-REF DEST="BSW-MODULE-ENTRY">/Cdd_Pwm_TI_AM263x/Cdd_Pwm_ModuleEntry/Cdd_Pwm_G2_TzCh10Isr</BSW-MODULE-ENTRY-REF>
            </BSW-MODULE-ENTRY-REF-CONDITIONAL>
          [!ENDIF!][!//
          [!IF "num:i($Channel) = '11'"!][!//
            <BSW-MODULE-ENTRY-REF-CONDITIONAL>
              <BSW-MODULE-ENTRY-REF DEST="BSW-MODULE-ENTRY">/Cdd_Pwm_TI_AM263x/Cdd_Pwm_ModuleEntry/Cdd_Pwm_G2_TzCh11Isr</BSW-MODULE-ENTRY-REF>
            </BSW-MODULE-ENTRY-REF-CONDITIONAL>
          [!ENDIF!][!//
          [!IF "num:i($Channel) = '12'"!][!//
            <BSW-MODULE-ENTRY-REF-CONDITIONAL>
              <BSW-MODULE-ENTRY-REF DEST="BSW-MODULE-ENTRY">/Cdd_Pwm_TI_AM263x/Cdd_Pwm_ModuleEntry/Cdd_Pwm_G2_TzCh12Isr</BSW-MODULE-ENTRY-REF>
            </BSW-MODULE-ENTRY-REF-CONDITIONAL>
          [!ENDIF!][!//
          [!IF "num:i($Channel) = '13'"!][!//
            <BSW-MODULE-ENTRY-REF-CONDITIONAL>
              <BSW-MODULE-ENTRY-REF DEST="BSW-MODULE-ENTRY">/Cdd_Pwm_TI_AM263x/Cdd_Pwm_ModuleEntry/Cdd_Pwm_G2_TzCh13Isr</BSW-MODULE-ENTRY-REF>
            </BSW-MODULE-ENTRY-REF-CONDITIONAL>
          [!ENDIF!][!//
          [!IF "num:i($Channel) = '14'"!][!//
            <BSW-MODULE-ENTRY-REF-CONDITIONAL>
              <BSW-MODULE-ENTRY-REF DEST="BSW-MODULE-ENTRY">/Cdd_Pwm_TI_AM263x/Cdd_Pwm_ModuleEntry/Cdd_Pwm_G2_TzCh14Isr</BSW-MODULE-ENTRY-REF>
            </BSW-MODULE-ENTRY-REF-CONDITIONAL>
          [!ENDIF!][!//
          [!IF "num:i($Channel) = '15'"!][!//
            <BSW-MODULE-ENTRY-REF-CONDITIONAL>
              <BSW-MODULE-ENTRY-REF DEST="BSW-MODULE-ENTRY">/Cdd_Pwm_TI_AM263x/Cdd_Pwm_ModuleEntry/Cdd_Pwm_G2_TzCh15Isr</BSW-MODULE-ENTRY-REF>
            </BSW-MODULE-ENTRY-REF-CONDITIONAL>
          [!ENDIF!][!//
          [!IF "num:i($Channel) = '16'"!][!//
            <BSW-MODULE-ENTRY-REF-CONDITIONAL>
              <BSW-MODULE-ENTRY-REF DEST="BSW-MODULE-ENTRY">/Cdd_Pwm_TI_AM263x/Cdd_Pwm_ModuleEntry/Cdd_Pwm_G2_TzCh16Isr</BSW-MODULE-ENTRY-REF>
            </BSW-MODULE-ENTRY-REF-CONDITIONAL>
          [!ENDIF!][!//
          [!IF "num:i($Channel) = '17'"!][!//
            <BSW-MODULE-ENTRY-REF-CONDITIONAL>
              <BSW-MODULE-ENTRY-REF DEST="BSW-MODULE-ENTRY">/Cdd_Pwm_TI_AM263x/Cdd_Pwm_ModuleEntry/Cdd_Pwm_G2_TzCh17Isr</BSW-MODULE-ENTRY-REF>
            </BSW-MODULE-ENTRY-REF-CONDITIONAL>
          [!ENDIF!][!//
          [!IF "num:i($Channel) = '18'"!][!//
            <BSW-MODULE-ENTRY-REF-CONDITIONAL>
              <BSW-MODULE-ENTRY-REF DEST="BSW-MODULE-ENTRY">/Cdd_Pwm_TI_AM263x/Cdd_Pwm_ModuleEntry/Cdd_Pwm_G2_TzCh18Isr</BSW-MODULE-ENTRY-REF>
            </BSW-MODULE-ENTRY-REF-CONDITIONAL>
          [!ENDIF!][!//
          [!IF "num:i($Channel) = '19'"!][!//
            <BSW-MODULE-ENTRY-REF-CONDITIONAL>
              <BSW-MODULE-ENTRY-REF DEST="BSW-MODULE-ENTRY">/Cdd_Pwm_TI_AM263x/Cdd_Pwm_ModuleEntry/Cdd_Pwm_G2_TzCh19Isr</BSW-MODULE-ENTRY-REF>
            </BSW-MODULE-ENTRY-REF-CONDITIONAL>
          [!ENDIF!][!//
          [!IF "num:i($Channel) = '1'"!][!//
            <BSW-MODULE-ENTRY-REF-CONDITIONAL>
              <BSW-MODULE-ENTRY-REF DEST="BSW-MODULE-ENTRY">/Cdd_Pwm_TI_AM263x/Cdd_Pwm_ModuleEntry/Cdd_Pwm_G2_TzCh1Isr</BSW-MODULE-ENTRY-REF>
            </BSW-MODULE-ENTRY-REF-CONDITIONAL>
          [!ENDIF!][!//
          [!IF "num:i($Channel) = '20'"!][!//
            <BSW-MODULE-ENTRY-REF-CONDITIONAL>
              <BSW-MODULE-ENTRY-REF DEST="BSW-MODULE-ENTRY">/Cdd_Pwm_TI_AM263x/Cdd_Pwm_ModuleEntry/Cdd_Pwm_G2_TzCh20Isr</BSW-MODULE-ENTRY-REF>
            </BSW-MODULE-ENTRY-REF-CONDITIONAL>
          [!ENDIF!][!//
          [!IF "num:i($Channel) = '21'"!][!//
            <BSW-MODULE-ENTRY-REF-CONDITIONAL>
              <BSW-MODULE-ENTRY-REF DEST="BSW-MODULE-ENTRY">/Cdd_Pwm_TI_AM263x/Cdd_Pwm_ModuleEntry/Cdd_Pwm_G2_TzCh21Isr</BSW-MODULE-ENTRY-REF>
            </BSW-MODULE-ENTRY-REF-CONDITIONAL>
          [!ENDIF!][!//
          [!IF "num:i($Channel) = '22'"!][!//
            <BSW-MODULE-ENTRY-REF-CONDITIONAL>
              <BSW-MODULE-ENTRY-REF DEST="BSW-MODULE-ENTRY">/Cdd_Pwm_TI_AM263x/Cdd_Pwm_ModuleEntry/Cdd_Pwm_G2_TzCh22Isr</BSW-MODULE-ENTRY-REF>
            </BSW-MODULE-ENTRY-REF-CONDITIONAL>
          [!ENDIF!][!//
          [!IF "num:i($Channel) = '23'"!][!//
            <BSW-MODULE-ENTRY-REF-CONDITIONAL>
              <BSW-MODULE-ENTRY-REF DEST="BSW-MODULE-ENTRY">/Cdd_Pwm_TI_AM263x/Cdd_Pwm_ModuleEntry/Cdd_Pwm_G2_TzCh23Isr</BSW-MODULE-ENTRY-REF>
            </BSW-MODULE-ENTRY-REF-CONDITIONAL>
          [!ENDIF!][!//
          [!IF "num:i($Channel) = '24'"!][!//
            <BSW-MODULE-ENTRY-REF-CONDITIONAL>
              <BSW-MODULE-ENTRY-REF DEST="BSW-MODULE-ENTRY">/Cdd_Pwm_TI_AM263x/Cdd_Pwm_ModuleEntry/Cdd_Pwm_G2_TzCh24Isr</BSW-MODULE-ENTRY-REF>
            </BSW-MODULE-ENTRY-REF-CONDITIONAL>
          [!ENDIF!][!//
          [!IF "num:i($Channel) = '25'"!][!//
            <BSW-MODULE-ENTRY-REF-CONDITIONAL>
              <BSW-MODULE-ENTRY-REF DEST="BSW-MODULE-ENTRY">/Cdd_Pwm_TI_AM263x/Cdd_Pwm_ModuleEntry/Cdd_Pwm_G2_TzCh25Isr</BSW-MODULE-ENTRY-REF>
            </BSW-MODULE-ENTRY-REF-CONDITIONAL>
          [!ENDIF!][!//
          [!IF "num:i($Channel) = '26'"!][!//
            <BSW-MODULE-ENTRY-REF-CONDITIONAL>
              <BSW-MODULE-ENTRY-REF DEST="BSW-MODULE-ENTRY">/Cdd_Pwm_TI_AM263x/Cdd_Pwm_ModuleEntry/Cdd_Pwm_G2_TzCh26Isr</BSW-MODULE-ENTRY-REF>
            </BSW-MODULE-ENTRY-REF-CONDITIONAL>
          [!ENDIF!][!//
          [!IF "num:i($Channel) = '27'"!][!//
            <BSW-MODULE-ENTRY-REF-CONDITIONAL>
              <BSW-MODULE-ENTRY-REF DEST="BSW-MODULE-ENTRY">/Cdd_Pwm_TI_AM263x/Cdd_Pwm_ModuleEntry/Cdd_Pwm_G2_TzCh27Isr</BSW-MODULE-ENTRY-REF>
            </BSW-MODULE-ENTRY-REF-CONDITIONAL>
          [!ENDIF!][!//
          [!IF "num:i($Channel) = '28'"!][!//
            <BSW-MODULE-ENTRY-REF-CONDITIONAL>
              <BSW-MODULE-ENTRY-REF DEST="BSW-MODULE-ENTRY">/Cdd_Pwm_TI_AM263x/Cdd_Pwm_ModuleEntry/Cdd_Pwm_G2_TzCh28Isr</BSW-MODULE-ENTRY-REF>
            </BSW-MODULE-ENTRY-REF-CONDITIONAL>
          [!ENDIF!][!//
          [!IF "num:i($Channel) = '29'"!][!//
            <BSW-MODULE-ENTRY-REF-CONDITIONAL>
              <BSW-MODULE-ENTRY-REF DEST="BSW-MODULE-ENTRY">/Cdd_Pwm_TI_AM263x/Cdd_Pwm_ModuleEntry/Cdd_Pwm_G2_TzCh29Isr</BSW-MODULE-ENTRY-REF>
            </BSW-MODULE-ENTRY-REF-CONDITIONAL>
          [!ENDIF!][!//
          [!IF "num:i($Channel) = '2'"!][!//
            <BSW-MODULE-ENTRY-REF-CONDITIONAL>
              <BSW-MODULE-ENTRY-REF DEST="BSW-MODULE-ENTRY">/Cdd_Pwm_TI_AM263x/Cdd_Pwm_ModuleEntry/Cdd_Pwm_G2_TzCh2Isr</BSW-MODULE-ENTRY-REF>
            </BSW-MODULE-ENTRY-REF-CONDITIONAL>
          [!ENDIF!][!//
          [!IF "num:i($Channel) = '30'"!][!//
            <BSW-MODULE-ENTRY-REF-CONDITIONAL>
              <BSW-MODULE-ENTRY-REF DEST="BSW-MODULE-ENTRY">/Cdd_Pwm_TI_AM263x/Cdd_Pwm_ModuleEntry/Cdd_Pwm_G2_TzCh30Isr</BSW-MODULE-ENTRY-REF>
            </BSW-MODULE-ENTRY-REF-CONDITIONAL>
          [!ENDIF!][!//
          [!IF "num:i($Channel) = '31'"!][!//
            <BSW-MODULE-ENTRY-REF-CONDITIONAL>
              <BSW-MODULE-ENTRY-REF DEST="BSW-MODULE-ENTRY">/Cdd_Pwm_TI_AM263x/Cdd_Pwm_ModuleEntry/Cdd_Pwm_G2_TzCh31Isr</BSW-MODULE-ENTRY-REF>
            </BSW-MODULE-ENTRY-REF-CONDITIONAL>
          [!ENDIF!][!//
          [!IF "num:i($Channel) = '3'"!][!//
            <BSW-MODULE-ENTRY-REF-CONDITIONAL>
              <BSW-MODULE-ENTRY-REF DEST="BSW-MODULE-ENTRY">/Cdd_Pwm_TI_AM263x/Cdd_Pwm_ModuleEntry/Cdd_Pwm_G2_TzCh3Isr</BSW-MODULE-ENTRY-REF>
            </BSW-MODULE-ENTRY-REF-CONDITIONAL>
          [!ENDIF!][!//
          [!IF "num:i($Channel) = '4'"!][!//
            <BSW-MODULE-ENTRY-REF-CONDITIONAL>
              <BSW-MODULE-ENTRY-REF DEST="BSW-MODULE-ENTRY">/Cdd_Pwm_TI_AM263x/Cdd_Pwm_ModuleEntry/Cdd_Pwm_G2_TzCh4Isr</BSW-MODULE-ENTRY-REF>
            </BSW-MODULE-ENTRY-REF-CONDITIONAL>
          [!ENDIF!][!//
          [!IF "num:i($Channel) = '5'"!][!//
            <BSW-MODULE-ENTRY-REF-CONDITIONAL>
              <BSW-MODULE-ENTRY-REF DEST="BSW-MODULE-ENTRY">/Cdd_Pwm_TI_AM263x/Cdd_Pwm_ModuleEntry/Cdd_Pwm_G2_TzCh5Isr</BSW-MODULE-ENTRY-REF>
            </BSW-MODULE-ENTRY-REF-CONDITIONAL>
          [!ENDIF!][!//
          [!IF "num:i($Channel) = '6'"!][!//
            <BSW-MODULE-ENTRY-REF-CONDITIONAL>
              <BSW-MODULE-ENTRY-REF DEST="BSW-MODULE-ENTRY">/Cdd_Pwm_TI_AM263x/Cdd_Pwm_ModuleEntry/Cdd_Pwm_G2_TzCh6Isr</BSW-MODULE-ENTRY-REF>
            </BSW-MODULE-ENTRY-REF-CONDITIONAL>
          [!ENDIF!][!//
          [!IF "num:i($Channel) = '7'"!][!//
            <BSW-MODULE-ENTRY-REF-CONDITIONAL>
              <BSW-MODULE-ENTRY-REF DEST="BSW-MODULE-ENTRY">/Cdd_Pwm_TI_AM263x/Cdd_Pwm_ModuleEntry/Cdd_Pwm_G2_TzCh7Isr</BSW-MODULE-ENTRY-REF>
            </BSW-MODULE-ENTRY-REF-CONDITIONAL>
          [!ENDIF!][!//
          [!IF "num:i($Channel) = '8'"!][!//
            <BSW-MODULE-ENTRY-REF-CONDITIONAL>
              <BSW-MODULE-ENTRY-REF DEST="BSW-MODULE-ENTRY">/Cdd_Pwm_TI_AM263x/Cdd_Pwm_ModuleEntry/Cdd_Pwm_G2_TzCh8Isr</BSW-MODULE-ENTRY-REF>
            </BSW-MODULE-ENTRY-REF-CONDITIONAL>
          [!ENDIF!][!//
          [!IF "num:i($Channel) = '9'"!][!//
            <BSW-MODULE-ENTRY-REF-CONDITIONAL>
              <BSW-MODULE-ENTRY-REF DEST="BSW-MODULE-ENTRY">/Cdd_Pwm_TI_AM263x/Cdd_Pwm_ModuleEntry/Cdd_Pwm_G2_TzCh9Isr</BSW-MODULE-ENTRY-REF>
            </BSW-MODULE-ENTRY-REF-CONDITIONAL>
          [!ENDIF!][!//
          [!ELSE!][!//
          [!IF "num:i($Channel) = '0'"!][!//
            <BSW-MODULE-ENTRY-REF-CONDITIONAL>
              <BSW-MODULE-ENTRY-REF DEST="BSW-MODULE-ENTRY">/Cdd_Pwm_TI_AM263x/Cdd_Pwm_ModuleEntry/Cdd_Pwm_G3_Ch0Isr</BSW-MODULE-ENTRY-REF>
            </BSW-MODULE-ENTRY-REF-CONDITIONAL>
          [!ENDIF!][!//
          [!IF "num:i($Channel) = '10'"!][!//
            <BSW-MODULE-ENTRY-REF-CONDITIONAL>
              <BSW-MODULE-ENTRY-REF DEST="BSW-MODULE-ENTRY">/Cdd_Pwm_TI_AM263x/Cdd_Pwm_ModuleEntry/Cdd_Pwm_G3_Ch10Isr</BSW-MODULE-ENTRY-REF>
            </BSW-MODULE-ENTRY-REF-CONDITIONAL>
          [!ENDIF!][!//
          [!IF "num:i($Channel) = '11'"!][!//
            <BSW-MODULE-ENTRY-REF-CONDITIONAL>
              <BSW-MODULE-ENTRY-REF DEST="BSW-MODULE-ENTRY">/Cdd_Pwm_TI_AM263x/Cdd_Pwm_ModuleEntry/Cdd_Pwm_G3_Ch11Isr</BSW-MODULE-ENTRY-REF>
            </BSW-MODULE-ENTRY-REF-CONDITIONAL>
          [!ENDIF!][!//
          [!IF "num:i($Channel) = '12'"!][!//
            <BSW-MODULE-ENTRY-REF-CONDITIONAL>
              <BSW-MODULE-ENTRY-REF DEST="BSW-MODULE-ENTRY">/Cdd_Pwm_TI_AM263x/Cdd_Pwm_ModuleEntry/Cdd_Pwm_G3_Ch12Isr</BSW-MODULE-ENTRY-REF>
            </BSW-MODULE-ENTRY-REF-CONDITIONAL>
          [!ENDIF!][!//
          [!IF "num:i($Channel) = '13'"!][!//
            <BSW-MODULE-ENTRY-REF-CONDITIONAL>
              <BSW-MODULE-ENTRY-REF DEST="BSW-MODULE-ENTRY">/Cdd_Pwm_TI_AM263x/Cdd_Pwm_ModuleEntry/Cdd_Pwm_G3_Ch13Isr</BSW-MODULE-ENTRY-REF>
            </BSW-MODULE-ENTRY-REF-CONDITIONAL>
          [!ENDIF!][!//
          [!IF "num:i($Channel) = '14'"!][!//
            <BSW-MODULE-ENTRY-REF-CONDITIONAL>
              <BSW-MODULE-ENTRY-REF DEST="BSW-MODULE-ENTRY">/Cdd_Pwm_TI_AM263x/Cdd_Pwm_ModuleEntry/Cdd_Pwm_G3_Ch14Isr</BSW-MODULE-ENTRY-REF>
            </BSW-MODULE-ENTRY-REF-CONDITIONAL>
          [!ENDIF!][!//
          [!IF "num:i($Channel) = '15'"!][!//
            <BSW-MODULE-ENTRY-REF-CONDITIONAL>
              <BSW-MODULE-ENTRY-REF DEST="BSW-MODULE-ENTRY">/Cdd_Pwm_TI_AM263x/Cdd_Pwm_ModuleEntry/Cdd_Pwm_G3_Ch15Isr</BSW-MODULE-ENTRY-REF>
            </BSW-MODULE-ENTRY-REF-CONDITIONAL>
          [!ENDIF!][!//
          [!IF "num:i($Channel) = '16'"!][!//
            <BSW-MODULE-ENTRY-REF-CONDITIONAL>
              <BSW-MODULE-ENTRY-REF DEST="BSW-MODULE-ENTRY">/Cdd_Pwm_TI_AM263x/Cdd_Pwm_ModuleEntry/Cdd_Pwm_G3_Ch16Isr</BSW-MODULE-ENTRY-REF>
            </BSW-MODULE-ENTRY-REF-CONDITIONAL>
          [!ENDIF!][!//
          [!IF "num:i($Channel) = '17'"!][!//
            <BSW-MODULE-ENTRY-REF-CONDITIONAL>
              <BSW-MODULE-ENTRY-REF DEST="BSW-MODULE-ENTRY">/Cdd_Pwm_TI_AM263x/Cdd_Pwm_ModuleEntry/Cdd_Pwm_G3_Ch17Isr</BSW-MODULE-ENTRY-REF>
            </BSW-MODULE-ENTRY-REF-CONDITIONAL>
          [!ENDIF!][!//
          [!IF "num:i($Channel) = '18'"!][!//
            <BSW-MODULE-ENTRY-REF-CONDITIONAL>
              <BSW-MODULE-ENTRY-REF DEST="BSW-MODULE-ENTRY">/Cdd_Pwm_TI_AM263x/Cdd_Pwm_ModuleEntry/Cdd_Pwm_G3_Ch18Isr</BSW-MODULE-ENTRY-REF>
            </BSW-MODULE-ENTRY-REF-CONDITIONAL>
          [!ENDIF!][!//
          [!IF "num:i($Channel) = '19'"!][!//
            <BSW-MODULE-ENTRY-REF-CONDITIONAL>
              <BSW-MODULE-ENTRY-REF DEST="BSW-MODULE-ENTRY">/Cdd_Pwm_TI_AM263x/Cdd_Pwm_ModuleEntry/Cdd_Pwm_G3_Ch19Isr</BSW-MODULE-ENTRY-REF>
            </BSW-MODULE-ENTRY-REF-CONDITIONAL>
          [!ENDIF!][!//
          [!IF "num:i($Channel) = '1'"!][!//
            <BSW-MODULE-ENTRY-REF-CONDITIONAL>
              <BSW-MODULE-ENTRY-REF DEST="BSW-MODULE-ENTRY">/Cdd_Pwm_TI_AM263x/Cdd_Pwm_ModuleEntry/Cdd_Pwm_G3_Ch1Isr</BSW-MODULE-ENTRY-REF>
            </BSW-MODULE-ENTRY-REF-CONDITIONAL>
          [!ENDIF!][!//
          [!IF "num:i($Channel) = '20'"!][!//
            <BSW-MODULE-ENTRY-REF-CONDITIONAL>
              <BSW-MODULE-ENTRY-REF DEST="BSW-MODULE-ENTRY">/Cdd_Pwm_TI_AM263x/Cdd_Pwm_ModuleEntry/Cdd_Pwm_G3_Ch20Isr</BSW-MODULE-ENTRY-REF>
            </BSW-MODULE-ENTRY-REF-CONDITIONAL>
          [!ENDIF!][!//
          [!IF "num:i($Channel) = '21'"!][!//
            <BSW-MODULE-ENTRY-REF-CONDITIONAL>
              <BSW-MODULE-ENTRY-REF DEST="BSW-MODULE-ENTRY">/Cdd_Pwm_TI_AM263x/Cdd_Pwm_ModuleEntry/Cdd_Pwm_G3_Ch21Isr</BSW-MODULE-ENTRY-REF>
            </BSW-MODULE-ENTRY-REF-CONDITIONAL>
          [!ENDIF!][!//
          [!IF "num:i($Channel) = '22'"!][!//
            <BSW-MODULE-ENTRY-REF-CONDITIONAL>
              <BSW-MODULE-ENTRY-REF DEST="BSW-MODULE-ENTRY">/Cdd_Pwm_TI_AM263x/Cdd_Pwm_ModuleEntry/Cdd_Pwm_G3_Ch22Isr</BSW-MODULE-ENTRY-REF>
            </BSW-MODULE-ENTRY-REF-CONDITIONAL>
          [!ENDIF!][!//
          [!IF "num:i($Channel) = '23'"!][!//
            <BSW-MODULE-ENTRY-REF-CONDITIONAL>
              <BSW-MODULE-ENTRY-REF DEST="BSW-MODULE-ENTRY">/Cdd_Pwm_TI_AM263x/Cdd_Pwm_ModuleEntry/Cdd_Pwm_G3_Ch23Isr</BSW-MODULE-ENTRY-REF>
            </BSW-MODULE-ENTRY-REF-CONDITIONAL>
          [!ENDIF!][!//
          [!IF "num:i($Channel) = '24'"!][!//
            <BSW-MODULE-ENTRY-REF-CONDITIONAL>
              <BSW-MODULE-ENTRY-REF DEST="BSW-MODULE-ENTRY">/Cdd_Pwm_TI_AM263x/Cdd_Pwm_ModuleEntry/Cdd_Pwm_G3_Ch24Isr</BSW-MODULE-ENTRY-REF>
            </BSW-MODULE-ENTRY-REF-CONDITIONAL>
          [!ENDIF!][!//
          [!IF "num:i($Channel) = '25'"!][!//
            <BSW-MODULE-ENTRY-REF-CONDITIONAL>
              <BSW-MODULE-ENTRY-REF DEST="BSW-MODULE-ENTRY">/Cdd_Pwm_TI_AM263x/Cdd_Pwm_ModuleEntry/Cdd_Pwm_G3_Ch25Isr</BSW-MODULE-ENTRY-REF>
            </BSW-MODULE-ENTRY-REF-CONDITIONAL>
          [!ENDIF!][!//
          [!IF "num:i($Channel) = '26'"!][!//
            <BSW-MODULE-ENTRY-REF-CONDITIONAL>
              <BSW-MODULE-ENTRY-REF DEST="BSW-MODULE-ENTRY">/Cdd_Pwm_TI_AM263x/Cdd_Pwm_ModuleEntry/Cdd_Pwm_G3_Ch26Isr</BSW-MODULE-ENTRY-REF>
            </BSW-MODULE-ENTRY-REF-CONDITIONAL>
          [!ENDIF!][!//
          [!IF "num:i($Channel) = '27'"!][!//
            <BSW-MODULE-ENTRY-REF-CONDITIONAL>
              <BSW-MODULE-ENTRY-REF DEST="BSW-MODULE-ENTRY">/Cdd_Pwm_TI_AM263x/Cdd_Pwm_ModuleEntry/Cdd_Pwm_G3_Ch27Isr</BSW-MODULE-ENTRY-REF>
            </BSW-MODULE-ENTRY-REF-CONDITIONAL>
          [!ENDIF!][!//
          [!IF "num:i($Channel) = '28'"!][!//
            <BSW-MODULE-ENTRY-REF-CONDITIONAL>
              <BSW-MODULE-ENTRY-REF DEST="BSW-MODULE-ENTRY">/Cdd_Pwm_TI_AM263x/Cdd_Pwm_ModuleEntry/Cdd_Pwm_G3_Ch28Isr</BSW-MODULE-ENTRY-REF>
            </BSW-MODULE-ENTRY-REF-CONDITIONAL>
          [!ENDIF!][!//
          [!IF "num:i($Channel) = '29'"!][!//
            <BSW-MODULE-ENTRY-REF-CONDITIONAL>
              <BSW-MODULE-ENTRY-REF DEST="BSW-MODULE-ENTRY">/Cdd_Pwm_TI_AM263x/Cdd_Pwm_ModuleEntry/Cdd_Pwm_G3_Ch29Isr</BSW-MODULE-ENTRY-REF>
            </BSW-MODULE-ENTRY-REF-CONDITIONAL>
          [!ENDIF!][!//
          [!IF "num:i($Channel) = '2'"!][!//
            <BSW-MODULE-ENTRY-REF-CONDITIONAL>
              <BSW-MODULE-ENTRY-REF DEST="BSW-MODULE-ENTRY">/Cdd_Pwm_TI_AM263x/Cdd_Pwm_ModuleEntry/Cdd_Pwm_G3_Ch2Isr</BSW-MODULE-ENTRY-REF>
            </BSW-MODULE-ENTRY-REF-CONDITIONAL>
          [!ENDIF!][!//
          [!IF "num:i($Channel) = '30'"!][!//
            <BSW-MODULE-ENTRY-REF-CONDITIONAL>
              <BSW-MODULE-ENTRY-REF DEST="BSW-MODULE-ENTRY">/Cdd_Pwm_TI_AM263x/Cdd_Pwm_ModuleEntry/Cdd_Pwm_G3_Ch30Isr</BSW-MODULE-ENTRY-REF>
            </BSW-MODULE-ENTRY-REF-CONDITIONAL>
          [!ENDIF!][!//
          [!IF "num:i($Channel) = '31'"!][!//
            <BSW-MODULE-ENTRY-REF-CONDITIONAL>
              <BSW-MODULE-ENTRY-REF DEST="BSW-MODULE-ENTRY">/Cdd_Pwm_TI_AM263x/Cdd_Pwm_ModuleEntry/Cdd_Pwm_G3_Ch31Isr</BSW-MODULE-ENTRY-REF>
            </BSW-MODULE-ENTRY-REF-CONDITIONAL>
          [!ENDIF!][!//
          [!IF "num:i($Channel) = '3'"!][!//
            <BSW-MODULE-ENTRY-REF-CONDITIONAL>
              <BSW-MODULE-ENTRY-REF DEST="BSW-MODULE-ENTRY">/Cdd_Pwm_TI_AM263x/Cdd_Pwm_ModuleEntry/Cdd_Pwm_G3_Ch3Isr</BSW-MODULE-ENTRY-REF>
            </BSW-MODULE-ENTRY-REF-CONDITIONAL>
          [!ENDIF!][!//
          [!IF "num:i($Channel) = '4'"!][!//
            <BSW-MODULE-ENTRY-REF-CONDITIONAL>
              <BSW-MODULE-ENTRY-REF DEST="BSW-MODULE-ENTRY">/Cdd_Pwm_TI_AM263x/Cdd_Pwm_ModuleEntry/Cdd_Pwm_G3_Ch4Isr</BSW-MODULE-ENTRY-REF>
            </BSW-MODULE-ENTRY-REF-CONDITIONAL>
          [!ENDIF!][!//
          [!IF "num:i($Channel) = '5'"!][!//
            <BSW-MODULE-ENTRY-REF-CONDITIONAL>
              <BSW-MODULE-ENTRY-REF DEST="BSW-MODULE-ENTRY">/Cdd_Pwm_TI_AM263x/Cdd_Pwm_ModuleEntry/Cdd_Pwm_G3_Ch5Isr</BSW-MODULE-ENTRY-REF>
            </BSW-MODULE-ENTRY-REF-CONDITIONAL>
          [!ENDIF!][!//
          [!IF "num:i($Channel) = '6'"!][!//
            <BSW-MODULE-ENTRY-REF-CONDITIONAL>
              <BSW-MODULE-ENTRY-REF DEST="BSW-MODULE-ENTRY">/Cdd_Pwm_TI_AM263x/Cdd_Pwm_ModuleEntry/Cdd_Pwm_G3_Ch6Isr</BSW-MODULE-ENTRY-REF>
            </BSW-MODULE-ENTRY-REF-CONDITIONAL>
          [!ENDIF!][!//
          [!IF "num:i($Channel) = '7'"!][!//
            <BSW-MODULE-ENTRY-REF-CONDITIONAL>
              <BSW-MODULE-ENTRY-REF DEST="BSW-MODULE-ENTRY">/Cdd_Pwm_TI_AM263x/Cdd_Pwm_ModuleEntry/Cdd_Pwm_G3_Ch7Isr</BSW-MODULE-ENTRY-REF>
            </BSW-MODULE-ENTRY-REF-CONDITIONAL>
          [!ENDIF!][!//
          [!IF "num:i($Channel) = '8'"!][!//
            <BSW-MODULE-ENTRY-REF-CONDITIONAL>
              <BSW-MODULE-ENTRY-REF DEST="BSW-MODULE-ENTRY">/Cdd_Pwm_TI_AM263x/Cdd_Pwm_ModuleEntry/Cdd_Pwm_G3_Ch8Isr</BSW-MODULE-ENTRY-REF>
            </BSW-MODULE-ENTRY-REF-CONDITIONAL>
          [!ENDIF!][!//
          [!IF "num:i($Channel) = '9'"!][!//
            <BSW-MODULE-ENTRY-REF-CONDITIONAL>
              <BSW-MODULE-ENTRY-REF DEST="BSW-MODULE-ENTRY">/Cdd_Pwm_TI_AM263x/Cdd_Pwm_ModuleEntry/Cdd_Pwm_G3_Ch9Isr</BSW-MODULE-ENTRY-REF>
            </BSW-MODULE-ENTRY-REF-CONDITIONAL>
          [!ENDIF!][!//
          [!IF "num:i($Channel) = '0'"!][!//
            <BSW-MODULE-ENTRY-REF-CONDITIONAL>
              <BSW-MODULE-ENTRY-REF DEST="BSW-MODULE-ENTRY">/Cdd_Pwm_TI_AM263x/Cdd_Pwm_ModuleEntry/Cdd_Pwm_G3_TzCh0Isr</BSW-MODULE-ENTRY-REF>
            </BSW-MODULE-ENTRY-REF-CONDITIONAL>
          [!ENDIF!][!//
          [!IF "num:i($Channel) = '10'"!][!//
            <BSW-MODULE-ENTRY-REF-CONDITIONAL>
              <BSW-MODULE-ENTRY-REF DEST="BSW-MODULE-ENTRY">/Cdd_Pwm_TI_AM263x/Cdd_Pwm_ModuleEntry/Cdd_Pwm_G3_TzCh10Isr</BSW-MODULE-ENTRY-REF>
            </BSW-MODULE-ENTRY-REF-CONDITIONAL>
          [!ENDIF!][!//
          [!IF "num:i($Channel) = '11'"!][!//
            <BSW-MODULE-ENTRY-REF-CONDITIONAL>
              <BSW-MODULE-ENTRY-REF DEST="BSW-MODULE-ENTRY">/Cdd_Pwm_TI_AM263x/Cdd_Pwm_ModuleEntry/Cdd_Pwm_G3_TzCh11Isr</BSW-MODULE-ENTRY-REF>
            </BSW-MODULE-ENTRY-REF-CONDITIONAL>
          [!ENDIF!][!//
          [!IF "num:i($Channel) = '12'"!][!//
            <BSW-MODULE-ENTRY-REF-CONDITIONAL>
              <BSW-MODULE-ENTRY-REF DEST="BSW-MODULE-ENTRY">/Cdd_Pwm_TI_AM263x/Cdd_Pwm_ModuleEntry/Cdd_Pwm_G3_TzCh12Isr</BSW-MODULE-ENTRY-REF>
            </BSW-MODULE-ENTRY-REF-CONDITIONAL>
          [!ENDIF!][!//
          [!IF "num:i($Channel) = '13'"!][!//
            <BSW-MODULE-ENTRY-REF-CONDITIONAL>
              <BSW-MODULE-ENTRY-REF DEST="BSW-MODULE-ENTRY">/Cdd_Pwm_TI_AM263x/Cdd_Pwm_ModuleEntry/Cdd_Pwm_G3_TzCh13Isr</BSW-MODULE-ENTRY-REF>
            </BSW-MODULE-ENTRY-REF-CONDITIONAL>
          [!ENDIF!][!//
          [!IF "num:i($Channel) = '14'"!][!//
            <BSW-MODULE-ENTRY-REF-CONDITIONAL>
              <BSW-MODULE-ENTRY-REF DEST="BSW-MODULE-ENTRY">/Cdd_Pwm_TI_AM263x/Cdd_Pwm_ModuleEntry/Cdd_Pwm_G3_TzCh14Isr</BSW-MODULE-ENTRY-REF>
            </BSW-MODULE-ENTRY-REF-CONDITIONAL>
          [!ENDIF!][!//
          [!IF "num:i($Channel) = '15'"!][!//
            <BSW-MODULE-ENTRY-REF-CONDITIONAL>
              <BSW-MODULE-ENTRY-REF DEST="BSW-MODULE-ENTRY">/Cdd_Pwm_TI_AM263x/Cdd_Pwm_ModuleEntry/Cdd_Pwm_G3_TzCh15Isr</BSW-MODULE-ENTRY-REF>
            </BSW-MODULE-ENTRY-REF-CONDITIONAL>
          [!ENDIF!][!//
          [!IF "num:i($Channel) = '16'"!][!//
            <BSW-MODULE-ENTRY-REF-CONDITIONAL>
              <BSW-MODULE-ENTRY-REF DEST="BSW-MODULE-ENTRY">/Cdd_Pwm_TI_AM263x/Cdd_Pwm_ModuleEntry/Cdd_Pwm_G3_TzCh16Isr</BSW-MODULE-ENTRY-REF>
            </BSW-MODULE-ENTRY-REF-CONDITIONAL>
          [!ENDIF!][!//
          [!IF "num:i($Channel) = '17'"!][!//
            <BSW-MODULE-ENTRY-REF-CONDITIONAL>
              <BSW-MODULE-ENTRY-REF DEST="BSW-MODULE-ENTRY">/Cdd_Pwm_TI_AM263x/Cdd_Pwm_ModuleEntry/Cdd_Pwm_G3_TzCh17Isr</BSW-MODULE-ENTRY-REF>
            </BSW-MODULE-ENTRY-REF-CONDITIONAL>
          [!ENDIF!][!//
          [!IF "num:i($Channel) = '18'"!][!//
            <BSW-MODULE-ENTRY-REF-CONDITIONAL>
              <BSW-MODULE-ENTRY-REF DEST="BSW-MODULE-ENTRY">/Cdd_Pwm_TI_AM263x/Cdd_Pwm_ModuleEntry/Cdd_Pwm_G3_TzCh18Isr</BSW-MODULE-ENTRY-REF>
            </BSW-MODULE-ENTRY-REF-CONDITIONAL>
          [!ENDIF!][!//
          [!IF "num:i($Channel) = '19'"!][!//
            <BSW-MODULE-ENTRY-REF-CONDITIONAL>
              <BSW-MODULE-ENTRY-REF DEST="BSW-MODULE-ENTRY">/Cdd_Pwm_TI_AM263x/Cdd_Pwm_ModuleEntry/Cdd_Pwm_G3_TzCh19Isr</BSW-MODULE-ENTRY-REF>
            </BSW-MODULE-ENTRY-REF-CONDITIONAL>
          [!ENDIF!][!//
          [!IF "num:i($Channel) = '1'"!][!//
            <BSW-MODULE-ENTRY-REF-CONDITIONAL>
              <BSW-MODULE-ENTRY-REF DEST="BSW-MODULE-ENTRY">/Cdd_Pwm_TI_AM263x/Cdd_Pwm_ModuleEntry/Cdd_Pwm_G3_TzCh1Isr</BSW-MODULE-ENTRY-REF>
            </BSW-MODULE-ENTRY-REF-CONDITIONAL>
          [!ENDIF!][!//
          [!IF "num:i($Channel) = '20'"!][!//
            <BSW-MODULE-ENTRY-REF-CONDITIONAL>
              <BSW-MODULE-ENTRY-REF DEST="BSW-MODULE-ENTRY">/Cdd_Pwm_TI_AM263x/Cdd_Pwm_ModuleEntry/Cdd_Pwm_G3_TzCh20Isr</BSW-MODULE-ENTRY-REF>
            </BSW-MODULE-ENTRY-REF-CONDITIONAL>
          [!ENDIF!][!//
          [!IF "num:i($Channel) = '21'"!][!//
            <BSW-MODULE-ENTRY-REF-CONDITIONAL>
              <BSW-MODULE-ENTRY-REF DEST="BSW-MODULE-ENTRY">/Cdd_Pwm_TI_AM263x/Cdd_Pwm_ModuleEntry/Cdd_Pwm_G3_TzCh21Isr</BSW-MODULE-ENTRY-REF>
            </BSW-MODULE-ENTRY-REF-CONDITIONAL>
          [!ENDIF!][!//
          [!IF "num:i($Channel) = '22'"!][!//
            <BSW-MODULE-ENTRY-REF-CONDITIONAL>
              <BSW-MODULE-ENTRY-REF DEST="BSW-MODULE-ENTRY">/Cdd_Pwm_TI_AM263x/Cdd_Pwm_ModuleEntry/Cdd_Pwm_G3_TzCh22Isr</BSW-MODULE-ENTRY-REF>
            </BSW-MODULE-ENTRY-REF-CONDITIONAL>
          [!ENDIF!][!//
          [!IF "num:i($Channel) = '23'"!][!//
            <BSW-MODULE-ENTRY-REF-CONDITIONAL>
              <BSW-MODULE-ENTRY-REF DEST="BSW-MODULE-ENTRY">/Cdd_Pwm_TI_AM263x/Cdd_Pwm_ModuleEntry/Cdd_Pwm_G3_TzCh23Isr</BSW-MODULE-ENTRY-REF>
            </BSW-MODULE-ENTRY-REF-CONDITIONAL>
          [!ENDIF!][!//
          [!IF "num:i($Channel) = '24'"!][!//
            <BSW-MODULE-ENTRY-REF-CONDITIONAL>
              <BSW-MODULE-ENTRY-REF DEST="BSW-MODULE-ENTRY">/Cdd_Pwm_TI_AM263x/Cdd_Pwm_ModuleEntry/Cdd_Pwm_G3_TzCh24Isr</BSW-MODULE-ENTRY-REF>
            </BSW-MODULE-ENTRY-REF-CONDITIONAL>
          [!ENDIF!][!//
          [!IF "num:i($Channel) = '25'"!][!//
            <BSW-MODULE-ENTRY-REF-CONDITIONAL>
              <BSW-MODULE-ENTRY-REF DEST="BSW-MODULE-ENTRY">/Cdd_Pwm_TI_AM263x/Cdd_Pwm_ModuleEntry/Cdd_Pwm_G3_TzCh25Isr</BSW-MODULE-ENTRY-REF>
            </BSW-MODULE-ENTRY-REF-CONDITIONAL>
          [!ENDIF!][!//
          [!IF "num:i($Channel) = '26'"!][!//
            <BSW-MODULE-ENTRY-REF-CONDITIONAL>
              <BSW-MODULE-ENTRY-REF DEST="BSW-MODULE-ENTRY">/Cdd_Pwm_TI_AM263x/Cdd_Pwm_ModuleEntry/Cdd_Pwm_G3_TzCh26Isr</BSW-MODULE-ENTRY-REF>
            </BSW-MODULE-ENTRY-REF-CONDITIONAL>
          [!ENDIF!][!//
          [!IF "num:i($Channel) = '27'"!][!//
            <BSW-MODULE-ENTRY-REF-CONDITIONAL>
              <BSW-MODULE-ENTRY-REF DEST="BSW-MODULE-ENTRY">/Cdd_Pwm_TI_AM263x/Cdd_Pwm_ModuleEntry/Cdd_Pwm_G3_TzCh27Isr</BSW-MODULE-ENTRY-REF>
            </BSW-MODULE-ENTRY-REF-CONDITIONAL>
          [!ENDIF!][!//
          [!IF "num:i($Channel) = '28'"!][!//
            <BSW-MODULE-ENTRY-REF-CONDITIONAL>
              <BSW-MODULE-ENTRY-REF DEST="BSW-MODULE-ENTRY">/Cdd_Pwm_TI_AM263x/Cdd_Pwm_ModuleEntry/Cdd_Pwm_G3_TzCh28Isr</BSW-MODULE-ENTRY-REF>
            </BSW-MODULE-ENTRY-REF-CONDITIONAL>
          [!ENDIF!][!//
          [!IF "num:i($Channel) = '29'"!][!//
            <BSW-MODULE-ENTRY-REF-CONDITIONAL>
              <BSW-MODULE-ENTRY-REF DEST="BSW-MODULE-ENTRY">/Cdd_Pwm_TI_AM263x/Cdd_Pwm_ModuleEntry/Cdd_Pwm_G3_TzCh29Isr</BSW-MODULE-ENTRY-REF>
            </BSW-MODULE-ENTRY-REF-CONDITIONAL>
          [!ENDIF!][!//
          [!IF "num:i($Channel) = '2'"!][!//
            <BSW-MODULE-ENTRY-REF-CONDITIONAL>
              <BSW-MODULE-ENTRY-REF DEST="BSW-MODULE-ENTRY">/Cdd_Pwm_TI_AM263x/Cdd_Pwm_ModuleEntry/Cdd_Pwm_G3_TzCh2Isr</BSW-MODULE-ENTRY-REF>
            </BSW-MODULE-ENTRY-REF-CONDITIONAL>
          [!ENDIF!][!//
          [!IF "num:i($Channel) = '30'"!][!//
            <BSW-MODULE-ENTRY-REF-CONDITIONAL>
              <BSW-MODULE-ENTRY-REF DEST="BSW-MODULE-ENTRY">/Cdd_Pwm_TI_AM263x/Cdd_Pwm_ModuleEntry/Cdd_Pwm_G3_TzCh30Isr</BSW-MODULE-ENTRY-REF>
            </BSW-MODULE-ENTRY-REF-CONDITIONAL>
          [!ENDIF!][!//
          [!IF "num:i($Channel) = '31'"!][!//
            <BSW-MODULE-ENTRY-REF-CONDITIONAL>
              <BSW-MODULE-ENTRY-REF DEST="BSW-MODULE-ENTRY">/Cdd_Pwm_TI_AM263x/Cdd_Pwm_ModuleEntry/Cdd_Pwm_G3_TzCh31Isr</BSW-MODULE-ENTRY-REF>
            </BSW-MODULE-ENTRY-REF-CONDITIONAL>
          [!ENDIF!][!//
          [!IF "num:i($Channel) = '3'"!][!//
            <BSW-MODULE-ENTRY-REF-CONDITIONAL>
              <BSW-MODULE-ENTRY-REF DEST="BSW-MODULE-ENTRY">/Cdd_Pwm_TI_AM263x/Cdd_Pwm_ModuleEntry/Cdd_Pwm_G3_TzCh3Isr</BSW-MODULE-ENTRY-REF>
            </BSW-MODULE-ENTRY-REF-CONDITIONAL>
          [!ENDIF!][!//
          [!IF "num:i($Channel) = '4'"!][!//
            <BSW-MODULE-ENTRY-REF-CONDITIONAL>
              <BSW-MODULE-ENTRY-REF DEST="BSW-MODULE-ENTRY">/Cdd_Pwm_TI_AM263x/Cdd_Pwm_ModuleEntry/Cdd_Pwm_G3_TzCh4Isr</BSW-MODULE-ENTRY-REF>
            </BSW-MODULE-ENTRY-REF-CONDITIONAL>
          [!ENDIF!][!//
          [!IF "num:i($Channel) = '5'"!][!//
            <BSW-MODULE-ENTRY-REF-CONDITIONAL>
              <BSW-MODULE-ENTRY-REF DEST="BSW-MODULE-ENTRY">/Cdd_Pwm_TI_AM263x/Cdd_Pwm_ModuleEntry/Cdd_Pwm_G3_TzCh5Isr</BSW-MODULE-ENTRY-REF>
            </BSW-MODULE-ENTRY-REF-CONDITIONAL>
          [!ENDIF!][!//
          [!IF "num:i($Channel) = '6'"!][!//
            <BSW-MODULE-ENTRY-REF-CONDITIONAL>
              <BSW-MODULE-ENTRY-REF DEST="BSW-MODULE-ENTRY">/Cdd_Pwm_TI_AM263x/Cdd_Pwm_ModuleEntry/Cdd_Pwm_G3_TzCh6Isr</BSW-MODULE-ENTRY-REF>
            </BSW-MODULE-ENTRY-REF-CONDITIONAL>
          [!ENDIF!][!//
          [!IF "num:i($Channel) = '7'"!][!//
            <BSW-MODULE-ENTRY-REF-CONDITIONAL>
              <BSW-MODULE-ENTRY-REF DEST="BSW-MODULE-ENTRY">/Cdd_Pwm_TI_AM263x/Cdd_Pwm_ModuleEntry/Cdd_Pwm_G3_TzCh7Isr</BSW-MODULE-ENTRY-REF>
            </BSW-MODULE-ENTRY-REF-CONDITIONAL>
          [!ENDIF!][!//
          [!IF "num:i($Channel) = '8'"!][!//
            <BSW-MODULE-ENTRY-REF-CONDITIONAL>
              <BSW-MODULE-ENTRY-REF DEST="BSW-MODULE-ENTRY">/Cdd_Pwm_TI_AM263x/Cdd_Pwm_ModuleEntry/Cdd_Pwm_G3_TzCh8Isr</BSW-MODULE-ENTRY-REF>
            </BSW-MODULE-ENTRY-REF-CONDITIONAL>
          [!ENDIF!][!//
          [!IF "num:i($Channel) = '9'"!][!//
            <BSW-MODULE-ENTRY-REF-CONDITIONAL>
              <BSW-MODULE-ENTRY-REF DEST="BSW-MODULE-ENTRY">/Cdd_Pwm_TI_AM263x/Cdd_Pwm_ModuleEntry/Cdd_Pwm_G3_TzCh9Isr</BSW-MODULE-ENTRY-REF>
            </BSW-MODULE-ENTRY-REF-CONDITIONAL>
          [!ENDIF!][!//
          [!ENDIF!][!//
          [!ENDLOOP!][!//
          [!IF "as:modconf('Cdd_Pwm')[1]/CddPwmConfigurationOfOptionalApis/CddPwmGetCounterApi"!][!//
            <BSW-MODULE-ENTRY-REF-CONDITIONAL>
              <BSW-MODULE-ENTRY-REF DEST="BSW-MODULE-ENTRY">/Cdd_Pwm_TI_AM263x/Cdd_Pwm_ModuleEntry/Cdd_Pwm_GetCounter</BSW-MODULE-ENTRY-REF>
            </BSW-MODULE-ENTRY-REF-CONDITIONAL>
          [!ENDIF!][!//
          [!IF "as:modconf('Cdd_Pwm')[1]/CddPwmConfigurationOfOptionalApis/CddPwmGetCounterStatus"!][!//
            <BSW-MODULE-ENTRY-REF-CONDITIONAL>
              <BSW-MODULE-ENTRY-REF DEST="BSW-MODULE-ENTRY">/Cdd_Pwm_TI_AM263x/Cdd_Pwm_ModuleEntry/Cdd_Pwm_GetCounterStatus</BSW-MODULE-ENTRY-REF>
            </BSW-MODULE-ENTRY-REF-CONDITIONAL>
          [!ENDIF!][!//
          [!IF "as:modconf('Cdd_Pwm')[1]/CddPwmConfigurationOfOptionalApis/CddPwmVersionInfoApi"!][!//
            <BSW-MODULE-ENTRY-REF-CONDITIONAL>
              <BSW-MODULE-ENTRY-REF DEST="BSW-MODULE-ENTRY">/Cdd_Pwm_TI_AM263x/Cdd_Pwm_ModuleEntry/Cdd_Pwm_GetVersionInfo</BSW-MODULE-ENTRY-REF>
            </BSW-MODULE-ENTRY-REF-CONDITIONAL>
          [!ENDIF!][!//
          [!IF "as:modconf('Cdd_Pwm')[1]/CddPwmGeneral/CddPwmHrSetPeriodDutyEnable"!][!//
            <BSW-MODULE-ENTRY-REF-CONDITIONAL>
              <BSW-MODULE-ENTRY-REF DEST="BSW-MODULE-ENTRY">/Cdd_Pwm_TI_AM263x/Cdd_Pwm_ModuleEntry/Cdd_Pwm_HrSetPeriodDutyPhase</BSW-MODULE-ENTRY-REF>
            </BSW-MODULE-ENTRY-REF-CONDITIONAL>
			<BSW-MODULE-ENTRY-REF-CONDITIONAL>
              <BSW-MODULE-ENTRY-REF DEST="BSW-MODULE-ENTRY">/Cdd_Pwm_TI_AM263x/Cdd_Pwm_ModuleEntry/Cdd_Pwm_HrSetPhaseShift</BSW-MODULE-ENTRY-REF>
            </BSW-MODULE-ENTRY-REF-CONDITIONAL>
			<BSW-MODULE-ENTRY-REF-CONDITIONAL>
              <BSW-MODULE-ENTRY-REF DEST="BSW-MODULE-ENTRY">/Cdd_Pwm_TI_AM263x/Cdd_Pwm_ModuleEntry/Cdd_Pwm_HrSetTimeBasePeriod</BSW-MODULE-ENTRY-REF>
            </BSW-MODULE-ENTRY-REF-CONDITIONAL>
			<BSW-MODULE-ENTRY-REF-CONDITIONAL>
              <BSW-MODULE-ENTRY-REF DEST="BSW-MODULE-ENTRY">/Cdd_Pwm_TI_AM263x/Cdd_Pwm_ModuleEntry/Cdd_Pwm_HrSetCounterCompareValue</BSW-MODULE-ENTRY-REF>
            </BSW-MODULE-ENTRY-REF-CONDITIONAL>
			<BSW-MODULE-ENTRY-REF-CONDITIONAL>
              <BSW-MODULE-ENTRY-REF DEST="BSW-MODULE-ENTRY">/Cdd_Pwm_TI_AM263x/Cdd_Pwm_ModuleEntry/Cdd_Pwm_HrSetXcmpRegValue</BSW-MODULE-ENTRY-REF>
            </BSW-MODULE-ENTRY-REF-CONDITIONAL>
          [!ENDIF!][!//
          [!IF "as:modconf('Cdd_Pwm')[1]/CddPwmGeneral/CddPwmHrSfoCalibrationEnable"!][!//
            <BSW-MODULE-ENTRY-REF-CONDITIONAL>
              <BSW-MODULE-ENTRY-REF DEST="BSW-MODULE-ENTRY">/Cdd_Pwm_TI_AM263x/Cdd_Pwm_ModuleEntry/Cdd_Pwm_HrSfoCalibration</BSW-MODULE-ENTRY-REF>
            </BSW-MODULE-ENTRY-REF-CONDITIONAL>
          [!ENDIF!][!//
          [!IF "as:modconf('Cdd_Pwm')[1]/CddPwmGeneral/CddPwmHrSfoStatusEnable"!][!//
            <BSW-MODULE-ENTRY-REF-CONDITIONAL>
              <BSW-MODULE-ENTRY-REF DEST="BSW-MODULE-ENTRY">/Cdd_Pwm_TI_AM263x/Cdd_Pwm_ModuleEntry/Cdd_Pwm_HrSfoStatus</BSW-MODULE-ENTRY-REF>
            </BSW-MODULE-ENTRY-REF-CONDITIONAL>
          [!ENDIF!][!//
            <BSW-MODULE-ENTRY-REF-CONDITIONAL>
              <BSW-MODULE-ENTRY-REF DEST="BSW-MODULE-ENTRY">/Cdd_Pwm_TI_AM263x/Cdd_Pwm_ModuleEntry/Cdd_Pwm_Init</BSW-MODULE-ENTRY-REF>
            </BSW-MODULE-ENTRY-REF-CONDITIONAL>
          [!IF "as:modconf('Cdd_Pwm')[1]/CddPwmConfigurationOfOptionalApis/CddPwmEnableRegisterReadbackApi"!][!//
            <BSW-MODULE-ENTRY-REF-CONDITIONAL>
              <BSW-MODULE-ENTRY-REF DEST="BSW-MODULE-ENTRY">/Cdd_Pwm_TI_AM263x/Cdd_Pwm_ModuleEntry/Cdd_Pwm_RegisterReadback</BSW-MODULE-ENTRY-REF>
            </BSW-MODULE-ENTRY-REF-CONDITIONAL>
          [!ENDIF!][!//
          [!IF "as:modconf('Cdd_Pwm')[1]/CddPwmConfigurationOfOptionalApis/CddPwmSetAbsoluteThreshold"!][!//
            <BSW-MODULE-ENTRY-REF-CONDITIONAL>
              <BSW-MODULE-ENTRY-REF DEST="BSW-MODULE-ENTRY">/Cdd_Pwm_TI_AM263x/Cdd_Pwm_ModuleEntry/Cdd_Pwm_SetAbsoluteThreshold</BSW-MODULE-ENTRY-REF>
            </BSW-MODULE-ENTRY-REF-CONDITIONAL>
          [!ENDIF!][!//
          [!IF "as:modconf('Cdd_Pwm')[1]/CddPwmConfigurationOfOptionalApis/CddPwmSetAdcTriggerApi"!][!//
            <BSW-MODULE-ENTRY-REF-CONDITIONAL>
              <BSW-MODULE-ENTRY-REF DEST="BSW-MODULE-ENTRY">/Cdd_Pwm_TI_AM263x/Cdd_Pwm_ModuleEntry/Cdd_Pwm_SetAdcTrigger</BSW-MODULE-ENTRY-REF>
            </BSW-MODULE-ENTRY-REF-CONDITIONAL>
          [!ENDIF!][!//
          [!IF "as:modconf('Cdd_Pwm')[1]/CddPwmConfigurationOfOptionalApis/CddPwmSetOutputToIdle"!][!//
            <BSW-MODULE-ENTRY-REF-CONDITIONAL>
              <BSW-MODULE-ENTRY-REF DEST="BSW-MODULE-ENTRY">/Cdd_Pwm_TI_AM263x/Cdd_Pwm_ModuleEntry/Cdd_Pwm_SetOutputToIdle</BSW-MODULE-ENTRY-REF>
            </BSW-MODULE-ENTRY-REF-CONDITIONAL>
          [!ENDIF!][!//
          [!IF "as:modconf('Cdd_Pwm')[1]/CddPwmConfigurationOfOptionalApis/CddPwmSetPeriodDutyPhase"!][!//
            <BSW-MODULE-ENTRY-REF-CONDITIONAL>
              <BSW-MODULE-ENTRY-REF DEST="BSW-MODULE-ENTRY">/Cdd_Pwm_TI_AM263x/Cdd_Pwm_ModuleEntry/Cdd_Pwm_SetPeriodDutyPhase</BSW-MODULE-ENTRY-REF>
            </BSW-MODULE-ENTRY-REF-CONDITIONAL>
			<BSW-MODULE-ENTRY-REF-CONDITIONAL>
              <BSW-MODULE-ENTRY-REF DEST="BSW-MODULE-ENTRY">/Cdd_Pwm_TI_AM263x/Cdd_Pwm_ModuleEntry/Cdd_Pwm_SetTimeBaseCounterMode</BSW-MODULE-ENTRY-REF>
            </BSW-MODULE-ENTRY-REF-CONDITIONAL>
			<BSW-MODULE-ENTRY-REF-CONDITIONAL>
              <BSW-MODULE-ENTRY-REF DEST="BSW-MODULE-ENTRY">/Cdd_Pwm_TI_AM263x/Cdd_Pwm_ModuleEntry/Cdd_Pwm_SetPhaseShift</BSW-MODULE-ENTRY-REF>
            </BSW-MODULE-ENTRY-REF-CONDITIONAL>
			<BSW-MODULE-ENTRY-REF-CONDITIONAL>
              <BSW-MODULE-ENTRY-REF DEST="BSW-MODULE-ENTRY">/Cdd_Pwm_TI_AM263x/Cdd_Pwm_ModuleEntry/Cdd_Pwm_SetTimeBasePeriod</BSW-MODULE-ENTRY-REF>
            </BSW-MODULE-ENTRY-REF-CONDITIONAL>
			<BSW-MODULE-ENTRY-REF-CONDITIONAL>
              <BSW-MODULE-ENTRY-REF DEST="BSW-MODULE-ENTRY">/Cdd_Pwm_TI_AM263x/Cdd_Pwm_ModuleEntry/Cdd_Pwm_SetCounterCompareValue</BSW-MODULE-ENTRY-REF>
            </BSW-MODULE-ENTRY-REF-CONDITIONAL>
			<BSW-MODULE-ENTRY-REF-CONDITIONAL>
              <BSW-MODULE-ENTRY-REF DEST="BSW-MODULE-ENTRY">/Cdd_Pwm_TI_AM263x/Cdd_Pwm_ModuleEntry/Cdd_Pwm_SetXcmpRegValue</BSW-MODULE-ENTRY-REF>
            </BSW-MODULE-ENTRY-REF-CONDITIONAL>
			<BSW-MODULE-ENTRY-REF-CONDITIONAL>
              <BSW-MODULE-ENTRY-REF DEST="BSW-MODULE-ENTRY">/Cdd_Pwm_TI_AM263x/Cdd_Pwm_ModuleEntry/Cdd_Pwm_SetXMinMaxRegValue</BSW-MODULE-ENTRY-REF>
            </BSW-MODULE-ENTRY-REF-CONDITIONAL>
			<BSW-MODULE-ENTRY-REF-CONDITIONAL>
              <BSW-MODULE-ENTRY-REF DEST="BSW-MODULE-ENTRY">/Cdd_Pwm_TI_AM263x/Cdd_Pwm_ModuleEntry/Cdd_Pwm_SetCmpShadowRegValue</BSW-MODULE-ENTRY-REF>
            </BSW-MODULE-ENTRY-REF-CONDITIONAL>
          [!ENDIF!][!//
          [!IF "as:modconf('Cdd_Pwm')[1]/CddPwmConfigurationOfOptionalApis/CddPwmSetPinAction"!][!//
            <BSW-MODULE-ENTRY-REF-CONDITIONAL>
              <BSW-MODULE-ENTRY-REF DEST="BSW-MODULE-ENTRY">/Cdd_Pwm_TI_AM263x/Cdd_Pwm_ModuleEntry/Cdd_Pwm_SetPinAction</BSW-MODULE-ENTRY-REF>
            </BSW-MODULE-ENTRY-REF-CONDITIONAL>
          [!ENDIF!][!//
          [!IF "as:modconf('Cdd_Pwm')[1]/CddPwmConfigurationOfOptionalApis/CddPwmSetRelativeThreshold"!][!//
            <BSW-MODULE-ENTRY-REF-CONDITIONAL>
              <BSW-MODULE-ENTRY-REF DEST="BSW-MODULE-ENTRY">/Cdd_Pwm_TI_AM263x/Cdd_Pwm_ModuleEntry/Cdd_Pwm_SetRelativeThreshold</BSW-MODULE-ENTRY-REF>
            </BSW-MODULE-ENTRY-REF-CONDITIONAL>
          [!ENDIF!][!//
            <BSW-MODULE-ENTRY-REF-CONDITIONAL>
              <BSW-MODULE-ENTRY-REF DEST="BSW-MODULE-ENTRY">/Cdd_Pwm_TI_AM263x/Cdd_Pwm_ModuleEntry/Cdd_Pwm_StartChannelCounter</BSW-MODULE-ENTRY-REF>
            </BSW-MODULE-ENTRY-REF-CONDITIONAL>
            <BSW-MODULE-ENTRY-REF-CONDITIONAL>
              <BSW-MODULE-ENTRY-REF DEST="BSW-MODULE-ENTRY">/Cdd_Pwm_TI_AM263x/Cdd_Pwm_ModuleEntry/Cdd_Pwm_StopChannelCounter</BSW-MODULE-ENTRY-REF>
            </BSW-MODULE-ENTRY-REF-CONDITIONAL>
          [!IF "as:modconf('Cdd_Pwm')[1]/CddPwmGeneral/CddPwmChannelTimerBaseSyncEnable"!][!//
            <BSW-MODULE-ENTRY-REF-CONDITIONAL>
              <BSW-MODULE-ENTRY-REF DEST="BSW-MODULE-ENTRY">/Cdd_Pwm_TI_AM263x/Cdd_Pwm_ModuleEntry/Cdd_Pwm_SyncDisable</BSW-MODULE-ENTRY-REF>
            </BSW-MODULE-ENTRY-REF-CONDITIONAL>
            <BSW-MODULE-ENTRY-REF-CONDITIONAL>
              <BSW-MODULE-ENTRY-REF DEST="BSW-MODULE-ENTRY">/Cdd_Pwm_TI_AM263x/Cdd_Pwm_ModuleEntry/Cdd_Pwm_SyncEnable</BSW-MODULE-ENTRY-REF>
            </BSW-MODULE-ENTRY-REF-CONDITIONAL>
          [!ENDIF!][!//
          [!IF "as:modconf('Cdd_Pwm')[1]/CddPwmGeneral/CddPwmTripZoneEnable"!][!//
            <BSW-MODULE-ENTRY-REF-CONDITIONAL>
              <BSW-MODULE-ENTRY-REF DEST="BSW-MODULE-ENTRY">/Cdd_Pwm_TI_AM263x/Cdd_Pwm_ModuleEntry/Cdd_Pwm_TzEventStatusClear</BSW-MODULE-ENTRY-REF>
            </BSW-MODULE-ENTRY-REF-CONDITIONAL>
            <BSW-MODULE-ENTRY-REF-CONDITIONAL>
              <BSW-MODULE-ENTRY-REF DEST="BSW-MODULE-ENTRY">/Cdd_Pwm_TI_AM263x/Cdd_Pwm_ModuleEntry/Cdd_Pwm_TzGetEventStatus</BSW-MODULE-ENTRY-REF>
            </BSW-MODULE-ENTRY-REF-CONDITIONAL>
            <BSW-MODULE-ENTRY-REF-CONDITIONAL>
              <BSW-MODULE-ENTRY-REF DEST="BSW-MODULE-ENTRY">/Cdd_Pwm_TI_AM263x/Cdd_Pwm_ModuleEntry/Cdd_Pwm_TzIntrDisable</BSW-MODULE-ENTRY-REF>
            </BSW-MODULE-ENTRY-REF-CONDITIONAL>
            <BSW-MODULE-ENTRY-REF-CONDITIONAL>
              <BSW-MODULE-ENTRY-REF DEST="BSW-MODULE-ENTRY">/Cdd_Pwm_TI_AM263x/Cdd_Pwm_ModuleEntry/Cdd_Pwm_TzIntrEnable</BSW-MODULE-ENTRY-REF>
            </BSW-MODULE-ENTRY-REF-CONDITIONAL>
            <BSW-MODULE-ENTRY-REF-CONDITIONAL>
              <BSW-MODULE-ENTRY-REF DEST="BSW-MODULE-ENTRY">/Cdd_Pwm_TI_AM263x/Cdd_Pwm_ModuleEntry/Cdd_Pwm_TzTripEventDisable</BSW-MODULE-ENTRY-REF>
            </BSW-MODULE-ENTRY-REF-CONDITIONAL>
            <BSW-MODULE-ENTRY-REF-CONDITIONAL>
              <BSW-MODULE-ENTRY-REF DEST="BSW-MODULE-ENTRY">/Cdd_Pwm_TI_AM263x/Cdd_Pwm_ModuleEntry/Cdd_Pwm_TzTripEventEnable</BSW-MODULE-ENTRY-REF>
            </BSW-MODULE-ENTRY-REF-CONDITIONAL>
          [!ENDIF!][!//
          </IMPLEMENTED-ENTRYS>
          <MODULE-ID>255</MODULE-ID>
        [!IF "as:modconf('Cdd_Pwm')[1]/CddPwmGeneral/CddPwmDevErrorDetect"!][!//
          <BSW-MODULE-DEPENDENCYS>
            <BSW-MODULE-DEPENDENCY UUID="921299a5-07e4-4bc5-a5e0-695e1b1c1ba5">
              <SHORT-NAME>Det</SHORT-NAME>
              <TARGET-MODULE-ID>15</TARGET-MODULE-ID>
              <TARGET-MODULE-REFS>
                <BSW-MODULE-DESCRIPTION-REF-CONDITIONAL>
                  <BSW-MODULE-DESCRIPTION-REF DEST="BSW-MODULE-DESCRIPTION">/AUTOSAR_Det/Det</BSW-MODULE-DESCRIPTION-REF>
                </BSW-MODULE-DESCRIPTION-REF-CONDITIONAL>
              </TARGET-MODULE-REFS>
            </BSW-MODULE-DEPENDENCY>
          </BSW-MODULE-DEPENDENCYS>
        [!ENDIF!][!//
          <INTERNAL-BEHAVIORS>
            <BSW-INTERNAL-BEHAVIOR UUID="08c7871b-5e99-4611-9a00-06a369df7e86">
              <SHORT-NAME>Cdd_Pwm_Behavior</SHORT-NAME>
              <EXCLUSIVE-AREAS>
                <EXCLUSIVE-AREA  UUID="4fc38db4-f789-41ad-baac-f5c8fc007188">
                  <SHORT-NAME>PWM_EXCLUSIVE_AREA_0</SHORT-NAME>
                </EXCLUSIVE-AREA>
              </EXCLUSIVE-AREAS>
              <ENTITYS>
              [!IF "as:modconf('Cdd_Pwm')[1]/CddPwmGeneral/CddPwmChopperEnable = 'true'"!][!//
                <BSW-CALLED-ENTITY UUID="2f19ea6d-3f8a-4187-963c-2c3d9f6fcbe3">
                  <SHORT-NAME>Cdd_Pwm_ChopperCfg</SHORT-NAME>
                  <CAN-ENTER-EXCLUSIVE-AREA-REFS>
                    <CAN-ENTER-EXCLUSIVE-AREA-REF DEST="EXCLUSIVE-AREA">/Cdd_Pwm_TI_AM263x/Cdd_Pwm/Cdd_Pwm_Behavior/PWM_EXCLUSIVE_AREA_0</CAN-ENTER-EXCLUSIVE-AREA-REF>
                  </CAN-ENTER-EXCLUSIVE-AREA-REFS>
                  <MINIMUM-START-INTERVAL>0.0</MINIMUM-START-INTERVAL>
                  <REENTRANCY-LEVEL>NON-REENTRANT</REENTRANCY-LEVEL>
                [!IF "as:modconf('Cdd_Pwm')[1]/CddPwmGeneral/CddPwmDevErrorDetect"!][!//
                  <CALL-POINTS>
                    <BSW-DIRECT-CALL-POINT>
                      <SHORT-NAME>Det</SHORT-NAME>
                      <CALLED-ENTRY-REF DEST="BSW-MODULE-ENTRY">/AUTOSAR_Det/BSWModuleEntry/Det_ReportError</CALLED-ENTRY-REF>
                    </BSW-DIRECT-CALL-POINT>
                  </CALL-POINTS>
                [!ENDIF!][!//
                  <IMPLEMENTED-ENTRY-REF DEST="BSW-MODULE-ENTRY">/Cdd_Pwm_TI_AM263x/Cdd_Pwm_ModuleEntry/Cdd_Pwm_ChopperCfg</IMPLEMENTED-ENTRY-REF>
                </BSW-CALLED-ENTITY>
                <BSW-CALLED-ENTITY UUID="79a4ab00-2aaa-497c-bbbd-5a8521e0aecb">
                  <SHORT-NAME>Cdd_Pwm_ChopperEnable</SHORT-NAME>
                  <CAN-ENTER-EXCLUSIVE-AREA-REFS>
                    <CAN-ENTER-EXCLUSIVE-AREA-REF DEST="EXCLUSIVE-AREA">/Cdd_Pwm_TI_AM263x/Cdd_Pwm/Cdd_Pwm_Behavior/PWM_EXCLUSIVE_AREA_0</CAN-ENTER-EXCLUSIVE-AREA-REF>
                  </CAN-ENTER-EXCLUSIVE-AREA-REFS>
                  <MINIMUM-START-INTERVAL>0.0</MINIMUM-START-INTERVAL>
                  <REENTRANCY-LEVEL>NON-REENTRANT</REENTRANCY-LEVEL>
                  <IMPLEMENTED-ENTRY-REF DEST="BSW-MODULE-ENTRY">/Cdd_Pwm_TI_AM263x/Cdd_Pwm_ModuleEntry/Cdd_Pwm_ChopperEnable</IMPLEMENTED-ENTRY-REF>
                </BSW-CALLED-ENTITY>
              [!ENDIF!][!//
              [!IF "as:modconf('Cdd_Pwm')[1]/CddPwmConfigurationOfOptionalApis/CddPwmGetCounterStatus"!][!//
                <BSW-CALLED-ENTITY UUID="2147401b-0cb1-468a-aee6-c61b5a63d01b">
                  <SHORT-NAME>Cdd_Pwm_ClearCounterStatus</SHORT-NAME>
                  <CAN-ENTER-EXCLUSIVE-AREA-REFS>
                    <CAN-ENTER-EXCLUSIVE-AREA-REF DEST="EXCLUSIVE-AREA">/Cdd_Pwm_TI_AM263x/Cdd_Pwm/Cdd_Pwm_Behavior/PWM_EXCLUSIVE_AREA_0</CAN-ENTER-EXCLUSIVE-AREA-REF>
                  </CAN-ENTER-EXCLUSIVE-AREA-REFS>
                  <MINIMUM-START-INTERVAL>0.0</MINIMUM-START-INTERVAL>
                  <REENTRANCY-LEVEL>NON-REENTRANT</REENTRANCY-LEVEL>
                  <IMPLEMENTED-ENTRY-REF DEST="BSW-MODULE-ENTRY">/Cdd_Pwm_TI_AM263x/Cdd_Pwm_ModuleEntry/Cdd_Pwm_ClearCounterStatus</IMPLEMENTED-ENTRY-REF>
                </BSW-CALLED-ENTITY>
              [!ENDIF!][!//
              [!IF "as:modconf('Cdd_Pwm')[1]/CddPwmConfigurationOfOptionalApis/CddPwmCounterComparatorCfg"!][!//
                <BSW-CALLED-ENTITY UUID="2d3f85a9-312d-417e-b5a9-de513df7ace0">
                  <SHORT-NAME>Cdd_Pwm_CounterComparatorCfg</SHORT-NAME>
                  <CAN-ENTER-EXCLUSIVE-AREA-REFS>
                    <CAN-ENTER-EXCLUSIVE-AREA-REF DEST="EXCLUSIVE-AREA">/Cdd_Pwm_TI_AM263x/Cdd_Pwm/Cdd_Pwm_Behavior/PWM_EXCLUSIVE_AREA_0</CAN-ENTER-EXCLUSIVE-AREA-REF>
                  </CAN-ENTER-EXCLUSIVE-AREA-REFS>
                  <MINIMUM-START-INTERVAL>0.0</MINIMUM-START-INTERVAL>
                  <REENTRANCY-LEVEL>NON-REENTRANT</REENTRANCY-LEVEL>
                  <IMPLEMENTED-ENTRY-REF DEST="BSW-MODULE-ENTRY">/Cdd_Pwm_TI_AM263x/Cdd_Pwm_ModuleEntry/Cdd_Pwm_CounterComparatorCfg</IMPLEMENTED-ENTRY-REF>
                </BSW-CALLED-ENTITY>
              [!ENDIF!][!//
              [!IF "as:modconf('Cdd_Pwm')[1]/CddPwmConfigurationOfOptionalApis/CddPwmDeInitApi"!][!//
                <BSW-CALLED-ENTITY UUID="ee090fdc-305c-4179-acae-f83a71c5c9d0">
                  <SHORT-NAME>Cdd_Pwm_DeInit</SHORT-NAME>
                  <MINIMUM-START-INTERVAL>0.0</MINIMUM-START-INTERVAL>
                  <REENTRANCY-LEVEL>NON-REENTRANT</REENTRANCY-LEVEL>
                  <IMPLEMENTED-ENTRY-REF DEST="BSW-MODULE-ENTRY">/Cdd_Pwm_TI_AM263x/Cdd_Pwm_ModuleEntry/Cdd_Pwm_DeInit</IMPLEMENTED-ENTRY-REF>
                </BSW-CALLED-ENTITY>
              [!ENDIF!][!//
              [!IF "as:modconf('Cdd_Pwm')[1]/CddPwmGeneral/CddPwmDeadBandEnable"!][!//
                <BSW-CALLED-ENTITY UUID="e925a02f-7bdd-441a-a4a4-2e9979e27ce3">
                  <SHORT-NAME>Cdd_Pwm_DeadbandBypass</SHORT-NAME>
                  <CAN-ENTER-EXCLUSIVE-AREA-REFS>
                    <CAN-ENTER-EXCLUSIVE-AREA-REF DEST="EXCLUSIVE-AREA">/Cdd_Pwm_TI_AM263x/Cdd_Pwm/Cdd_Pwm_Behavior/PWM_EXCLUSIVE_AREA_0</CAN-ENTER-EXCLUSIVE-AREA-REF>
                  </CAN-ENTER-EXCLUSIVE-AREA-REFS>
                  <MINIMUM-START-INTERVAL>0.0</MINIMUM-START-INTERVAL>
                  <REENTRANCY-LEVEL>NON-REENTRANT</REENTRANCY-LEVEL>
                  <IMPLEMENTED-ENTRY-REF DEST="BSW-MODULE-ENTRY">/Cdd_Pwm_TI_AM263x/Cdd_Pwm_ModuleEntry/Cdd_Pwm_DeadbandBypass</IMPLEMENTED-ENTRY-REF>
                </BSW-CALLED-ENTITY>
                <BSW-CALLED-ENTITY UUID="8f598232-02e3-45a0-9530-8ab5438d1985">
                  <SHORT-NAME>Cdd_Pwm_DeadbandCfg</SHORT-NAME>
                  <CAN-ENTER-EXCLUSIVE-AREA-REFS>
                    <CAN-ENTER-EXCLUSIVE-AREA-REF DEST="EXCLUSIVE-AREA">/Cdd_Pwm_TI_AM263x/Cdd_Pwm/Cdd_Pwm_Behavior/PWM_EXCLUSIVE_AREA_0</CAN-ENTER-EXCLUSIVE-AREA-REF>
                  </CAN-ENTER-EXCLUSIVE-AREA-REFS>
                  <MINIMUM-START-INTERVAL>0.0</MINIMUM-START-INTERVAL>
                  <REENTRANCY-LEVEL>NON-REENTRANT</REENTRANCY-LEVEL>
                [!IF "as:modconf('Cdd_Pwm')[1]/CddPwmGeneral/CddPwmDevErrorDetect"!][!//
                  <CALL-POINTS>
                    <BSW-DIRECT-CALL-POINT>
                      <SHORT-NAME>Det</SHORT-NAME>
                      <CALLED-ENTRY-REF DEST="BSW-MODULE-ENTRY">/AUTOSAR_Det/BSWModuleEntry/Det_ReportError</CALLED-ENTRY-REF>
                    </BSW-DIRECT-CALL-POINT>
                  </CALL-POINTS>
                [!ENDIF!][!//
                  <IMPLEMENTED-ENTRY-REF DEST="BSW-MODULE-ENTRY">/Cdd_Pwm_TI_AM263x/Cdd_Pwm_ModuleEntry/Cdd_Pwm_DeadbandCfg</IMPLEMENTED-ENTRY-REF>
                </BSW-CALLED-ENTITY>
				<BSW-CALLED-ENTITY UUID="7ac6d060-020a-49ed-8ca5-9f97240dbb13">
                  <SHORT-NAME>Cdd_Pwm_SetRisingEdgeDelay</SHORT-NAME>
                  <MINIMUM-START-INTERVAL>0.0</MINIMUM-START-INTERVAL>
                  <REENTRANCY-LEVEL>NON-REENTRANT</REENTRANCY-LEVEL>
                  <IMPLEMENTED-ENTRY-REF DEST="BSW-MODULE-ENTRY">/Cdd_Pwm_TI_AM263x/Cdd_Pwm_ModuleEntry/Cdd_Pwm_SetRisingEdgeDelay</IMPLEMENTED-ENTRY-REF>
                </BSW-CALLED-ENTITY>
				<BSW-CALLED-ENTITY UUID="64560048-2f58-46fb-996b-549f6da81bba">
                  <SHORT-NAME>Cdd_Pwm_SetFallingEdgeDelay</SHORT-NAME>
                  <MINIMUM-START-INTERVAL>0.0</MINIMUM-START-INTERVAL>
                  <REENTRANCY-LEVEL>NON-REENTRANT</REENTRANCY-LEVEL>
                  <IMPLEMENTED-ENTRY-REF DEST="BSW-MODULE-ENTRY">/Cdd_Pwm_TI_AM263x/Cdd_Pwm_ModuleEntry/Cdd_Pwm_SetFallingEdgeDelay</IMPLEMENTED-ENTRY-REF>
                </BSW-CALLED-ENTITY>
				<BSW-CALLED-ENTITY UUID="b86ddb8e-8750-4a49-8357-a98e1e1b1072">
                  <SHORT-NAME>Cdd_Pwm_SetMinDeadbandDelay</SHORT-NAME>
                  <MINIMUM-START-INTERVAL>0.0</MINIMUM-START-INTERVAL>
                  <REENTRANCY-LEVEL>NON-REENTRANT</REENTRANCY-LEVEL>
                  <IMPLEMENTED-ENTRY-REF DEST="BSW-MODULE-ENTRY">/Cdd_Pwm_TI_AM263x/Cdd_Pwm_ModuleEntry/Cdd_Pwm_SetMinDeadbandDelay</IMPLEMENTED-ENTRY-REF>
                </BSW-CALLED-ENTITY>
				<BSW-CALLED-ENTITY UUID="6f7c7049-ff07-4142-b50f-c25e6de09807">
                  <SHORT-NAME>Cdd_Pwm_HrSetRisingEdgeDelay</SHORT-NAME>
                  <MINIMUM-START-INTERVAL>0.0</MINIMUM-START-INTERVAL>
                  <REENTRANCY-LEVEL>NON-REENTRANT</REENTRANCY-LEVEL>
                  <IMPLEMENTED-ENTRY-REF DEST="BSW-MODULE-ENTRY">/Cdd_Pwm_TI_AM263x/Cdd_Pwm_ModuleEntry/Cdd_Pwm_HrSetRisingEdgeDelay</IMPLEMENTED-ENTRY-REF>
                </BSW-CALLED-ENTITY>
				<BSW-CALLED-ENTITY UUID="c218a2be-3247-4a22-8057-900dbda002cf">
                  <SHORT-NAME>Cdd_Pwm_HrSetFallingEdgeDelay</SHORT-NAME>
                  <MINIMUM-START-INTERVAL>0.0</MINIMUM-START-INTERVAL>
                  <REENTRANCY-LEVEL>NON-REENTRANT</REENTRANCY-LEVEL>
                  <IMPLEMENTED-ENTRY-REF DEST="BSW-MODULE-ENTRY">/Cdd_Pwm_TI_AM263x/Cdd_Pwm_ModuleEntry/Cdd_Pwm_HrSetFallingEdgeDelay</IMPLEMENTED-ENTRY-REF>
                </BSW-CALLED-ENTITY>
              [!ENDIF!][!//
              [!IF "as:modconf('Cdd_Pwm')[1]/CddPwmConfigurationOfOptionalApis/CddPwmNotificationSupported"!][!//
                <BSW-CALLED-ENTITY UUID="a46c805b-72a4-4caf-9813-20dd0623167a">
                  <SHORT-NAME>Cdd_Pwm_DisableNotification</SHORT-NAME>
                  <CAN-ENTER-EXCLUSIVE-AREA-REFS>
                    <CAN-ENTER-EXCLUSIVE-AREA-REF DEST="EXCLUSIVE-AREA">/Cdd_Pwm_TI_AM263x/Cdd_Pwm/Cdd_Pwm_Behavior/PWM_EXCLUSIVE_AREA_0</CAN-ENTER-EXCLUSIVE-AREA-REF>
                  </CAN-ENTER-EXCLUSIVE-AREA-REFS>
                  <MINIMUM-START-INTERVAL>0.0</MINIMUM-START-INTERVAL>
                  <REENTRANCY-LEVEL>NON-REENTRANT</REENTRANCY-LEVEL>
                [!IF "as:modconf('Cdd_Pwm')[1]/CddPwmGeneral/CddPwmDevErrorDetect"!][!//
                  <CALL-POINTS>
                    <BSW-DIRECT-CALL-POINT>
                      <SHORT-NAME>Det</SHORT-NAME>
                      <CALLED-ENTRY-REF DEST="BSW-MODULE-ENTRY">/AUTOSAR_Det/BSWModuleEntry/Det_ReportError</CALLED-ENTRY-REF>
                    </BSW-DIRECT-CALL-POINT>
                  </CALL-POINTS>
                [!ENDIF!][!//
                  <IMPLEMENTED-ENTRY-REF DEST="BSW-MODULE-ENTRY">/Cdd_Pwm_TI_AM263x/Cdd_Pwm_ModuleEntry/Cdd_Pwm_DisableNotification</IMPLEMENTED-ENTRY-REF>
                </BSW-CALLED-ENTITY>
                <BSW-CALLED-ENTITY UUID="e632936b-3213-4d7a-97e2-7194f9e88b58">
                  <SHORT-NAME>Cdd_Pwm_EnableNotification</SHORT-NAME>
                  <CAN-ENTER-EXCLUSIVE-AREA-REFS>
                    <CAN-ENTER-EXCLUSIVE-AREA-REF DEST="EXCLUSIVE-AREA">/Cdd_Pwm_TI_AM263x/Cdd_Pwm/Cdd_Pwm_Behavior/PWM_EXCLUSIVE_AREA_0</CAN-ENTER-EXCLUSIVE-AREA-REF>
                  </CAN-ENTER-EXCLUSIVE-AREA-REFS>
                  <MINIMUM-START-INTERVAL>0.0</MINIMUM-START-INTERVAL>
                  <REENTRANCY-LEVEL>NON-REENTRANT</REENTRANCY-LEVEL>
                [!IF "as:modconf('Cdd_Pwm')[1]/CddPwmGeneral/CddPwmDevErrorDetect"!][!//
                  <CALL-POINTS>
                    <BSW-DIRECT-CALL-POINT>
                      <SHORT-NAME>Det</SHORT-NAME>
                      <CALLED-ENTRY-REF DEST="BSW-MODULE-ENTRY">/AUTOSAR_Det/BSWModuleEntry/Det_ReportError</CALLED-ENTRY-REF>
                    </BSW-DIRECT-CALL-POINT>
                  </CALL-POINTS>
                [!ENDIF!][!//
                  <IMPLEMENTED-ENTRY-REF DEST="BSW-MODULE-ENTRY">/Cdd_Pwm_TI_AM263x/Cdd_Pwm_ModuleEntry/Cdd_Pwm_EnableNotification</IMPLEMENTED-ENTRY-REF>
                </BSW-CALLED-ENTITY>
              [!ENDIF!][!//
                <BSW-CALLED-ENTITY UUID="87ef94a7-799d-4ebf-9414-4eb855319174">
                  <SHORT-NAME>Cdd_Pwm_EtGetEventCount</SHORT-NAME>
                  <MINIMUM-START-INTERVAL>0.0</MINIMUM-START-INTERVAL>
                  <REENTRANCY-LEVEL>SINGLE-CORE-REENTRANT</REENTRANCY-LEVEL>
                  <IMPLEMENTED-ENTRY-REF DEST="BSW-MODULE-ENTRY">/Cdd_Pwm_TI_AM263x/Cdd_Pwm_ModuleEntry/Cdd_Pwm_EtGetEventCount</IMPLEMENTED-ENTRY-REF>
                </BSW-CALLED-ENTITY>
                <BSW-CALLED-ENTITY UUID="094280f1-1e97-4f34-b927-737befc554cf">
                  <SHORT-NAME>Cdd_Pwm_EtIntrClear</SHORT-NAME>
                  <CAN-ENTER-EXCLUSIVE-AREA-REFS>
                    <CAN-ENTER-EXCLUSIVE-AREA-REF DEST="EXCLUSIVE-AREA">/Cdd_Pwm_TI_AM263x/Cdd_Pwm/Cdd_Pwm_Behavior/PWM_EXCLUSIVE_AREA_0</CAN-ENTER-EXCLUSIVE-AREA-REF>
                  </CAN-ENTER-EXCLUSIVE-AREA-REFS>
                  <MINIMUM-START-INTERVAL>0.0</MINIMUM-START-INTERVAL>
                  <REENTRANCY-LEVEL>NON-REENTRANT</REENTRANCY-LEVEL>
                  <IMPLEMENTED-ENTRY-REF DEST="BSW-MODULE-ENTRY">/Cdd_Pwm_TI_AM263x/Cdd_Pwm_ModuleEntry/Cdd_Pwm_EtIntrClear</IMPLEMENTED-ENTRY-REF>
                </BSW-CALLED-ENTITY>
                <BSW-CALLED-ENTITY UUID="0dc7c869-7dd4-4ddd-97ee-970f8a05459f">
                  <SHORT-NAME>Cdd_Pwm_EtIntrStatus</SHORT-NAME>
                  <CAN-ENTER-EXCLUSIVE-AREA-REFS>
                    <CAN-ENTER-EXCLUSIVE-AREA-REF DEST="EXCLUSIVE-AREA">/Cdd_Pwm_TI_AM263x/Cdd_Pwm/Cdd_Pwm_Behavior/PWM_EXCLUSIVE_AREA_0</CAN-ENTER-EXCLUSIVE-AREA-REF>
                  </CAN-ENTER-EXCLUSIVE-AREA-REFS>
                  <MINIMUM-START-INTERVAL>0.0</MINIMUM-START-INTERVAL>
                  <REENTRANCY-LEVEL>SINGLE-CORE-REENTRANT</REENTRANCY-LEVEL>
                  <IMPLEMENTED-ENTRY-REF DEST="BSW-MODULE-ENTRY">/Cdd_Pwm_TI_AM263x/Cdd_Pwm_ModuleEntry/Cdd_Pwm_EtIntrStatus</IMPLEMENTED-ENTRY-REF>
                </BSW-CALLED-ENTITY>
              [!LOOP "as:modconf('Cdd_Pwm')[1]/CddPwmConfigSet/*/CddPwmChannel/*"!]
              [!VAR "CddGroup" = "(num:i(substring-after(CddPwmGroupUnit,'CDD_PWM_CONTROLSS_G')))"!]
              [!VAR "CddChannel" = "(num:i(substring-after(CddPwmHwChannel,'CDD_PWM_CHANNEL_')))"!]
              [!IF "num:i($CddGroup) = '0'"!][!//
              [!IF "num:i($CddChannel) = '0'"!][!//
                <BSW-INTERRUPT-ENTITY UUID="6e81150d-4167-46a0-8ebe-3ae8210e9ba9">
                  <SHORT-NAME>Cdd_Pwm_G0_Ch0Isr</SHORT-NAME>
                  <MINIMUM-START-INTERVAL>0.0</MINIMUM-START-INTERVAL>
                  <REENTRANCY-LEVEL>NON-REENTRANT</REENTRANCY-LEVEL>
                  <IMPLEMENTED-ENTRY-REF DEST="BSW-MODULE-ENTRY">/Cdd_Pwm_TI_AM263x/Cdd_Pwm_ModuleEntry/Cdd_Pwm_G0_Ch0Isr</IMPLEMENTED-ENTRY-REF>
                [!IF "as:modconf('Cdd_Pwm')[1]/CddPwmGeneral/CddPwmTypeofInterruptFunction = 'CDD_PWM_ISR_CAT2'"!][!//
                  <INTERRUPT-CATEGORY>CAT-2</INTERRUPT-CATEGORY>
                [!ELSE!][!//
                  <INTERRUPT-CATEGORY>CAT-1</INTERRUPT-CATEGORY>
                [!ENDIF!][!//
                  <INTERRUPT-SOURCE>Hardware</INTERRUPT-SOURCE>
                </BSW-INTERRUPT-ENTITY>
              [!ENDIF!][!//
              [!IF "num:i($CddChannel) = '10'"!][!//
                <BSW-INTERRUPT-ENTITY UUID="3d116237-3312-4c7e-9583-8e11d1f08fac">
                  <SHORT-NAME>Cdd_Pwm_G0_Ch10Isr</SHORT-NAME>
                  <MINIMUM-START-INTERVAL>0.0</MINIMUM-START-INTERVAL>
                  <REENTRANCY-LEVEL>NON-REENTRANT</REENTRANCY-LEVEL>
                  <IMPLEMENTED-ENTRY-REF DEST="BSW-MODULE-ENTRY">/Cdd_Pwm_TI_AM263x/Cdd_Pwm_ModuleEntry/Cdd_Pwm_G0_Ch10Isr</IMPLEMENTED-ENTRY-REF>
                [!IF "as:modconf('Cdd_Pwm')[1]/CddPwmGeneral/CddPwmTypeofInterruptFunction = 'CDD_PWM_ISR_CAT2'"!][!//
                  <INTERRUPT-CATEGORY>CAT-2</INTERRUPT-CATEGORY>
                [!ELSE!][!//
                  <INTERRUPT-CATEGORY>CAT-1</INTERRUPT-CATEGORY>
                [!ENDIF!][!//
                  <INTERRUPT-SOURCE>Hardware</INTERRUPT-SOURCE>
                </BSW-INTERRUPT-ENTITY>
              [!ENDIF!][!//
              [!IF "num:i($CddChannel) = '11'"!][!//
                <BSW-INTERRUPT-ENTITY UUID="a31ac20c-9432-4185-a771-2290ba612bc3">
                  <SHORT-NAME>Cdd_Pwm_G0_Ch11Isr</SHORT-NAME>
                  <MINIMUM-START-INTERVAL>0.0</MINIMUM-START-INTERVAL>
                  <REENTRANCY-LEVEL>NON-REENTRANT</REENTRANCY-LEVEL>
                  <IMPLEMENTED-ENTRY-REF DEST="BSW-MODULE-ENTRY">/Cdd_Pwm_TI_AM263x/Cdd_Pwm_ModuleEntry/Cdd_Pwm_G0_Ch11Isr</IMPLEMENTED-ENTRY-REF>
                [!IF "as:modconf('Cdd_Pwm')[1]/CddPwmGeneral/CddPwmTypeofInterruptFunction = 'CDD_PWM_ISR_CAT2'"!][!//
                  <INTERRUPT-CATEGORY>CAT-2</INTERRUPT-CATEGORY>
                [!ELSE!][!//
                  <INTERRUPT-CATEGORY>CAT-1</INTERRUPT-CATEGORY>
                [!ENDIF!][!//
                  <INTERRUPT-SOURCE>Hardware</INTERRUPT-SOURCE>
                </BSW-INTERRUPT-ENTITY>
              [!ENDIF!][!//
              [!IF "num:i($CddChannel) = '12'"!][!//
                <BSW-INTERRUPT-ENTITY UUID="81e93e0e-b638-4939-a430-596f16f35989">
                  <SHORT-NAME>Cdd_Pwm_G0_Ch12Isr</SHORT-NAME>
                  <MINIMUM-START-INTERVAL>0.0</MINIMUM-START-INTERVAL>
                  <REENTRANCY-LEVEL>NON-REENTRANT</REENTRANCY-LEVEL>
                  <IMPLEMENTED-ENTRY-REF DEST="BSW-MODULE-ENTRY">/Cdd_Pwm_TI_AM263x/Cdd_Pwm_ModuleEntry/Cdd_Pwm_G0_Ch12Isr</IMPLEMENTED-ENTRY-REF>
                [!IF "as:modconf('Cdd_Pwm')[1]/CddPwmGeneral/CddPwmTypeofInterruptFunction = 'CDD_PWM_ISR_CAT2'"!][!//
                  <INTERRUPT-CATEGORY>CAT-2</INTERRUPT-CATEGORY>
                [!ELSE!][!//
                  <INTERRUPT-CATEGORY>CAT-1</INTERRUPT-CATEGORY>
                [!ENDIF!][!//
                  <INTERRUPT-SOURCE>Hardware</INTERRUPT-SOURCE>
                </BSW-INTERRUPT-ENTITY>
              [!ENDIF!][!//
              [!IF "num:i($CddChannel) = '13'"!][!//
                <BSW-INTERRUPT-ENTITY UUID="dd5fd0dc-2897-4359-bf9d-c5d56f70a537">
                  <SHORT-NAME>Cdd_Pwm_G0_Ch13Isr</SHORT-NAME>
                  <MINIMUM-START-INTERVAL>0.0</MINIMUM-START-INTERVAL>
                  <REENTRANCY-LEVEL>NON-REENTRANT</REENTRANCY-LEVEL>
                  <IMPLEMENTED-ENTRY-REF DEST="BSW-MODULE-ENTRY">/Cdd_Pwm_TI_AM263x/Cdd_Pwm_ModuleEntry/Cdd_Pwm_G0_Ch13Isr</IMPLEMENTED-ENTRY-REF>
                [!IF "as:modconf('Cdd_Pwm')[1]/CddPwmGeneral/CddPwmTypeofInterruptFunction = 'CDD_PWM_ISR_CAT2'"!][!//
                  <INTERRUPT-CATEGORY>CAT-2</INTERRUPT-CATEGORY>
                [!ELSE!][!//
                  <INTERRUPT-CATEGORY>CAT-1</INTERRUPT-CATEGORY>
                [!ENDIF!][!//
                  <INTERRUPT-SOURCE>Hardware</INTERRUPT-SOURCE>
                </BSW-INTERRUPT-ENTITY>
              [!ENDIF!][!//
              [!IF "num:i($CddChannel) = '14'"!][!//
                <BSW-INTERRUPT-ENTITY UUID="e9c29530-a4b6-4da5-87f0-83b8098d41ec">
                  <SHORT-NAME>Cdd_Pwm_G0_Ch14Isr</SHORT-NAME>
                  <MINIMUM-START-INTERVAL>0.0</MINIMUM-START-INTERVAL>
                  <REENTRANCY-LEVEL>NON-REENTRANT</REENTRANCY-LEVEL>
                  <IMPLEMENTED-ENTRY-REF DEST="BSW-MODULE-ENTRY">/Cdd_Pwm_TI_AM263x/Cdd_Pwm_ModuleEntry/Cdd_Pwm_G0_Ch14Isr</IMPLEMENTED-ENTRY-REF>
                [!IF "as:modconf('Cdd_Pwm')[1]/CddPwmGeneral/CddPwmTypeofInterruptFunction = 'CDD_PWM_ISR_CAT2'"!][!//
                  <INTERRUPT-CATEGORY>CAT-2</INTERRUPT-CATEGORY>
                [!ELSE!][!//
                  <INTERRUPT-CATEGORY>CAT-1</INTERRUPT-CATEGORY>
                [!ENDIF!][!//
                  <INTERRUPT-SOURCE>Hardware</INTERRUPT-SOURCE>
                </BSW-INTERRUPT-ENTITY>
              [!ENDIF!][!//
              [!IF "num:i($CddChannel) = '15'"!][!//
                <BSW-INTERRUPT-ENTITY UUID="f27660b0-f846-4686-a328-0f3f2a8de408">
                  <SHORT-NAME>Cdd_Pwm_G0_Ch15Isr</SHORT-NAME>
                  <MINIMUM-START-INTERVAL>0.0</MINIMUM-START-INTERVAL>
                  <REENTRANCY-LEVEL>NON-REENTRANT</REENTRANCY-LEVEL>
                  <IMPLEMENTED-ENTRY-REF DEST="BSW-MODULE-ENTRY">/Cdd_Pwm_TI_AM263x/Cdd_Pwm_ModuleEntry/Cdd_Pwm_G0_Ch15Isr</IMPLEMENTED-ENTRY-REF>
                [!IF "as:modconf('Cdd_Pwm')[1]/CddPwmGeneral/CddPwmTypeofInterruptFunction = 'CDD_PWM_ISR_CAT2'"!][!//
                  <INTERRUPT-CATEGORY>CAT-2</INTERRUPT-CATEGORY>
                [!ELSE!][!//
                  <INTERRUPT-CATEGORY>CAT-1</INTERRUPT-CATEGORY>
                [!ENDIF!][!//
                  <INTERRUPT-SOURCE>Hardware</INTERRUPT-SOURCE>
                </BSW-INTERRUPT-ENTITY>
              [!ENDIF!][!//
              [!IF "num:i($CddChannel) = '16'"!][!//
                <BSW-INTERRUPT-ENTITY UUID="60c2dddf-2c6a-4b23-91d6-3c3b20cdedbc">
                  <SHORT-NAME>Cdd_Pwm_G0_Ch16Isr</SHORT-NAME>
                  <MINIMUM-START-INTERVAL>0.0</MINIMUM-START-INTERVAL>
                  <REENTRANCY-LEVEL>NON-REENTRANT</REENTRANCY-LEVEL>
                  <IMPLEMENTED-ENTRY-REF DEST="BSW-MODULE-ENTRY">/Cdd_Pwm_TI_AM263x/Cdd_Pwm_ModuleEntry/Cdd_Pwm_G0_Ch16Isr</IMPLEMENTED-ENTRY-REF>
                [!IF "as:modconf('Cdd_Pwm')[1]/CddPwmGeneral/CddPwmTypeofInterruptFunction = 'CDD_PWM_ISR_CAT2'"!][!//
                  <INTERRUPT-CATEGORY>CAT-2</INTERRUPT-CATEGORY>
                [!ELSE!][!//
                  <INTERRUPT-CATEGORY>CAT-1</INTERRUPT-CATEGORY>
                [!ENDIF!][!//
                  <INTERRUPT-SOURCE>Hardware</INTERRUPT-SOURCE>
                </BSW-INTERRUPT-ENTITY>
              [!ENDIF!][!//
              [!IF "num:i($CddChannel) = '17'"!][!//
                <BSW-INTERRUPT-ENTITY UUID="d3ac6a35-0d02-4428-a1aa-6eb45c4701d1">
                  <SHORT-NAME>Cdd_Pwm_G0_Ch17Isr</SHORT-NAME>
                  <MINIMUM-START-INTERVAL>0.0</MINIMUM-START-INTERVAL>
                  <REENTRANCY-LEVEL>NON-REENTRANT</REENTRANCY-LEVEL>
                  <IMPLEMENTED-ENTRY-REF DEST="BSW-MODULE-ENTRY">/Cdd_Pwm_TI_AM263x/Cdd_Pwm_ModuleEntry/Cdd_Pwm_G0_Ch17Isr</IMPLEMENTED-ENTRY-REF>
                [!IF "as:modconf('Cdd_Pwm')[1]/CddPwmGeneral/CddPwmTypeofInterruptFunction = 'CDD_PWM_ISR_CAT2'"!][!//
                  <INTERRUPT-CATEGORY>CAT-2</INTERRUPT-CATEGORY>
                [!ELSE!][!//
                  <INTERRUPT-CATEGORY>CAT-1</INTERRUPT-CATEGORY>
                [!ENDIF!][!//
                  <INTERRUPT-SOURCE>Hardware</INTERRUPT-SOURCE>
                </BSW-INTERRUPT-ENTITY>
              [!ENDIF!][!//
              [!IF "num:i($CddChannel) = '18'"!][!//
                <BSW-INTERRUPT-ENTITY UUID="47f8768c-308a-4e56-8042-266e3d054948">
                  <SHORT-NAME>Cdd_Pwm_G0_Ch18Isr</SHORT-NAME>
                  <MINIMUM-START-INTERVAL>0.0</MINIMUM-START-INTERVAL>
                  <REENTRANCY-LEVEL>NON-REENTRANT</REENTRANCY-LEVEL>
                  <IMPLEMENTED-ENTRY-REF DEST="BSW-MODULE-ENTRY">/Cdd_Pwm_TI_AM263x/Cdd_Pwm_ModuleEntry/Cdd_Pwm_G0_Ch18Isr</IMPLEMENTED-ENTRY-REF>
                [!IF "as:modconf('Cdd_Pwm')[1]/CddPwmGeneral/CddPwmTypeofInterruptFunction = 'CDD_PWM_ISR_CAT2'"!][!//
                  <INTERRUPT-CATEGORY>CAT-2</INTERRUPT-CATEGORY>
                [!ELSE!][!//
                  <INTERRUPT-CATEGORY>CAT-1</INTERRUPT-CATEGORY>
                [!ENDIF!][!//
                  <INTERRUPT-SOURCE>Hardware</INTERRUPT-SOURCE>
                </BSW-INTERRUPT-ENTITY>
              [!ENDIF!][!//
              [!IF "num:i($CddChannel) = '19'"!][!//
                <BSW-INTERRUPT-ENTITY UUID="ad2d763e-6f06-46a3-a781-61115c9f3047">
                  <SHORT-NAME>Cdd_Pwm_G0_Ch19Isr</SHORT-NAME>
                  <MINIMUM-START-INTERVAL>0.0</MINIMUM-START-INTERVAL>
                  <REENTRANCY-LEVEL>NON-REENTRANT</REENTRANCY-LEVEL>
                  <IMPLEMENTED-ENTRY-REF DEST="BSW-MODULE-ENTRY">/Cdd_Pwm_TI_AM263x/Cdd_Pwm_ModuleEntry/Cdd_Pwm_G0_Ch19Isr</IMPLEMENTED-ENTRY-REF>
                [!IF "as:modconf('Cdd_Pwm')[1]/CddPwmGeneral/CddPwmTypeofInterruptFunction = 'CDD_PWM_ISR_CAT2'"!][!//
                  <INTERRUPT-CATEGORY>CAT-2</INTERRUPT-CATEGORY>
                [!ELSE!][!//
                  <INTERRUPT-CATEGORY>CAT-1</INTERRUPT-CATEGORY>
                [!ENDIF!][!//
                  <INTERRUPT-SOURCE>Hardware</INTERRUPT-SOURCE>
                </BSW-INTERRUPT-ENTITY>
              [!ENDIF!][!//
              [!IF "num:i($CddChannel) = '1'"!][!//
                <BSW-INTERRUPT-ENTITY UUID="ac14fa3b-a94f-4fcc-97ce-afe493122c22">
                  <SHORT-NAME>Cdd_Pwm_G0_Ch1Isr</SHORT-NAME>
                  <MINIMUM-START-INTERVAL>0.0</MINIMUM-START-INTERVAL>
                  <REENTRANCY-LEVEL>NON-REENTRANT</REENTRANCY-LEVEL>
                  <IMPLEMENTED-ENTRY-REF DEST="BSW-MODULE-ENTRY">/Cdd_Pwm_TI_AM263x/Cdd_Pwm_ModuleEntry/Cdd_Pwm_G0_Ch1Isr</IMPLEMENTED-ENTRY-REF>
                [!IF "as:modconf('Cdd_Pwm')[1]/CddPwmGeneral/CddPwmTypeofInterruptFunction = 'CDD_PWM_ISR_CAT2'"!][!//
                  <INTERRUPT-CATEGORY>CAT-2</INTERRUPT-CATEGORY>
                [!ELSE!][!//
                  <INTERRUPT-CATEGORY>CAT-1</INTERRUPT-CATEGORY>
                [!ENDIF!][!//
                  <INTERRUPT-SOURCE>Hardware</INTERRUPT-SOURCE>
                </BSW-INTERRUPT-ENTITY>
              [!ENDIF!][!//
              [!IF "num:i($CddChannel) = '20'"!][!//
                <BSW-INTERRUPT-ENTITY UUID="f50d9fb5-a36d-487b-a9b4-a43ba754fb0e">
                  <SHORT-NAME>Cdd_Pwm_G0_Ch20Isr</SHORT-NAME>
                  <MINIMUM-START-INTERVAL>0.0</MINIMUM-START-INTERVAL>
                  <REENTRANCY-LEVEL>NON-REENTRANT</REENTRANCY-LEVEL>
                  <IMPLEMENTED-ENTRY-REF DEST="BSW-MODULE-ENTRY">/Cdd_Pwm_TI_AM263x/Cdd_Pwm_ModuleEntry/Cdd_Pwm_G0_Ch20Isr</IMPLEMENTED-ENTRY-REF>
                [!IF "as:modconf('Cdd_Pwm')[1]/CddPwmGeneral/CddPwmTypeofInterruptFunction = 'CDD_PWM_ISR_CAT2'"!][!//
                  <INTERRUPT-CATEGORY>CAT-2</INTERRUPT-CATEGORY>
                [!ELSE!][!//
                  <INTERRUPT-CATEGORY>CAT-1</INTERRUPT-CATEGORY>
                [!ENDIF!][!//
                  <INTERRUPT-SOURCE>Hardware</INTERRUPT-SOURCE>
                </BSW-INTERRUPT-ENTITY>
              [!ENDIF!][!//
              [!IF "num:i($CddChannel) = '21'"!][!//
                <BSW-INTERRUPT-ENTITY UUID="aa1dad4e-2fe8-4f51-9813-d8894cd92070">
                  <SHORT-NAME>Cdd_Pwm_G0_Ch21Isr</SHORT-NAME>
                  <MINIMUM-START-INTERVAL>0.0</MINIMUM-START-INTERVAL>
                  <REENTRANCY-LEVEL>NON-REENTRANT</REENTRANCY-LEVEL>
                  <IMPLEMENTED-ENTRY-REF DEST="BSW-MODULE-ENTRY">/Cdd_Pwm_TI_AM263x/Cdd_Pwm_ModuleEntry/Cdd_Pwm_G0_Ch21Isr</IMPLEMENTED-ENTRY-REF>
                [!IF "as:modconf('Cdd_Pwm')[1]/CddPwmGeneral/CddPwmTypeofInterruptFunction = 'CDD_PWM_ISR_CAT2'"!][!//
                  <INTERRUPT-CATEGORY>CAT-2</INTERRUPT-CATEGORY>
                [!ELSE!][!//
                  <INTERRUPT-CATEGORY>CAT-1</INTERRUPT-CATEGORY>
                [!ENDIF!][!//
                  <INTERRUPT-SOURCE>Hardware</INTERRUPT-SOURCE>
                </BSW-INTERRUPT-ENTITY>
              [!ENDIF!][!//
              [!IF "num:i($CddChannel) = '22'"!][!//
                <BSW-INTERRUPT-ENTITY UUID="2415e2e8-53b0-4401-aa58-5054e58849fe">
                  <SHORT-NAME>Cdd_Pwm_G0_Ch22Isr</SHORT-NAME>
                  <MINIMUM-START-INTERVAL>0.0</MINIMUM-START-INTERVAL>
                  <REENTRANCY-LEVEL>NON-REENTRANT</REENTRANCY-LEVEL>
                  <IMPLEMENTED-ENTRY-REF DEST="BSW-MODULE-ENTRY">/Cdd_Pwm_TI_AM263x/Cdd_Pwm_ModuleEntry/Cdd_Pwm_G0_Ch22Isr</IMPLEMENTED-ENTRY-REF>
                [!IF "as:modconf('Cdd_Pwm')[1]/CddPwmGeneral/CddPwmTypeofInterruptFunction = 'CDD_PWM_ISR_CAT2'"!][!//
                  <INTERRUPT-CATEGORY>CAT-2</INTERRUPT-CATEGORY>
                [!ELSE!][!//
                  <INTERRUPT-CATEGORY>CAT-1</INTERRUPT-CATEGORY>
                [!ENDIF!][!//
                  <INTERRUPT-SOURCE>Hardware</INTERRUPT-SOURCE>
                </BSW-INTERRUPT-ENTITY>
              [!ENDIF!][!//
              [!IF "num:i($CddChannel) = '23'"!][!//
                <BSW-INTERRUPT-ENTITY UUID="bfa60bb9-88c0-4163-9e99-243f38b91850">
                  <SHORT-NAME>Cdd_Pwm_G0_Ch23Isr</SHORT-NAME>
                  <MINIMUM-START-INTERVAL>0.0</MINIMUM-START-INTERVAL>
                  <REENTRANCY-LEVEL>NON-REENTRANT</REENTRANCY-LEVEL>
                  <IMPLEMENTED-ENTRY-REF DEST="BSW-MODULE-ENTRY">/Cdd_Pwm_TI_AM263x/Cdd_Pwm_ModuleEntry/Cdd_Pwm_G0_Ch23Isr</IMPLEMENTED-ENTRY-REF>
                [!IF "as:modconf('Cdd_Pwm')[1]/CddPwmGeneral/CddPwmTypeofInterruptFunction = 'CDD_PWM_ISR_CAT2'"!][!//
                  <INTERRUPT-CATEGORY>CAT-2</INTERRUPT-CATEGORY>
                [!ELSE!][!//
                  <INTERRUPT-CATEGORY>CAT-1</INTERRUPT-CATEGORY>
                [!ENDIF!][!//
                  <INTERRUPT-SOURCE>Hardware</INTERRUPT-SOURCE>
                </BSW-INTERRUPT-ENTITY>
              [!ENDIF!][!//
              [!IF "num:i($CddChannel) = '24'"!][!//
                <BSW-INTERRUPT-ENTITY UUID="a9718db4-5100-4cf0-bfd9-ea475df51ab9">
                  <SHORT-NAME>Cdd_Pwm_G0_Ch24Isr</SHORT-NAME>
                  <MINIMUM-START-INTERVAL>0.0</MINIMUM-START-INTERVAL>
                  <REENTRANCY-LEVEL>NON-REENTRANT</REENTRANCY-LEVEL>
                  <IMPLEMENTED-ENTRY-REF DEST="BSW-MODULE-ENTRY">/Cdd_Pwm_TI_AM263x/Cdd_Pwm_ModuleEntry/Cdd_Pwm_G0_Ch24Isr</IMPLEMENTED-ENTRY-REF>
                [!IF "as:modconf('Cdd_Pwm')[1]/CddPwmGeneral/CddPwmTypeofInterruptFunction = 'CDD_PWM_ISR_CAT2'"!][!//
                  <INTERRUPT-CATEGORY>CAT-2</INTERRUPT-CATEGORY>
                [!ELSE!][!//
                  <INTERRUPT-CATEGORY>CAT-1</INTERRUPT-CATEGORY>
                [!ENDIF!][!//
                  <INTERRUPT-SOURCE>Hardware</INTERRUPT-SOURCE>
                </BSW-INTERRUPT-ENTITY>
              [!ENDIF!][!//
              [!IF "num:i($CddChannel) = '25'"!][!//
                <BSW-INTERRUPT-ENTITY UUID="be954146-1b01-44b9-854f-980c5aa6d8ae">
                  <SHORT-NAME>Cdd_Pwm_G0_Ch25Isr</SHORT-NAME>
                  <MINIMUM-START-INTERVAL>0.0</MINIMUM-START-INTERVAL>
                  <REENTRANCY-LEVEL>NON-REENTRANT</REENTRANCY-LEVEL>
                  <IMPLEMENTED-ENTRY-REF DEST="BSW-MODULE-ENTRY">/Cdd_Pwm_TI_AM263x/Cdd_Pwm_ModuleEntry/Cdd_Pwm_G0_Ch25Isr</IMPLEMENTED-ENTRY-REF>
                [!IF "as:modconf('Cdd_Pwm')[1]/CddPwmGeneral/CddPwmTypeofInterruptFunction = 'CDD_PWM_ISR_CAT2'"!][!//
                  <INTERRUPT-CATEGORY>CAT-2</INTERRUPT-CATEGORY>
                [!ELSE!][!//
                  <INTERRUPT-CATEGORY>CAT-1</INTERRUPT-CATEGORY>
                [!ENDIF!][!//
                  <INTERRUPT-SOURCE>Hardware</INTERRUPT-SOURCE>
                </BSW-INTERRUPT-ENTITY>
              [!ENDIF!][!//
              [!IF "num:i($CddChannel) = '26'"!][!//
                <BSW-INTERRUPT-ENTITY UUID="f7d9f2d4-5de4-4292-9fc1-33e016e22d83">
                  <SHORT-NAME>Cdd_Pwm_G0_Ch26Isr</SHORT-NAME>
                  <MINIMUM-START-INTERVAL>0.0</MINIMUM-START-INTERVAL>
                  <REENTRANCY-LEVEL>NON-REENTRANT</REENTRANCY-LEVEL>
                  <IMPLEMENTED-ENTRY-REF DEST="BSW-MODULE-ENTRY">/Cdd_Pwm_TI_AM263x/Cdd_Pwm_ModuleEntry/Cdd_Pwm_G0_Ch26Isr</IMPLEMENTED-ENTRY-REF>
                [!IF "as:modconf('Cdd_Pwm')[1]/CddPwmGeneral/CddPwmTypeofInterruptFunction = 'CDD_PWM_ISR_CAT2'"!][!//
                  <INTERRUPT-CATEGORY>CAT-2</INTERRUPT-CATEGORY>
                [!ELSE!][!//
                  <INTERRUPT-CATEGORY>CAT-1</INTERRUPT-CATEGORY>
                [!ENDIF!][!//
                  <INTERRUPT-SOURCE>Hardware</INTERRUPT-SOURCE>
                </BSW-INTERRUPT-ENTITY>
              [!ENDIF!][!//
              [!IF "num:i($CddChannel) = '27'"!][!//
                <BSW-INTERRUPT-ENTITY UUID="2013c601-fd91-4490-8458-695f69a3cc6b">
                  <SHORT-NAME>Cdd_Pwm_G0_Ch27Isr</SHORT-NAME>
                  <MINIMUM-START-INTERVAL>0.0</MINIMUM-START-INTERVAL>
                  <REENTRANCY-LEVEL>NON-REENTRANT</REENTRANCY-LEVEL>
                  <IMPLEMENTED-ENTRY-REF DEST="BSW-MODULE-ENTRY">/Cdd_Pwm_TI_AM263x/Cdd_Pwm_ModuleEntry/Cdd_Pwm_G0_Ch27Isr</IMPLEMENTED-ENTRY-REF>
                [!IF "as:modconf('Cdd_Pwm')[1]/CddPwmGeneral/CddPwmTypeofInterruptFunction = 'CDD_PWM_ISR_CAT2'"!][!//
                  <INTERRUPT-CATEGORY>CAT-2</INTERRUPT-CATEGORY>
                [!ELSE!][!//
                  <INTERRUPT-CATEGORY>CAT-1</INTERRUPT-CATEGORY>
                [!ENDIF!][!//
                  <INTERRUPT-SOURCE>Hardware</INTERRUPT-SOURCE>
                </BSW-INTERRUPT-ENTITY>
              [!ENDIF!][!//
              [!IF "num:i($CddChannel) = '28'"!][!//
                <BSW-INTERRUPT-ENTITY UUID="b96078a7-ec4d-4281-9673-aa5020e7234c">
                  <SHORT-NAME>Cdd_Pwm_G0_Ch28Isr</SHORT-NAME>
                  <MINIMUM-START-INTERVAL>0.0</MINIMUM-START-INTERVAL>
                  <REENTRANCY-LEVEL>NON-REENTRANT</REENTRANCY-LEVEL>
                  <IMPLEMENTED-ENTRY-REF DEST="BSW-MODULE-ENTRY">/Cdd_Pwm_TI_AM263x/Cdd_Pwm_ModuleEntry/Cdd_Pwm_G0_Ch28Isr</IMPLEMENTED-ENTRY-REF>
                [!IF "as:modconf('Cdd_Pwm')[1]/CddPwmGeneral/CddPwmTypeofInterruptFunction = 'CDD_PWM_ISR_CAT2'"!][!//
                  <INTERRUPT-CATEGORY>CAT-2</INTERRUPT-CATEGORY>
                [!ELSE!][!//
                  <INTERRUPT-CATEGORY>CAT-1</INTERRUPT-CATEGORY>
                [!ENDIF!][!//
                  <INTERRUPT-SOURCE>Hardware</INTERRUPT-SOURCE>
                </BSW-INTERRUPT-ENTITY>
              [!ENDIF!][!//
              [!IF "num:i($CddChannel) = '29'"!][!//
                <BSW-INTERRUPT-ENTITY UUID="a390e465-1e18-4320-8ad3-6a6d7d3fce3d">
                  <SHORT-NAME>Cdd_Pwm_G0_Ch29Isr</SHORT-NAME>
                  <MINIMUM-START-INTERVAL>0.0</MINIMUM-START-INTERVAL>
                  <REENTRANCY-LEVEL>NON-REENTRANT</REENTRANCY-LEVEL>
                  <IMPLEMENTED-ENTRY-REF DEST="BSW-MODULE-ENTRY">/Cdd_Pwm_TI_AM263x/Cdd_Pwm_ModuleEntry/Cdd_Pwm_G0_Ch29Isr</IMPLEMENTED-ENTRY-REF>
                [!IF "as:modconf('Cdd_Pwm')[1]/CddPwmGeneral/CddPwmTypeofInterruptFunction = 'CDD_PWM_ISR_CAT2'"!][!//
                  <INTERRUPT-CATEGORY>CAT-2</INTERRUPT-CATEGORY>
                [!ELSE!][!//
                  <INTERRUPT-CATEGORY>CAT-1</INTERRUPT-CATEGORY>
                [!ENDIF!][!//
                  <INTERRUPT-SOURCE>Hardware</INTERRUPT-SOURCE>
                </BSW-INTERRUPT-ENTITY>
              [!ENDIF!][!//
              [!IF "num:i($CddChannel) = '2'"!][!//
                <BSW-INTERRUPT-ENTITY UUID="1d963915-32f0-4447-8ed1-b85d40d06f7a">
                  <SHORT-NAME>Cdd_Pwm_G0_Ch2Isr</SHORT-NAME>
                  <MINIMUM-START-INTERVAL>0.0</MINIMUM-START-INTERVAL>
                  <REENTRANCY-LEVEL>NON-REENTRANT</REENTRANCY-LEVEL>
                  <IMPLEMENTED-ENTRY-REF DEST="BSW-MODULE-ENTRY">/Cdd_Pwm_TI_AM263x/Cdd_Pwm_ModuleEntry/Cdd_Pwm_G0_Ch2Isr</IMPLEMENTED-ENTRY-REF>
                [!IF "as:modconf('Cdd_Pwm')[1]/CddPwmGeneral/CddPwmTypeofInterruptFunction = 'CDD_PWM_ISR_CAT2'"!][!//
                  <INTERRUPT-CATEGORY>CAT-2</INTERRUPT-CATEGORY>
                [!ELSE!][!//
                  <INTERRUPT-CATEGORY>CAT-1</INTERRUPT-CATEGORY>
                [!ENDIF!][!//
                  <INTERRUPT-SOURCE>Hardware</INTERRUPT-SOURCE>
                </BSW-INTERRUPT-ENTITY>
              [!ENDIF!][!//
              [!IF "num:i($CddChannel) = '30'"!][!//
                <BSW-INTERRUPT-ENTITY UUID="cb141fa1-6f4d-4767-b838-3ccf7bea882e">
                  <SHORT-NAME>Cdd_Pwm_G0_Ch30Isr</SHORT-NAME>
                  <MINIMUM-START-INTERVAL>0.0</MINIMUM-START-INTERVAL>
                  <REENTRANCY-LEVEL>NON-REENTRANT</REENTRANCY-LEVEL>
                  <IMPLEMENTED-ENTRY-REF DEST="BSW-MODULE-ENTRY">/Cdd_Pwm_TI_AM263x/Cdd_Pwm_ModuleEntry/Cdd_Pwm_G0_Ch30Isr</IMPLEMENTED-ENTRY-REF>
                [!IF "as:modconf('Cdd_Pwm')[1]/CddPwmGeneral/CddPwmTypeofInterruptFunction = 'CDD_PWM_ISR_CAT2'"!][!//
                  <INTERRUPT-CATEGORY>CAT-2</INTERRUPT-CATEGORY>
                [!ELSE!][!//
                  <INTERRUPT-CATEGORY>CAT-1</INTERRUPT-CATEGORY>
                [!ENDIF!][!//
                  <INTERRUPT-SOURCE>Hardware</INTERRUPT-SOURCE>
                </BSW-INTERRUPT-ENTITY>
              [!ENDIF!][!//
              [!IF "num:i($CddChannel) = '31'"!][!//
                <BSW-INTERRUPT-ENTITY UUID="4135c090-908a-4b39-a401-46a533955190">
                  <SHORT-NAME>Cdd_Pwm_G0_Ch31Isr</SHORT-NAME>
                  <MINIMUM-START-INTERVAL>0.0</MINIMUM-START-INTERVAL>
                  <REENTRANCY-LEVEL>NON-REENTRANT</REENTRANCY-LEVEL>
                  <IMPLEMENTED-ENTRY-REF DEST="BSW-MODULE-ENTRY">/Cdd_Pwm_TI_AM263x/Cdd_Pwm_ModuleEntry/Cdd_Pwm_G0_Ch31Isr</IMPLEMENTED-ENTRY-REF>
                [!IF "as:modconf('Cdd_Pwm')[1]/CddPwmGeneral/CddPwmTypeofInterruptFunction = 'CDD_PWM_ISR_CAT2'"!][!//
                  <INTERRUPT-CATEGORY>CAT-2</INTERRUPT-CATEGORY>
                [!ELSE!][!//
                  <INTERRUPT-CATEGORY>CAT-1</INTERRUPT-CATEGORY>
                [!ENDIF!][!//
                  <INTERRUPT-SOURCE>Hardware</INTERRUPT-SOURCE>
                </BSW-INTERRUPT-ENTITY>
              [!ENDIF!][!//
              [!IF "num:i($CddChannel) = '3'"!][!//
                <BSW-INTERRUPT-ENTITY UUID="b38dee71-1397-4833-b6dc-080f1d8087da">
                  <SHORT-NAME>Cdd_Pwm_G0_Ch3Isr</SHORT-NAME>
                  <MINIMUM-START-INTERVAL>0.0</MINIMUM-START-INTERVAL>
                  <REENTRANCY-LEVEL>NON-REENTRANT</REENTRANCY-LEVEL>
                  <IMPLEMENTED-ENTRY-REF DEST="BSW-MODULE-ENTRY">/Cdd_Pwm_TI_AM263x/Cdd_Pwm_ModuleEntry/Cdd_Pwm_G0_Ch3Isr</IMPLEMENTED-ENTRY-REF>
                [!IF "as:modconf('Cdd_Pwm')[1]/CddPwmGeneral/CddPwmTypeofInterruptFunction = 'CDD_PWM_ISR_CAT2'"!][!//
                  <INTERRUPT-CATEGORY>CAT-2</INTERRUPT-CATEGORY>
                [!ELSE!][!//
                  <INTERRUPT-CATEGORY>CAT-1</INTERRUPT-CATEGORY>
                [!ENDIF!][!//
                  <INTERRUPT-SOURCE>Hardware</INTERRUPT-SOURCE>
                </BSW-INTERRUPT-ENTITY>
              [!ENDIF!][!//
              [!IF "num:i($CddChannel) = '4'"!][!//
                <BSW-INTERRUPT-ENTITY UUID="b541a23c-c019-4ac5-81a3-e0d49f7243e3">
                  <SHORT-NAME>Cdd_Pwm_G0_Ch4Isr</SHORT-NAME>
                  <MINIMUM-START-INTERVAL>0.0</MINIMUM-START-INTERVAL>
                  <REENTRANCY-LEVEL>NON-REENTRANT</REENTRANCY-LEVEL>
                  <IMPLEMENTED-ENTRY-REF DEST="BSW-MODULE-ENTRY">/Cdd_Pwm_TI_AM263x/Cdd_Pwm_ModuleEntry/Cdd_Pwm_G0_Ch4Isr</IMPLEMENTED-ENTRY-REF>
                [!IF "as:modconf('Cdd_Pwm')[1]/CddPwmGeneral/CddPwmTypeofInterruptFunction = 'CDD_PWM_ISR_CAT2'"!][!//
                  <INTERRUPT-CATEGORY>CAT-2</INTERRUPT-CATEGORY>
                [!ELSE!][!//
                  <INTERRUPT-CATEGORY>CAT-1</INTERRUPT-CATEGORY>
                [!ENDIF!][!//
                  <INTERRUPT-SOURCE>Hardware</INTERRUPT-SOURCE>
                </BSW-INTERRUPT-ENTITY>
              [!ENDIF!][!//
              [!IF "num:i($CddChannel) = '5'"!][!//
                <BSW-INTERRUPT-ENTITY UUID="b756c8f8-aa05-4c8a-ba5b-ae35a2107cfc">
                  <SHORT-NAME>Cdd_Pwm_G0_Ch5Isr</SHORT-NAME>
                  <MINIMUM-START-INTERVAL>0.0</MINIMUM-START-INTERVAL>
                  <REENTRANCY-LEVEL>NON-REENTRANT</REENTRANCY-LEVEL>
                  <IMPLEMENTED-ENTRY-REF DEST="BSW-MODULE-ENTRY">/Cdd_Pwm_TI_AM263x/Cdd_Pwm_ModuleEntry/Cdd_Pwm_G0_Ch5Isr</IMPLEMENTED-ENTRY-REF>
                [!IF "as:modconf('Cdd_Pwm')[1]/CddPwmGeneral/CddPwmTypeofInterruptFunction = 'CDD_PWM_ISR_CAT2'"!][!//
                  <INTERRUPT-CATEGORY>CAT-2</INTERRUPT-CATEGORY>
                [!ELSE!][!//
                  <INTERRUPT-CATEGORY>CAT-1</INTERRUPT-CATEGORY>
                [!ENDIF!][!//
                  <INTERRUPT-SOURCE>Hardware</INTERRUPT-SOURCE>
                </BSW-INTERRUPT-ENTITY>
              [!ENDIF!][!//
              [!IF "num:i($CddChannel) = '6'"!][!//
                <BSW-INTERRUPT-ENTITY UUID="e7dd1b5c-9793-4957-bb33-753ced063e3b">
                  <SHORT-NAME>Cdd_Pwm_G0_Ch6Isr</SHORT-NAME>
                  <MINIMUM-START-INTERVAL>0.0</MINIMUM-START-INTERVAL>
                  <REENTRANCY-LEVEL>NON-REENTRANT</REENTRANCY-LEVEL>
                  <IMPLEMENTED-ENTRY-REF DEST="BSW-MODULE-ENTRY">/Cdd_Pwm_TI_AM263x/Cdd_Pwm_ModuleEntry/Cdd_Pwm_G0_Ch6Isr</IMPLEMENTED-ENTRY-REF>
                [!IF "as:modconf('Cdd_Pwm')[1]/CddPwmGeneral/CddPwmTypeofInterruptFunction = 'CDD_PWM_ISR_CAT2'"!][!//
                  <INTERRUPT-CATEGORY>CAT-2</INTERRUPT-CATEGORY>
                [!ELSE!][!//
                  <INTERRUPT-CATEGORY>CAT-1</INTERRUPT-CATEGORY>
                [!ENDIF!][!//
                  <INTERRUPT-SOURCE>Hardware</INTERRUPT-SOURCE>
                </BSW-INTERRUPT-ENTITY>
              [!ENDIF!][!//
              [!IF "num:i($CddChannel) = '7'"!][!//
                <BSW-INTERRUPT-ENTITY UUID="0aeaf08d-0fb8-45ce-9203-511c37b967f4">
                  <SHORT-NAME>Cdd_Pwm_G0_Ch7Isr</SHORT-NAME>
                  <MINIMUM-START-INTERVAL>0.0</MINIMUM-START-INTERVAL>
                  <REENTRANCY-LEVEL>NON-REENTRANT</REENTRANCY-LEVEL>
                  <IMPLEMENTED-ENTRY-REF DEST="BSW-MODULE-ENTRY">/Cdd_Pwm_TI_AM263x/Cdd_Pwm_ModuleEntry/Cdd_Pwm_G0_Ch7Isr</IMPLEMENTED-ENTRY-REF>
                [!IF "as:modconf('Cdd_Pwm')[1]/CddPwmGeneral/CddPwmTypeofInterruptFunction = 'CDD_PWM_ISR_CAT2'"!][!//
                  <INTERRUPT-CATEGORY>CAT-2</INTERRUPT-CATEGORY>
                [!ELSE!][!//
                  <INTERRUPT-CATEGORY>CAT-1</INTERRUPT-CATEGORY>
                [!ENDIF!][!//
                  <INTERRUPT-SOURCE>Hardware</INTERRUPT-SOURCE>
                </BSW-INTERRUPT-ENTITY>
              [!ENDIF!][!//
              [!IF "num:i($CddChannel) = '8'"!][!//
                <BSW-INTERRUPT-ENTITY UUID="fdeefe41-9e52-460d-9e26-756a8a531f13">
                  <SHORT-NAME>Cdd_Pwm_G0_Ch8Isr</SHORT-NAME>
                  <MINIMUM-START-INTERVAL>0.0</MINIMUM-START-INTERVAL>
                  <REENTRANCY-LEVEL>NON-REENTRANT</REENTRANCY-LEVEL>
                  <IMPLEMENTED-ENTRY-REF DEST="BSW-MODULE-ENTRY">/Cdd_Pwm_TI_AM263x/Cdd_Pwm_ModuleEntry/Cdd_Pwm_G0_Ch8Isr</IMPLEMENTED-ENTRY-REF>
                [!IF "as:modconf('Cdd_Pwm')[1]/CddPwmGeneral/CddPwmTypeofInterruptFunction = 'CDD_PWM_ISR_CAT2'"!][!//
                  <INTERRUPT-CATEGORY>CAT-2</INTERRUPT-CATEGORY>
                [!ELSE!][!//
                  <INTERRUPT-CATEGORY>CAT-1</INTERRUPT-CATEGORY>
                [!ENDIF!][!//
                  <INTERRUPT-SOURCE>Hardware</INTERRUPT-SOURCE>
                </BSW-INTERRUPT-ENTITY>
              [!ENDIF!][!//
              [!IF "num:i($CddChannel) = '9'"!][!//
                <BSW-INTERRUPT-ENTITY UUID="3ef94b73-fa23-4845-9f4e-3477b16d0174">
                  <SHORT-NAME>Cdd_Pwm_G0_Ch9Isr</SHORT-NAME>
                  <MINIMUM-START-INTERVAL>0.0</MINIMUM-START-INTERVAL>
                  <REENTRANCY-LEVEL>NON-REENTRANT</REENTRANCY-LEVEL>
                  <IMPLEMENTED-ENTRY-REF DEST="BSW-MODULE-ENTRY">/Cdd_Pwm_TI_AM263x/Cdd_Pwm_ModuleEntry/Cdd_Pwm_G0_Ch9Isr</IMPLEMENTED-ENTRY-REF>
                [!IF "as:modconf('Cdd_Pwm')[1]/CddPwmGeneral/CddPwmTypeofInterruptFunction = 'CDD_PWM_ISR_CAT2'"!][!//
                  <INTERRUPT-CATEGORY>CAT-2</INTERRUPT-CATEGORY>
                [!ELSE!][!//
                  <INTERRUPT-CATEGORY>CAT-1</INTERRUPT-CATEGORY>
                [!ENDIF!][!//
                  <INTERRUPT-SOURCE>Hardware</INTERRUPT-SOURCE>
                </BSW-INTERRUPT-ENTITY>
              [!ENDIF!][!//
              [!IF "num:i($CddChannel) = '0'"!][!//
                <BSW-INTERRUPT-ENTITY UUID="d69da544-8fc0-4bd5-bf9a-ec68a9ef333e">
                  <SHORT-NAME>Cdd_Pwm_G0_TzCh0Isr</SHORT-NAME>
                  <MINIMUM-START-INTERVAL>0.0</MINIMUM-START-INTERVAL>
                  <REENTRANCY-LEVEL>NON-REENTRANT</REENTRANCY-LEVEL>
                  <IMPLEMENTED-ENTRY-REF DEST="BSW-MODULE-ENTRY">/Cdd_Pwm_TI_AM263x/Cdd_Pwm_ModuleEntry/Cdd_Pwm_G0_TzCh0Isr</IMPLEMENTED-ENTRY-REF>
                [!IF "as:modconf('Cdd_Pwm')[1]/CddPwmGeneral/CddPwmTypeofInterruptFunction = 'CDD_PWM_ISR_CAT2'"!][!//
                  <INTERRUPT-CATEGORY>CAT-2</INTERRUPT-CATEGORY>
                [!ELSE!][!//
                  <INTERRUPT-CATEGORY>CAT-1</INTERRUPT-CATEGORY>
                [!ENDIF!][!//
                  <INTERRUPT-SOURCE>Hardware</INTERRUPT-SOURCE>
                </BSW-INTERRUPT-ENTITY>
              [!ENDIF!][!//
              [!IF "num:i($CddChannel) = '10'"!][!//
                <BSW-INTERRUPT-ENTITY UUID="69a2fbc6-09ae-4e0b-9ef7-43f05056a122">
                  <SHORT-NAME>Cdd_Pwm_G0_TzCh10Isr</SHORT-NAME>
                  <MINIMUM-START-INTERVAL>0.0</MINIMUM-START-INTERVAL>
                  <REENTRANCY-LEVEL>NON-REENTRANT</REENTRANCY-LEVEL>
                  <IMPLEMENTED-ENTRY-REF DEST="BSW-MODULE-ENTRY">/Cdd_Pwm_TI_AM263x/Cdd_Pwm_ModuleEntry/Cdd_Pwm_G0_TzCh10Isr</IMPLEMENTED-ENTRY-REF>
                [!IF "as:modconf('Cdd_Pwm')[1]/CddPwmGeneral/CddPwmTypeofInterruptFunction = 'CDD_PWM_ISR_CAT2'"!][!//
                  <INTERRUPT-CATEGORY>CAT-2</INTERRUPT-CATEGORY>
                [!ELSE!][!//
                  <INTERRUPT-CATEGORY>CAT-1</INTERRUPT-CATEGORY>
                [!ENDIF!][!//
                  <INTERRUPT-SOURCE>Hardware</INTERRUPT-SOURCE>
                </BSW-INTERRUPT-ENTITY>
              [!ENDIF!][!//
              [!IF "num:i($CddChannel) = '11'"!][!//
                <BSW-INTERRUPT-ENTITY UUID="530de49e-a47a-4467-b82b-07a604ca0312">
                  <SHORT-NAME>Cdd_Pwm_G0_TzCh11Isr</SHORT-NAME>
                  <MINIMUM-START-INTERVAL>0.0</MINIMUM-START-INTERVAL>
                  <REENTRANCY-LEVEL>NON-REENTRANT</REENTRANCY-LEVEL>
                  <IMPLEMENTED-ENTRY-REF DEST="BSW-MODULE-ENTRY">/Cdd_Pwm_TI_AM263x/Cdd_Pwm_ModuleEntry/Cdd_Pwm_G0_TzCh11Isr</IMPLEMENTED-ENTRY-REF>
                [!IF "as:modconf('Cdd_Pwm')[1]/CddPwmGeneral/CddPwmTypeofInterruptFunction = 'CDD_PWM_ISR_CAT2'"!][!//
                  <INTERRUPT-CATEGORY>CAT-2</INTERRUPT-CATEGORY>
                [!ELSE!][!//
                  <INTERRUPT-CATEGORY>CAT-1</INTERRUPT-CATEGORY>
                [!ENDIF!][!//
                  <INTERRUPT-SOURCE>Hardware</INTERRUPT-SOURCE>
                </BSW-INTERRUPT-ENTITY>
              [!ENDIF!][!//
              [!IF "num:i($CddChannel) = '12'"!][!//
                <BSW-INTERRUPT-ENTITY UUID="da8398d7-2b36-481e-a5bb-196cae84d6bf">
                  <SHORT-NAME>Cdd_Pwm_G0_TzCh12Isr</SHORT-NAME>
                  <MINIMUM-START-INTERVAL>0.0</MINIMUM-START-INTERVAL>
                  <REENTRANCY-LEVEL>NON-REENTRANT</REENTRANCY-LEVEL>
                  <IMPLEMENTED-ENTRY-REF DEST="BSW-MODULE-ENTRY">/Cdd_Pwm_TI_AM263x/Cdd_Pwm_ModuleEntry/Cdd_Pwm_G0_TzCh12Isr</IMPLEMENTED-ENTRY-REF>
                [!IF "as:modconf('Cdd_Pwm')[1]/CddPwmGeneral/CddPwmTypeofInterruptFunction = 'CDD_PWM_ISR_CAT2'"!][!//
                  <INTERRUPT-CATEGORY>CAT-2</INTERRUPT-CATEGORY>
                [!ELSE!][!//
                  <INTERRUPT-CATEGORY>CAT-1</INTERRUPT-CATEGORY>
                [!ENDIF!][!//
                  <INTERRUPT-SOURCE>Hardware</INTERRUPT-SOURCE>
                </BSW-INTERRUPT-ENTITY>
              [!ENDIF!][!//
              [!IF "num:i($CddChannel) = '13'"!][!//
                <BSW-INTERRUPT-ENTITY UUID="ab21630b-7678-4066-92f6-89b79e4835f2">
                  <SHORT-NAME>Cdd_Pwm_G0_TzCh13Isr</SHORT-NAME>
                  <MINIMUM-START-INTERVAL>0.0</MINIMUM-START-INTERVAL>
                  <REENTRANCY-LEVEL>NON-REENTRANT</REENTRANCY-LEVEL>
                  <IMPLEMENTED-ENTRY-REF DEST="BSW-MODULE-ENTRY">/Cdd_Pwm_TI_AM263x/Cdd_Pwm_ModuleEntry/Cdd_Pwm_G0_TzCh13Isr</IMPLEMENTED-ENTRY-REF>
                [!IF "as:modconf('Cdd_Pwm')[1]/CddPwmGeneral/CddPwmTypeofInterruptFunction = 'CDD_PWM_ISR_CAT2'"!][!//
                  <INTERRUPT-CATEGORY>CAT-2</INTERRUPT-CATEGORY>
                [!ELSE!][!//
                  <INTERRUPT-CATEGORY>CAT-1</INTERRUPT-CATEGORY>
                [!ENDIF!][!//
                  <INTERRUPT-SOURCE>Hardware</INTERRUPT-SOURCE>
                </BSW-INTERRUPT-ENTITY>
              [!ENDIF!][!//
              [!IF "num:i($CddChannel) = '14'"!][!//
                <BSW-INTERRUPT-ENTITY UUID="e22b0389-21f5-43aa-9b26-2a1c886aff43">
                  <SHORT-NAME>Cdd_Pwm_G0_TzCh14Isr</SHORT-NAME>
                  <MINIMUM-START-INTERVAL>0.0</MINIMUM-START-INTERVAL>
                  <REENTRANCY-LEVEL>NON-REENTRANT</REENTRANCY-LEVEL>
                  <IMPLEMENTED-ENTRY-REF DEST="BSW-MODULE-ENTRY">/Cdd_Pwm_TI_AM263x/Cdd_Pwm_ModuleEntry/Cdd_Pwm_G0_TzCh14Isr</IMPLEMENTED-ENTRY-REF>
                [!IF "as:modconf('Cdd_Pwm')[1]/CddPwmGeneral/CddPwmTypeofInterruptFunction = 'CDD_PWM_ISR_CAT2'"!][!//
                  <INTERRUPT-CATEGORY>CAT-2</INTERRUPT-CATEGORY>
                [!ELSE!][!//
                  <INTERRUPT-CATEGORY>CAT-1</INTERRUPT-CATEGORY>
                [!ENDIF!][!//
                  <INTERRUPT-SOURCE>Hardware</INTERRUPT-SOURCE>
                </BSW-INTERRUPT-ENTITY>
              [!ENDIF!][!//
              [!IF "num:i($CddChannel) = '15'"!][!//
                <BSW-INTERRUPT-ENTITY UUID="d0a3c37c-f3dd-4efa-b144-5a46e08b5c65">
                  <SHORT-NAME>Cdd_Pwm_G0_TzCh15Isr</SHORT-NAME>
                  <MINIMUM-START-INTERVAL>0.0</MINIMUM-START-INTERVAL>
                  <REENTRANCY-LEVEL>NON-REENTRANT</REENTRANCY-LEVEL>
                  <IMPLEMENTED-ENTRY-REF DEST="BSW-MODULE-ENTRY">/Cdd_Pwm_TI_AM263x/Cdd_Pwm_ModuleEntry/Cdd_Pwm_G0_TzCh15Isr</IMPLEMENTED-ENTRY-REF>
                [!IF "as:modconf('Cdd_Pwm')[1]/CddPwmGeneral/CddPwmTypeofInterruptFunction = 'CDD_PWM_ISR_CAT2'"!][!//
                  <INTERRUPT-CATEGORY>CAT-2</INTERRUPT-CATEGORY>
                [!ELSE!][!//
                  <INTERRUPT-CATEGORY>CAT-1</INTERRUPT-CATEGORY>
                [!ENDIF!][!//
                  <INTERRUPT-SOURCE>Hardware</INTERRUPT-SOURCE>
                </BSW-INTERRUPT-ENTITY>
              [!ENDIF!][!//
              [!IF "num:i($CddChannel) = '16'"!][!//
                <BSW-INTERRUPT-ENTITY UUID="374d79f5-f82c-4915-8af0-0c99cf264ea8">
                  <SHORT-NAME>Cdd_Pwm_G0_TzCh16Isr</SHORT-NAME>
                  <MINIMUM-START-INTERVAL>0.0</MINIMUM-START-INTERVAL>
                  <REENTRANCY-LEVEL>NON-REENTRANT</REENTRANCY-LEVEL>
                  <IMPLEMENTED-ENTRY-REF DEST="BSW-MODULE-ENTRY">/Cdd_Pwm_TI_AM263x/Cdd_Pwm_ModuleEntry/Cdd_Pwm_G0_TzCh16Isr</IMPLEMENTED-ENTRY-REF>
                [!IF "as:modconf('Cdd_Pwm')[1]/CddPwmGeneral/CddPwmTypeofInterruptFunction = 'CDD_PWM_ISR_CAT2'"!][!//
                  <INTERRUPT-CATEGORY>CAT-2</INTERRUPT-CATEGORY>
                [!ELSE!][!//
                  <INTERRUPT-CATEGORY>CAT-1</INTERRUPT-CATEGORY>
                [!ENDIF!][!//
                  <INTERRUPT-SOURCE>Hardware</INTERRUPT-SOURCE>
                </BSW-INTERRUPT-ENTITY>
              [!ENDIF!][!//
              [!IF "num:i($CddChannel) = '17'"!][!//
                <BSW-INTERRUPT-ENTITY UUID="06ba6192-5181-497d-ae55-c2513222e24c">
                  <SHORT-NAME>Cdd_Pwm_G0_TzCh17Isr</SHORT-NAME>
                  <MINIMUM-START-INTERVAL>0.0</MINIMUM-START-INTERVAL>
                  <REENTRANCY-LEVEL>NON-REENTRANT</REENTRANCY-LEVEL>
                  <IMPLEMENTED-ENTRY-REF DEST="BSW-MODULE-ENTRY">/Cdd_Pwm_TI_AM263x/Cdd_Pwm_ModuleEntry/Cdd_Pwm_G0_TzCh17Isr</IMPLEMENTED-ENTRY-REF>
                [!IF "as:modconf('Cdd_Pwm')[1]/CddPwmGeneral/CddPwmTypeofInterruptFunction = 'CDD_PWM_ISR_CAT2'"!][!//
                  <INTERRUPT-CATEGORY>CAT-2</INTERRUPT-CATEGORY>
                [!ELSE!][!//
                  <INTERRUPT-CATEGORY>CAT-1</INTERRUPT-CATEGORY>
                [!ENDIF!][!//
                  <INTERRUPT-SOURCE>Hardware</INTERRUPT-SOURCE>
                </BSW-INTERRUPT-ENTITY>
              [!ENDIF!][!//
              [!IF "num:i($CddChannel) = '18'"!][!//
                <BSW-INTERRUPT-ENTITY UUID="f39e8c9f-02c7-48d8-9228-f821d539bda3">
                  <SHORT-NAME>Cdd_Pwm_G0_TzCh18Isr</SHORT-NAME>
                  <MINIMUM-START-INTERVAL>0.0</MINIMUM-START-INTERVAL>
                  <REENTRANCY-LEVEL>NON-REENTRANT</REENTRANCY-LEVEL>
                  <IMPLEMENTED-ENTRY-REF DEST="BSW-MODULE-ENTRY">/Cdd_Pwm_TI_AM263x/Cdd_Pwm_ModuleEntry/Cdd_Pwm_G0_TzCh18Isr</IMPLEMENTED-ENTRY-REF>
                [!IF "as:modconf('Cdd_Pwm')[1]/CddPwmGeneral/CddPwmTypeofInterruptFunction = 'CDD_PWM_ISR_CAT2'"!][!//
                  <INTERRUPT-CATEGORY>CAT-2</INTERRUPT-CATEGORY>
                [!ELSE!][!//
                  <INTERRUPT-CATEGORY>CAT-1</INTERRUPT-CATEGORY>
                [!ENDIF!][!//
                  <INTERRUPT-SOURCE>Hardware</INTERRUPT-SOURCE>
                </BSW-INTERRUPT-ENTITY>
              [!ENDIF!][!//
              [!IF "num:i($CddChannel) = '19'"!][!//
                <BSW-INTERRUPT-ENTITY UUID="de083619-8d1d-4c09-b8f2-2c98c9eb73c3">
                  <SHORT-NAME>Cdd_Pwm_G0_TzCh19Isr</SHORT-NAME>
                  <MINIMUM-START-INTERVAL>0.0</MINIMUM-START-INTERVAL>
                  <REENTRANCY-LEVEL>NON-REENTRANT</REENTRANCY-LEVEL>
                  <IMPLEMENTED-ENTRY-REF DEST="BSW-MODULE-ENTRY">/Cdd_Pwm_TI_AM263x/Cdd_Pwm_ModuleEntry/Cdd_Pwm_G0_TzCh19Isr</IMPLEMENTED-ENTRY-REF>
                [!IF "as:modconf('Cdd_Pwm')[1]/CddPwmGeneral/CddPwmTypeofInterruptFunction = 'CDD_PWM_ISR_CAT2'"!][!//
                  <INTERRUPT-CATEGORY>CAT-2</INTERRUPT-CATEGORY>
                [!ELSE!][!//
                  <INTERRUPT-CATEGORY>CAT-1</INTERRUPT-CATEGORY>
                [!ENDIF!][!//
                  <INTERRUPT-SOURCE>Hardware</INTERRUPT-SOURCE>
                </BSW-INTERRUPT-ENTITY>
              [!ENDIF!][!//
              [!IF "num:i($CddChannel) = '1'"!][!//
                <BSW-INTERRUPT-ENTITY UUID="c21c6271-ee72-47e1-acbe-6d1b14a41fd4">
                  <SHORT-NAME>Cdd_Pwm_G0_TzCh1Isr</SHORT-NAME>
                  <MINIMUM-START-INTERVAL>0.0</MINIMUM-START-INTERVAL>
                  <REENTRANCY-LEVEL>NON-REENTRANT</REENTRANCY-LEVEL>
                  <IMPLEMENTED-ENTRY-REF DEST="BSW-MODULE-ENTRY">/Cdd_Pwm_TI_AM263x/Cdd_Pwm_ModuleEntry/Cdd_Pwm_G0_TzCh1Isr</IMPLEMENTED-ENTRY-REF>
                [!IF "as:modconf('Cdd_Pwm')[1]/CddPwmGeneral/CddPwmTypeofInterruptFunction = 'CDD_PWM_ISR_CAT2'"!][!//
                  <INTERRUPT-CATEGORY>CAT-2</INTERRUPT-CATEGORY>
                [!ELSE!][!//
                  <INTERRUPT-CATEGORY>CAT-1</INTERRUPT-CATEGORY>
                [!ENDIF!][!//
                  <INTERRUPT-SOURCE>Hardware</INTERRUPT-SOURCE>
                </BSW-INTERRUPT-ENTITY>
              [!ENDIF!][!//
              [!IF "num:i($CddChannel) = '20'"!][!//
                <BSW-INTERRUPT-ENTITY UUID="87e0bcdd-d439-4a14-b4c1-42acb54c556e">
                  <SHORT-NAME>Cdd_Pwm_G0_TzCh20Isr</SHORT-NAME>
                  <MINIMUM-START-INTERVAL>0.0</MINIMUM-START-INTERVAL>
                  <REENTRANCY-LEVEL>NON-REENTRANT</REENTRANCY-LEVEL>
                  <IMPLEMENTED-ENTRY-REF DEST="BSW-MODULE-ENTRY">/Cdd_Pwm_TI_AM263x/Cdd_Pwm_ModuleEntry/Cdd_Pwm_G0_TzCh20Isr</IMPLEMENTED-ENTRY-REF>
                [!IF "as:modconf('Cdd_Pwm')[1]/CddPwmGeneral/CddPwmTypeofInterruptFunction = 'CDD_PWM_ISR_CAT2'"!][!//
                  <INTERRUPT-CATEGORY>CAT-2</INTERRUPT-CATEGORY>
                [!ELSE!][!//
                  <INTERRUPT-CATEGORY>CAT-1</INTERRUPT-CATEGORY>
                [!ENDIF!][!//
                  <INTERRUPT-SOURCE>Hardware</INTERRUPT-SOURCE>
                </BSW-INTERRUPT-ENTITY>
              [!ENDIF!][!//
              [!IF "num:i($CddChannel) = '21'"!][!//
                <BSW-INTERRUPT-ENTITY UUID="e67a99c4-3b84-4e35-aa5f-a378164cfee9">
                  <SHORT-NAME>Cdd_Pwm_G0_TzCh21Isr</SHORT-NAME>
                  <MINIMUM-START-INTERVAL>0.0</MINIMUM-START-INTERVAL>
                  <REENTRANCY-LEVEL>NON-REENTRANT</REENTRANCY-LEVEL>
                  <IMPLEMENTED-ENTRY-REF DEST="BSW-MODULE-ENTRY">/Cdd_Pwm_TI_AM263x/Cdd_Pwm_ModuleEntry/Cdd_Pwm_G0_TzCh21Isr</IMPLEMENTED-ENTRY-REF>
                [!IF "as:modconf('Cdd_Pwm')[1]/CddPwmGeneral/CddPwmTypeofInterruptFunction = 'CDD_PWM_ISR_CAT2'"!][!//
                  <INTERRUPT-CATEGORY>CAT-2</INTERRUPT-CATEGORY>
                [!ELSE!][!//
                  <INTERRUPT-CATEGORY>CAT-1</INTERRUPT-CATEGORY>
                [!ENDIF!][!//
                  <INTERRUPT-SOURCE>Hardware</INTERRUPT-SOURCE>
                </BSW-INTERRUPT-ENTITY>
              [!ENDIF!][!//
              [!IF "num:i($CddChannel) = '22'"!][!//
                <BSW-INTERRUPT-ENTITY UUID="5b35f1cc-7cc0-4ece-b867-0384b8c44cb6">
                  <SHORT-NAME>Cdd_Pwm_G0_TzCh22Isr</SHORT-NAME>
                  <MINIMUM-START-INTERVAL>0.0</MINIMUM-START-INTERVAL>
                  <REENTRANCY-LEVEL>NON-REENTRANT</REENTRANCY-LEVEL>
                  <IMPLEMENTED-ENTRY-REF DEST="BSW-MODULE-ENTRY">/Cdd_Pwm_TI_AM263x/Cdd_Pwm_ModuleEntry/Cdd_Pwm_G0_TzCh22Isr</IMPLEMENTED-ENTRY-REF>
                [!IF "as:modconf('Cdd_Pwm')[1]/CddPwmGeneral/CddPwmTypeofInterruptFunction = 'CDD_PWM_ISR_CAT2'"!][!//
                  <INTERRUPT-CATEGORY>CAT-2</INTERRUPT-CATEGORY>
                [!ELSE!][!//
                  <INTERRUPT-CATEGORY>CAT-1</INTERRUPT-CATEGORY>
                [!ENDIF!][!//
                  <INTERRUPT-SOURCE>Hardware</INTERRUPT-SOURCE>
                </BSW-INTERRUPT-ENTITY>
              [!ENDIF!][!//
              [!IF "num:i($CddChannel) = '23'"!][!//
                <BSW-INTERRUPT-ENTITY UUID="5badceb1-9404-4d7a-854e-010cd17cba33">
                  <SHORT-NAME>Cdd_Pwm_G0_TzCh23Isr</SHORT-NAME>
                  <MINIMUM-START-INTERVAL>0.0</MINIMUM-START-INTERVAL>
                  <REENTRANCY-LEVEL>NON-REENTRANT</REENTRANCY-LEVEL>
                  <IMPLEMENTED-ENTRY-REF DEST="BSW-MODULE-ENTRY">/Cdd_Pwm_TI_AM263x/Cdd_Pwm_ModuleEntry/Cdd_Pwm_G0_TzCh23Isr</IMPLEMENTED-ENTRY-REF>
                [!IF "as:modconf('Cdd_Pwm')[1]/CddPwmGeneral/CddPwmTypeofInterruptFunction = 'CDD_PWM_ISR_CAT2'"!][!//
                  <INTERRUPT-CATEGORY>CAT-2</INTERRUPT-CATEGORY>
                [!ELSE!][!//
                  <INTERRUPT-CATEGORY>CAT-1</INTERRUPT-CATEGORY>
                [!ENDIF!][!//
                  <INTERRUPT-SOURCE>Hardware</INTERRUPT-SOURCE>
                </BSW-INTERRUPT-ENTITY>
              [!ENDIF!][!//
              [!IF "num:i($CddChannel) = '24'"!][!//
                <BSW-INTERRUPT-ENTITY UUID="bdd667b4-6e93-404a-ab13-55bc8eb1d321">
                  <SHORT-NAME>Cdd_Pwm_G0_TzCh24Isr</SHORT-NAME>
                  <MINIMUM-START-INTERVAL>0.0</MINIMUM-START-INTERVAL>
                  <REENTRANCY-LEVEL>NON-REENTRANT</REENTRANCY-LEVEL>
                  <IMPLEMENTED-ENTRY-REF DEST="BSW-MODULE-ENTRY">/Cdd_Pwm_TI_AM263x/Cdd_Pwm_ModuleEntry/Cdd_Pwm_G0_TzCh24Isr</IMPLEMENTED-ENTRY-REF>
                [!IF "as:modconf('Cdd_Pwm')[1]/CddPwmGeneral/CddPwmTypeofInterruptFunction = 'CDD_PWM_ISR_CAT2'"!][!//
                  <INTERRUPT-CATEGORY>CAT-2</INTERRUPT-CATEGORY>
                [!ELSE!][!//
                  <INTERRUPT-CATEGORY>CAT-1</INTERRUPT-CATEGORY>
                [!ENDIF!][!//
                  <INTERRUPT-SOURCE>Hardware</INTERRUPT-SOURCE>
                </BSW-INTERRUPT-ENTITY>
              [!ENDIF!][!//
              [!IF "num:i($CddChannel) = '25'"!][!//
                <BSW-INTERRUPT-ENTITY UUID="ffd2e2cf-3c48-472a-98d7-a120bdaf389b">
                  <SHORT-NAME>Cdd_Pwm_G0_TzCh25Isr</SHORT-NAME>
                  <MINIMUM-START-INTERVAL>0.0</MINIMUM-START-INTERVAL>
                  <REENTRANCY-LEVEL>NON-REENTRANT</REENTRANCY-LEVEL>
                  <IMPLEMENTED-ENTRY-REF DEST="BSW-MODULE-ENTRY">/Cdd_Pwm_TI_AM263x/Cdd_Pwm_ModuleEntry/Cdd_Pwm_G0_TzCh25Isr</IMPLEMENTED-ENTRY-REF>
                [!IF "as:modconf('Cdd_Pwm')[1]/CddPwmGeneral/CddPwmTypeofInterruptFunction = 'CDD_PWM_ISR_CAT2'"!][!//
                  <INTERRUPT-CATEGORY>CAT-2</INTERRUPT-CATEGORY>
                [!ELSE!][!//
                  <INTERRUPT-CATEGORY>CAT-1</INTERRUPT-CATEGORY>
                [!ENDIF!][!//
                  <INTERRUPT-SOURCE>Hardware</INTERRUPT-SOURCE>
                </BSW-INTERRUPT-ENTITY>
              [!ENDIF!][!//
              [!IF "num:i($CddChannel) = '26'"!][!//
                <BSW-INTERRUPT-ENTITY UUID="8e1c71d2-08fb-424e-8705-eb969afa8106">
                  <SHORT-NAME>Cdd_Pwm_G0_TzCh26Isr</SHORT-NAME>
                  <MINIMUM-START-INTERVAL>0.0</MINIMUM-START-INTERVAL>
                  <REENTRANCY-LEVEL>NON-REENTRANT</REENTRANCY-LEVEL>
                  <IMPLEMENTED-ENTRY-REF DEST="BSW-MODULE-ENTRY">/Cdd_Pwm_TI_AM263x/Cdd_Pwm_ModuleEntry/Cdd_Pwm_G0_TzCh26Isr</IMPLEMENTED-ENTRY-REF>
                [!IF "as:modconf('Cdd_Pwm')[1]/CddPwmGeneral/CddPwmTypeofInterruptFunction = 'CDD_PWM_ISR_CAT2'"!][!//
                  <INTERRUPT-CATEGORY>CAT-2</INTERRUPT-CATEGORY>
                [!ELSE!][!//
                  <INTERRUPT-CATEGORY>CAT-1</INTERRUPT-CATEGORY>
                [!ENDIF!][!//
                  <INTERRUPT-SOURCE>Hardware</INTERRUPT-SOURCE>
                </BSW-INTERRUPT-ENTITY>
              [!ENDIF!][!//
              [!IF "num:i($CddChannel) = '27'"!][!//
                <BSW-INTERRUPT-ENTITY UUID="528df48b-dab5-48b4-a55e-842458dbdf35">
                  <SHORT-NAME>Cdd_Pwm_G0_TzCh27Isr</SHORT-NAME>
                  <MINIMUM-START-INTERVAL>0.0</MINIMUM-START-INTERVAL>
                  <REENTRANCY-LEVEL>NON-REENTRANT</REENTRANCY-LEVEL>
                  <IMPLEMENTED-ENTRY-REF DEST="BSW-MODULE-ENTRY">/Cdd_Pwm_TI_AM263x/Cdd_Pwm_ModuleEntry/Cdd_Pwm_G0_TzCh27Isr</IMPLEMENTED-ENTRY-REF>
                [!IF "as:modconf('Cdd_Pwm')[1]/CddPwmGeneral/CddPwmTypeofInterruptFunction = 'CDD_PWM_ISR_CAT2'"!][!//
                  <INTERRUPT-CATEGORY>CAT-2</INTERRUPT-CATEGORY>
                [!ELSE!][!//
                  <INTERRUPT-CATEGORY>CAT-1</INTERRUPT-CATEGORY>
                [!ENDIF!][!//
                  <INTERRUPT-SOURCE>Hardware</INTERRUPT-SOURCE>
                </BSW-INTERRUPT-ENTITY>
              [!ENDIF!][!//
              [!IF "num:i($CddChannel) = '28'"!][!//
                <BSW-INTERRUPT-ENTITY UUID="d0595cb2-3f46-4857-91cc-84b5d57c6fb1">
                  <SHORT-NAME>Cdd_Pwm_G0_TzCh28Isr</SHORT-NAME>
                  <MINIMUM-START-INTERVAL>0.0</MINIMUM-START-INTERVAL>
                  <REENTRANCY-LEVEL>NON-REENTRANT</REENTRANCY-LEVEL>
                  <IMPLEMENTED-ENTRY-REF DEST="BSW-MODULE-ENTRY">/Cdd_Pwm_TI_AM263x/Cdd_Pwm_ModuleEntry/Cdd_Pwm_G0_TzCh28Isr</IMPLEMENTED-ENTRY-REF>
                [!IF "as:modconf('Cdd_Pwm')[1]/CddPwmGeneral/CddPwmTypeofInterruptFunction = 'CDD_PWM_ISR_CAT2'"!][!//
                  <INTERRUPT-CATEGORY>CAT-2</INTERRUPT-CATEGORY>
                [!ELSE!][!//
                  <INTERRUPT-CATEGORY>CAT-1</INTERRUPT-CATEGORY>
                [!ENDIF!][!//
                  <INTERRUPT-SOURCE>Hardware</INTERRUPT-SOURCE>
                </BSW-INTERRUPT-ENTITY>
              [!ENDIF!][!//
              [!IF "num:i($CddChannel) = '29'"!][!//
                <BSW-INTERRUPT-ENTITY UUID="c7e90290-a3e6-4511-a736-e82f63911157">
                  <SHORT-NAME>Cdd_Pwm_G0_TzCh29Isr</SHORT-NAME>
                  <MINIMUM-START-INTERVAL>0.0</MINIMUM-START-INTERVAL>
                  <REENTRANCY-LEVEL>NON-REENTRANT</REENTRANCY-LEVEL>
                  <IMPLEMENTED-ENTRY-REF DEST="BSW-MODULE-ENTRY">/Cdd_Pwm_TI_AM263x/Cdd_Pwm_ModuleEntry/Cdd_Pwm_G0_TzCh29Isr</IMPLEMENTED-ENTRY-REF>
                [!IF "as:modconf('Cdd_Pwm')[1]/CddPwmGeneral/CddPwmTypeofInterruptFunction = 'CDD_PWM_ISR_CAT2'"!][!//
                  <INTERRUPT-CATEGORY>CAT-2</INTERRUPT-CATEGORY>
                [!ELSE!][!//
                  <INTERRUPT-CATEGORY>CAT-1</INTERRUPT-CATEGORY>
                [!ENDIF!][!//
                  <INTERRUPT-SOURCE>Hardware</INTERRUPT-SOURCE>
                </BSW-INTERRUPT-ENTITY>
              [!ENDIF!][!//
              [!IF "num:i($CddChannel) = '2'"!][!//
                <BSW-INTERRUPT-ENTITY UUID="c2a68200-f8cd-48c5-ae8e-f788ab9db012">
                  <SHORT-NAME>Cdd_Pwm_G0_TzCh2Isr</SHORT-NAME>
                  <MINIMUM-START-INTERVAL>0.0</MINIMUM-START-INTERVAL>
                  <REENTRANCY-LEVEL>NON-REENTRANT</REENTRANCY-LEVEL>
                  <IMPLEMENTED-ENTRY-REF DEST="BSW-MODULE-ENTRY">/Cdd_Pwm_TI_AM263x/Cdd_Pwm_ModuleEntry/Cdd_Pwm_G0_TzCh2Isr</IMPLEMENTED-ENTRY-REF>
                [!IF "as:modconf('Cdd_Pwm')[1]/CddPwmGeneral/CddPwmTypeofInterruptFunction = 'CDD_PWM_ISR_CAT2'"!][!//
                  <INTERRUPT-CATEGORY>CAT-2</INTERRUPT-CATEGORY>
                [!ELSE!][!//
                  <INTERRUPT-CATEGORY>CAT-1</INTERRUPT-CATEGORY>
                [!ENDIF!][!//
                  <INTERRUPT-SOURCE>Hardware</INTERRUPT-SOURCE>
                </BSW-INTERRUPT-ENTITY>
              [!ENDIF!][!//
              [!IF "num:i($CddChannel) = '30'"!][!//
                <BSW-INTERRUPT-ENTITY UUID="dc9e04ef-e5ae-44e3-9dc9-0f20b2131aa8">
                  <SHORT-NAME>Cdd_Pwm_G0_TzCh30Isr</SHORT-NAME>
                  <MINIMUM-START-INTERVAL>0.0</MINIMUM-START-INTERVAL>
                  <REENTRANCY-LEVEL>NON-REENTRANT</REENTRANCY-LEVEL>
                  <IMPLEMENTED-ENTRY-REF DEST="BSW-MODULE-ENTRY">/Cdd_Pwm_TI_AM263x/Cdd_Pwm_ModuleEntry/Cdd_Pwm_G0_TzCh30Isr</IMPLEMENTED-ENTRY-REF>
                [!IF "as:modconf('Cdd_Pwm')[1]/CddPwmGeneral/CddPwmTypeofInterruptFunction = 'CDD_PWM_ISR_CAT2'"!][!//
                  <INTERRUPT-CATEGORY>CAT-2</INTERRUPT-CATEGORY>
                [!ELSE!][!//
                  <INTERRUPT-CATEGORY>CAT-1</INTERRUPT-CATEGORY>
                [!ENDIF!][!//
                  <INTERRUPT-SOURCE>Hardware</INTERRUPT-SOURCE>
                </BSW-INTERRUPT-ENTITY>
              [!ENDIF!][!//
              [!IF "num:i($CddChannel) = '31'"!][!//
                <BSW-INTERRUPT-ENTITY UUID="491f66af-8364-47ed-a790-4aff92d4cc5b">
                  <SHORT-NAME>Cdd_Pwm_G0_TzCh31Isr</SHORT-NAME>
                  <MINIMUM-START-INTERVAL>0.0</MINIMUM-START-INTERVAL>
                  <REENTRANCY-LEVEL>NON-REENTRANT</REENTRANCY-LEVEL>
                  <IMPLEMENTED-ENTRY-REF DEST="BSW-MODULE-ENTRY">/Cdd_Pwm_TI_AM263x/Cdd_Pwm_ModuleEntry/Cdd_Pwm_G0_TzCh31Isr</IMPLEMENTED-ENTRY-REF>
                [!IF "as:modconf('Cdd_Pwm')[1]/CddPwmGeneral/CddPwmTypeofInterruptFunction = 'CDD_PWM_ISR_CAT2'"!][!//
                  <INTERRUPT-CATEGORY>CAT-2</INTERRUPT-CATEGORY>
                [!ELSE!][!//
                  <INTERRUPT-CATEGORY>CAT-1</INTERRUPT-CATEGORY>
                [!ENDIF!][!//
                  <INTERRUPT-SOURCE>Hardware</INTERRUPT-SOURCE>
                </BSW-INTERRUPT-ENTITY>
              [!ENDIF!][!//
              [!IF "num:i($CddChannel) = '3'"!][!//
                <BSW-INTERRUPT-ENTITY UUID="5f9298fc-13d3-486a-9085-a807e2a8b389">
                  <SHORT-NAME>Cdd_Pwm_G0_TzCh3Isr</SHORT-NAME>
                  <MINIMUM-START-INTERVAL>0.0</MINIMUM-START-INTERVAL>
                  <REENTRANCY-LEVEL>NON-REENTRANT</REENTRANCY-LEVEL>
                  <IMPLEMENTED-ENTRY-REF DEST="BSW-MODULE-ENTRY">/Cdd_Pwm_TI_AM263x/Cdd_Pwm_ModuleEntry/Cdd_Pwm_G0_TzCh3Isr</IMPLEMENTED-ENTRY-REF>
                [!IF "as:modconf('Cdd_Pwm')[1]/CddPwmGeneral/CddPwmTypeofInterruptFunction = 'CDD_PWM_ISR_CAT2'"!][!//
                  <INTERRUPT-CATEGORY>CAT-2</INTERRUPT-CATEGORY>
                [!ELSE!][!//
                  <INTERRUPT-CATEGORY>CAT-1</INTERRUPT-CATEGORY>
                [!ENDIF!][!//
                  <INTERRUPT-SOURCE>Hardware</INTERRUPT-SOURCE>
                </BSW-INTERRUPT-ENTITY>
              [!ENDIF!][!//
              [!IF "num:i($CddChannel) = '4'"!][!//
                <BSW-INTERRUPT-ENTITY UUID="6b302e06-14c1-45a8-9991-2d91168b8b4b">
                  <SHORT-NAME>Cdd_Pwm_G0_TzCh4Isr</SHORT-NAME>
                  <MINIMUM-START-INTERVAL>0.0</MINIMUM-START-INTERVAL>
                  <REENTRANCY-LEVEL>NON-REENTRANT</REENTRANCY-LEVEL>
                  <IMPLEMENTED-ENTRY-REF DEST="BSW-MODULE-ENTRY">/Cdd_Pwm_TI_AM263x/Cdd_Pwm_ModuleEntry/Cdd_Pwm_G0_TzCh4Isr</IMPLEMENTED-ENTRY-REF>
                [!IF "as:modconf('Cdd_Pwm')[1]/CddPwmGeneral/CddPwmTypeofInterruptFunction = 'CDD_PWM_ISR_CAT2'"!][!//
                  <INTERRUPT-CATEGORY>CAT-2</INTERRUPT-CATEGORY>
                [!ELSE!][!//
                  <INTERRUPT-CATEGORY>CAT-1</INTERRUPT-CATEGORY>
                [!ENDIF!][!//
                  <INTERRUPT-SOURCE>Hardware</INTERRUPT-SOURCE>
                </BSW-INTERRUPT-ENTITY>
              [!ENDIF!][!//
              [!IF "num:i($CddChannel) = '5'"!][!//
                <BSW-INTERRUPT-ENTITY UUID="3dfd724f-c80d-4e34-a7a7-d8fd36350170">
                  <SHORT-NAME>Cdd_Pwm_G0_TzCh5Isr</SHORT-NAME>
                  <MINIMUM-START-INTERVAL>0.0</MINIMUM-START-INTERVAL>
                  <REENTRANCY-LEVEL>NON-REENTRANT</REENTRANCY-LEVEL>
                  <IMPLEMENTED-ENTRY-REF DEST="BSW-MODULE-ENTRY">/Cdd_Pwm_TI_AM263x/Cdd_Pwm_ModuleEntry/Cdd_Pwm_G0_TzCh5Isr</IMPLEMENTED-ENTRY-REF>
                [!IF "as:modconf('Cdd_Pwm')[1]/CddPwmGeneral/CddPwmTypeofInterruptFunction = 'CDD_PWM_ISR_CAT2'"!][!//
                  <INTERRUPT-CATEGORY>CAT-2</INTERRUPT-CATEGORY>
                [!ELSE!][!//
                  <INTERRUPT-CATEGORY>CAT-1</INTERRUPT-CATEGORY>
                [!ENDIF!][!//
                  <INTERRUPT-SOURCE>Hardware</INTERRUPT-SOURCE>
                </BSW-INTERRUPT-ENTITY>
              [!ENDIF!][!//
              [!IF "num:i($CddChannel) = '6'"!][!//
                <BSW-INTERRUPT-ENTITY UUID="6c90e60c-4fdf-419d-bc4d-3e1d82e39d52">
                  <SHORT-NAME>Cdd_Pwm_G0_TzCh6Isr</SHORT-NAME>
                  <MINIMUM-START-INTERVAL>0.0</MINIMUM-START-INTERVAL>
                  <REENTRANCY-LEVEL>NON-REENTRANT</REENTRANCY-LEVEL>
                  <IMPLEMENTED-ENTRY-REF DEST="BSW-MODULE-ENTRY">/Cdd_Pwm_TI_AM263x/Cdd_Pwm_ModuleEntry/Cdd_Pwm_G0_TzCh6Isr</IMPLEMENTED-ENTRY-REF>
                [!IF "as:modconf('Cdd_Pwm')[1]/CddPwmGeneral/CddPwmTypeofInterruptFunction = 'CDD_PWM_ISR_CAT2'"!][!//
                  <INTERRUPT-CATEGORY>CAT-2</INTERRUPT-CATEGORY>
                [!ELSE!][!//
                  <INTERRUPT-CATEGORY>CAT-1</INTERRUPT-CATEGORY>
                [!ENDIF!][!//
                  <INTERRUPT-SOURCE>Hardware</INTERRUPT-SOURCE>
                </BSW-INTERRUPT-ENTITY>
              [!ENDIF!][!//
              [!IF "num:i($CddChannel) = '7'"!][!//
                <BSW-INTERRUPT-ENTITY UUID="468d1e10-bbf0-4ba7-8fed-13678a87d8db">
                  <SHORT-NAME>Cdd_Pwm_G0_TzCh7Isr</SHORT-NAME>
                  <MINIMUM-START-INTERVAL>0.0</MINIMUM-START-INTERVAL>
                  <REENTRANCY-LEVEL>NON-REENTRANT</REENTRANCY-LEVEL>
                  <IMPLEMENTED-ENTRY-REF DEST="BSW-MODULE-ENTRY">/Cdd_Pwm_TI_AM263x/Cdd_Pwm_ModuleEntry/Cdd_Pwm_G0_TzCh7Isr</IMPLEMENTED-ENTRY-REF>
                [!IF "as:modconf('Cdd_Pwm')[1]/CddPwmGeneral/CddPwmTypeofInterruptFunction = 'CDD_PWM_ISR_CAT2'"!][!//
                  <INTERRUPT-CATEGORY>CAT-2</INTERRUPT-CATEGORY>
                [!ELSE!][!//
                  <INTERRUPT-CATEGORY>CAT-1</INTERRUPT-CATEGORY>
                [!ENDIF!][!//
                  <INTERRUPT-SOURCE>Hardware</INTERRUPT-SOURCE>
                </BSW-INTERRUPT-ENTITY>
              [!ENDIF!][!//
              [!IF "num:i($CddChannel) = '8'"!][!//
                <BSW-INTERRUPT-ENTITY UUID="0baae350-690c-4081-80fc-e0dbf76a94f9">
                  <SHORT-NAME>Cdd_Pwm_G0_TzCh8Isr</SHORT-NAME>
                  <MINIMUM-START-INTERVAL>0.0</MINIMUM-START-INTERVAL>
                  <REENTRANCY-LEVEL>NON-REENTRANT</REENTRANCY-LEVEL>
                  <IMPLEMENTED-ENTRY-REF DEST="BSW-MODULE-ENTRY">/Cdd_Pwm_TI_AM263x/Cdd_Pwm_ModuleEntry/Cdd_Pwm_G0_TzCh8Isr</IMPLEMENTED-ENTRY-REF>
                [!IF "as:modconf('Cdd_Pwm')[1]/CddPwmGeneral/CddPwmTypeofInterruptFunction = 'CDD_PWM_ISR_CAT2'"!][!//
                  <INTERRUPT-CATEGORY>CAT-2</INTERRUPT-CATEGORY>
                [!ELSE!][!//
                  <INTERRUPT-CATEGORY>CAT-1</INTERRUPT-CATEGORY>
                [!ENDIF!][!//
                  <INTERRUPT-SOURCE>Hardware</INTERRUPT-SOURCE>
                </BSW-INTERRUPT-ENTITY>
              [!ENDIF!][!//
              [!IF "num:i($CddChannel) = '9'"!][!//
                <BSW-INTERRUPT-ENTITY UUID="b61cdf5c-8c09-4e0e-8e5c-919ce2a3eefb">
                  <SHORT-NAME>Cdd_Pwm_G0_TzCh9Isr</SHORT-NAME>
                  <MINIMUM-START-INTERVAL>0.0</MINIMUM-START-INTERVAL>
                  <REENTRANCY-LEVEL>NON-REENTRANT</REENTRANCY-LEVEL>
                  <IMPLEMENTED-ENTRY-REF DEST="BSW-MODULE-ENTRY">/Cdd_Pwm_TI_AM263x/Cdd_Pwm_ModuleEntry/Cdd_Pwm_G0_TzCh9Isr</IMPLEMENTED-ENTRY-REF>
                [!IF "as:modconf('Cdd_Pwm')[1]/CddPwmGeneral/CddPwmTypeofInterruptFunction = 'CDD_PWM_ISR_CAT2'"!][!//
                  <INTERRUPT-CATEGORY>CAT-2</INTERRUPT-CATEGORY>
                [!ELSE!][!//
                  <INTERRUPT-CATEGORY>CAT-1</INTERRUPT-CATEGORY>
                [!ENDIF!][!//
                  <INTERRUPT-SOURCE>Hardware</INTERRUPT-SOURCE>
                </BSW-INTERRUPT-ENTITY>
              [!ENDIF!][!//
              [!ELSEIF "num:i($CddGroup) = '1'"!][!//
              [!IF "num:i($CddChannel) = '0'"!][!//
                <BSW-INTERRUPT-ENTITY UUID="2679413a-388b-4c1c-8527-3e1f1205f791">
                  <SHORT-NAME>Cdd_Pwm_G1_Ch0Isr</SHORT-NAME>
                  <MINIMUM-START-INTERVAL>0.0</MINIMUM-START-INTERVAL>
                  <REENTRANCY-LEVEL>NON-REENTRANT</REENTRANCY-LEVEL>
                  <IMPLEMENTED-ENTRY-REF DEST="BSW-MODULE-ENTRY">/Cdd_Pwm_TI_AM263x/Cdd_Pwm_ModuleEntry/Cdd_Pwm_G1_Ch0Isr</IMPLEMENTED-ENTRY-REF>
                [!IF "as:modconf('Cdd_Pwm')[1]/CddPwmGeneral/CddPwmTypeofInterruptFunction = 'CDD_PWM_ISR_CAT2'"!][!//
                  <INTERRUPT-CATEGORY>CAT-2</INTERRUPT-CATEGORY>
                [!ELSE!][!//
                  <INTERRUPT-CATEGORY>CAT-1</INTERRUPT-CATEGORY>
                [!ENDIF!][!//
                  <INTERRUPT-SOURCE>Hardware</INTERRUPT-SOURCE>
                </BSW-INTERRUPT-ENTITY>
              [!ENDIF!][!//
              [!IF "num:i($CddChannel) = '10'"!][!//
                <BSW-INTERRUPT-ENTITY UUID="ccafdbd1-704f-4b19-817c-cbb9b2677c12">
                  <SHORT-NAME>Cdd_Pwm_G1_Ch10Isr</SHORT-NAME>
                  <MINIMUM-START-INTERVAL>0.0</MINIMUM-START-INTERVAL>
                  <REENTRANCY-LEVEL>NON-REENTRANT</REENTRANCY-LEVEL>
                  <IMPLEMENTED-ENTRY-REF DEST="BSW-MODULE-ENTRY">/Cdd_Pwm_TI_AM263x/Cdd_Pwm_ModuleEntry/Cdd_Pwm_G1_Ch10Isr</IMPLEMENTED-ENTRY-REF>
                [!IF "as:modconf('Cdd_Pwm')[1]/CddPwmGeneral/CddPwmTypeofInterruptFunction = 'CDD_PWM_ISR_CAT2'"!][!//
                  <INTERRUPT-CATEGORY>CAT-2</INTERRUPT-CATEGORY>
                [!ELSE!][!//
                  <INTERRUPT-CATEGORY>CAT-1</INTERRUPT-CATEGORY>
                [!ENDIF!][!//
                  <INTERRUPT-SOURCE>Hardware</INTERRUPT-SOURCE>
                </BSW-INTERRUPT-ENTITY>
              [!ENDIF!][!//
              [!IF "num:i($CddChannel) = '11'"!][!//
                <BSW-INTERRUPT-ENTITY UUID="31f24d44-f65c-41ea-acc8-8d7755972fef">
                  <SHORT-NAME>Cdd_Pwm_G1_Ch11Isr</SHORT-NAME>
                  <MINIMUM-START-INTERVAL>0.0</MINIMUM-START-INTERVAL>
                  <REENTRANCY-LEVEL>NON-REENTRANT</REENTRANCY-LEVEL>
                  <IMPLEMENTED-ENTRY-REF DEST="BSW-MODULE-ENTRY">/Cdd_Pwm_TI_AM263x/Cdd_Pwm_ModuleEntry/Cdd_Pwm_G1_Ch11Isr</IMPLEMENTED-ENTRY-REF>
                [!IF "as:modconf('Cdd_Pwm')[1]/CddPwmGeneral/CddPwmTypeofInterruptFunction = 'CDD_PWM_ISR_CAT2'"!][!//
                  <INTERRUPT-CATEGORY>CAT-2</INTERRUPT-CATEGORY>
                [!ELSE!][!//
                  <INTERRUPT-CATEGORY>CAT-1</INTERRUPT-CATEGORY>
                [!ENDIF!][!//
                  <INTERRUPT-SOURCE>Hardware</INTERRUPT-SOURCE>
                </BSW-INTERRUPT-ENTITY>
              [!ENDIF!][!//
              [!IF "num:i($CddChannel) = '12'"!][!//
                <BSW-INTERRUPT-ENTITY UUID="e4887053-13c9-407c-b874-bb17d20072c1">
                  <SHORT-NAME>Cdd_Pwm_G1_Ch12Isr</SHORT-NAME>
                  <MINIMUM-START-INTERVAL>0.0</MINIMUM-START-INTERVAL>
                  <REENTRANCY-LEVEL>NON-REENTRANT</REENTRANCY-LEVEL>
                  <IMPLEMENTED-ENTRY-REF DEST="BSW-MODULE-ENTRY">/Cdd_Pwm_TI_AM263x/Cdd_Pwm_ModuleEntry/Cdd_Pwm_G1_Ch12Isr</IMPLEMENTED-ENTRY-REF>
                [!IF "as:modconf('Cdd_Pwm')[1]/CddPwmGeneral/CddPwmTypeofInterruptFunction = 'CDD_PWM_ISR_CAT2'"!][!//
                  <INTERRUPT-CATEGORY>CAT-2</INTERRUPT-CATEGORY>
                [!ELSE!][!//
                  <INTERRUPT-CATEGORY>CAT-1</INTERRUPT-CATEGORY>
                [!ENDIF!][!//
                  <INTERRUPT-SOURCE>Hardware</INTERRUPT-SOURCE>
                </BSW-INTERRUPT-ENTITY>
              [!ENDIF!][!//
              [!IF "num:i($CddChannel) = '13'"!][!//
                <BSW-INTERRUPT-ENTITY UUID="52111581-3e0e-4471-9cf8-c9d65f297163">
                  <SHORT-NAME>Cdd_Pwm_G1_Ch13Isr</SHORT-NAME>
                  <MINIMUM-START-INTERVAL>0.0</MINIMUM-START-INTERVAL>
                  <REENTRANCY-LEVEL>NON-REENTRANT</REENTRANCY-LEVEL>
                  <IMPLEMENTED-ENTRY-REF DEST="BSW-MODULE-ENTRY">/Cdd_Pwm_TI_AM263x/Cdd_Pwm_ModuleEntry/Cdd_Pwm_G1_Ch13Isr</IMPLEMENTED-ENTRY-REF>
                [!IF "as:modconf('Cdd_Pwm')[1]/CddPwmGeneral/CddPwmTypeofInterruptFunction = 'CDD_PWM_ISR_CAT2'"!][!//
                  <INTERRUPT-CATEGORY>CAT-2</INTERRUPT-CATEGORY>
                [!ELSE!][!//
                  <INTERRUPT-CATEGORY>CAT-1</INTERRUPT-CATEGORY>
                [!ENDIF!][!//
                  <INTERRUPT-SOURCE>Hardware</INTERRUPT-SOURCE>
                </BSW-INTERRUPT-ENTITY>
              [!ENDIF!][!//
              [!IF "num:i($CddChannel) = '14'"!][!//
                <BSW-INTERRUPT-ENTITY UUID="05e34b7f-5751-48a9-9860-0aa5f6ed5cfc">
                  <SHORT-NAME>Cdd_Pwm_G1_Ch14Isr</SHORT-NAME>
                  <MINIMUM-START-INTERVAL>0.0</MINIMUM-START-INTERVAL>
                  <REENTRANCY-LEVEL>NON-REENTRANT</REENTRANCY-LEVEL>
                  <IMPLEMENTED-ENTRY-REF DEST="BSW-MODULE-ENTRY">/Cdd_Pwm_TI_AM263x/Cdd_Pwm_ModuleEntry/Cdd_Pwm_G1_Ch14Isr</IMPLEMENTED-ENTRY-REF>
                [!IF "as:modconf('Cdd_Pwm')[1]/CddPwmGeneral/CddPwmTypeofInterruptFunction = 'CDD_PWM_ISR_CAT2'"!][!//
                  <INTERRUPT-CATEGORY>CAT-2</INTERRUPT-CATEGORY>
                [!ELSE!][!//
                  <INTERRUPT-CATEGORY>CAT-1</INTERRUPT-CATEGORY>
                [!ENDIF!][!//
                  <INTERRUPT-SOURCE>Hardware</INTERRUPT-SOURCE>
                </BSW-INTERRUPT-ENTITY>
              [!ENDIF!][!//
              [!IF "num:i($CddChannel) = '15'"!][!//
                <BSW-INTERRUPT-ENTITY UUID="37ea2e87-582b-405c-90aa-2b78825fb979">
                  <SHORT-NAME>Cdd_Pwm_G1_Ch15Isr</SHORT-NAME>
                  <MINIMUM-START-INTERVAL>0.0</MINIMUM-START-INTERVAL>
                  <REENTRANCY-LEVEL>NON-REENTRANT</REENTRANCY-LEVEL>
                  <IMPLEMENTED-ENTRY-REF DEST="BSW-MODULE-ENTRY">/Cdd_Pwm_TI_AM263x/Cdd_Pwm_ModuleEntry/Cdd_Pwm_G1_Ch15Isr</IMPLEMENTED-ENTRY-REF>
                [!IF "as:modconf('Cdd_Pwm')[1]/CddPwmGeneral/CddPwmTypeofInterruptFunction = 'CDD_PWM_ISR_CAT2'"!][!//
                  <INTERRUPT-CATEGORY>CAT-2</INTERRUPT-CATEGORY>
                [!ELSE!][!//
                  <INTERRUPT-CATEGORY>CAT-1</INTERRUPT-CATEGORY>
                [!ENDIF!][!//
                  <INTERRUPT-SOURCE>Hardware</INTERRUPT-SOURCE>
                </BSW-INTERRUPT-ENTITY>
              [!ENDIF!][!//
              [!IF "num:i($CddChannel) = '16'"!][!//
                <BSW-INTERRUPT-ENTITY UUID="03013da1-82cd-4acf-9eb7-7c9ae9de5505">
                  <SHORT-NAME>Cdd_Pwm_G1_Ch16Isr</SHORT-NAME>
                  <MINIMUM-START-INTERVAL>0.0</MINIMUM-START-INTERVAL>
                  <REENTRANCY-LEVEL>NON-REENTRANT</REENTRANCY-LEVEL>
                  <IMPLEMENTED-ENTRY-REF DEST="BSW-MODULE-ENTRY">/Cdd_Pwm_TI_AM263x/Cdd_Pwm_ModuleEntry/Cdd_Pwm_G1_Ch16Isr</IMPLEMENTED-ENTRY-REF>
                [!IF "as:modconf('Cdd_Pwm')[1]/CddPwmGeneral/CddPwmTypeofInterruptFunction = 'CDD_PWM_ISR_CAT2'"!][!//
                  <INTERRUPT-CATEGORY>CAT-2</INTERRUPT-CATEGORY>
                [!ELSE!][!//
                  <INTERRUPT-CATEGORY>CAT-1</INTERRUPT-CATEGORY>
                [!ENDIF!][!//
                  <INTERRUPT-SOURCE>Hardware</INTERRUPT-SOURCE>
                </BSW-INTERRUPT-ENTITY>
              [!ENDIF!][!//
              [!IF "num:i($CddChannel) = '17'"!][!//
                <BSW-INTERRUPT-ENTITY UUID="3a66bf28-b112-4ddf-ad76-709d29f69032">
                  <SHORT-NAME>Cdd_Pwm_G1_Ch17Isr</SHORT-NAME>
                  <MINIMUM-START-INTERVAL>0.0</MINIMUM-START-INTERVAL>
                  <REENTRANCY-LEVEL>NON-REENTRANT</REENTRANCY-LEVEL>
                  <IMPLEMENTED-ENTRY-REF DEST="BSW-MODULE-ENTRY">/Cdd_Pwm_TI_AM263x/Cdd_Pwm_ModuleEntry/Cdd_Pwm_G1_Ch17Isr</IMPLEMENTED-ENTRY-REF>
                [!IF "as:modconf('Cdd_Pwm')[1]/CddPwmGeneral/CddPwmTypeofInterruptFunction = 'CDD_PWM_ISR_CAT2'"!][!//
                  <INTERRUPT-CATEGORY>CAT-2</INTERRUPT-CATEGORY>
                [!ELSE!][!//
                  <INTERRUPT-CATEGORY>CAT-1</INTERRUPT-CATEGORY>
                [!ENDIF!][!//
                  <INTERRUPT-SOURCE>Hardware</INTERRUPT-SOURCE>
                </BSW-INTERRUPT-ENTITY>
              [!ENDIF!][!//
              [!IF "num:i($CddChannel) = '18'"!][!//
                <BSW-INTERRUPT-ENTITY UUID="d67d0ca2-278d-4ce1-98e2-d8f291d47df5">
                  <SHORT-NAME>Cdd_Pwm_G1_Ch18Isr</SHORT-NAME>
                  <MINIMUM-START-INTERVAL>0.0</MINIMUM-START-INTERVAL>
                  <REENTRANCY-LEVEL>NON-REENTRANT</REENTRANCY-LEVEL>
                  <IMPLEMENTED-ENTRY-REF DEST="BSW-MODULE-ENTRY">/Cdd_Pwm_TI_AM263x/Cdd_Pwm_ModuleEntry/Cdd_Pwm_G1_Ch18Isr</IMPLEMENTED-ENTRY-REF>
                [!IF "as:modconf('Cdd_Pwm')[1]/CddPwmGeneral/CddPwmTypeofInterruptFunction = 'CDD_PWM_ISR_CAT2'"!][!//
                  <INTERRUPT-CATEGORY>CAT-2</INTERRUPT-CATEGORY>
                [!ELSE!][!//
                  <INTERRUPT-CATEGORY>CAT-1</INTERRUPT-CATEGORY>
                [!ENDIF!][!//
                  <INTERRUPT-SOURCE>Hardware</INTERRUPT-SOURCE>
                </BSW-INTERRUPT-ENTITY>
              [!ENDIF!][!//
              [!IF "num:i($CddChannel) = '19'"!][!//
                <BSW-INTERRUPT-ENTITY UUID="2d6e2483-7312-48b2-bc87-768b395b1825">
                  <SHORT-NAME>Cdd_Pwm_G1_Ch19Isr</SHORT-NAME>
                  <MINIMUM-START-INTERVAL>0.0</MINIMUM-START-INTERVAL>
                  <REENTRANCY-LEVEL>NON-REENTRANT</REENTRANCY-LEVEL>
                  <IMPLEMENTED-ENTRY-REF DEST="BSW-MODULE-ENTRY">/Cdd_Pwm_TI_AM263x/Cdd_Pwm_ModuleEntry/Cdd_Pwm_G1_Ch19Isr</IMPLEMENTED-ENTRY-REF>
                [!IF "as:modconf('Cdd_Pwm')[1]/CddPwmGeneral/CddPwmTypeofInterruptFunction = 'CDD_PWM_ISR_CAT2'"!][!//
                  <INTERRUPT-CATEGORY>CAT-2</INTERRUPT-CATEGORY>
                [!ELSE!][!//
                  <INTERRUPT-CATEGORY>CAT-1</INTERRUPT-CATEGORY>
                [!ENDIF!][!//
                  <INTERRUPT-SOURCE>Hardware</INTERRUPT-SOURCE>
                </BSW-INTERRUPT-ENTITY>
              [!ENDIF!][!//
              [!IF "num:i($CddChannel) = '1'"!][!//
                <BSW-INTERRUPT-ENTITY UUID="15781cfb-fa49-4b2b-a0b7-5aeaaa4d60af">
                  <SHORT-NAME>Cdd_Pwm_G1_Ch1Isr</SHORT-NAME>
                  <MINIMUM-START-INTERVAL>0.0</MINIMUM-START-INTERVAL>
                  <REENTRANCY-LEVEL>NON-REENTRANT</REENTRANCY-LEVEL>
                  <IMPLEMENTED-ENTRY-REF DEST="BSW-MODULE-ENTRY">/Cdd_Pwm_TI_AM263x/Cdd_Pwm_ModuleEntry/Cdd_Pwm_G1_Ch1Isr</IMPLEMENTED-ENTRY-REF>
                [!IF "as:modconf('Cdd_Pwm')[1]/CddPwmGeneral/CddPwmTypeofInterruptFunction = 'CDD_PWM_ISR_CAT2'"!][!//
                  <INTERRUPT-CATEGORY>CAT-2</INTERRUPT-CATEGORY>
                [!ELSE!][!//
                  <INTERRUPT-CATEGORY>CAT-1</INTERRUPT-CATEGORY>
                [!ENDIF!][!//
                  <INTERRUPT-SOURCE>Hardware</INTERRUPT-SOURCE>
                </BSW-INTERRUPT-ENTITY>
              [!ENDIF!][!//
              [!IF "num:i($CddChannel) = '20'"!][!//
                <BSW-INTERRUPT-ENTITY UUID="469b6ae1-fb0f-4701-a3b6-acf7e2923673">
                  <SHORT-NAME>Cdd_Pwm_G1_Ch20Isr</SHORT-NAME>
                  <MINIMUM-START-INTERVAL>0.0</MINIMUM-START-INTERVAL>
                  <REENTRANCY-LEVEL>NON-REENTRANT</REENTRANCY-LEVEL>
                  <IMPLEMENTED-ENTRY-REF DEST="BSW-MODULE-ENTRY">/Cdd_Pwm_TI_AM263x/Cdd_Pwm_ModuleEntry/Cdd_Pwm_G1_Ch20Isr</IMPLEMENTED-ENTRY-REF>
                [!IF "as:modconf('Cdd_Pwm')[1]/CddPwmGeneral/CddPwmTypeofInterruptFunction = 'CDD_PWM_ISR_CAT2'"!][!//
                  <INTERRUPT-CATEGORY>CAT-2</INTERRUPT-CATEGORY>
                [!ELSE!][!//
                  <INTERRUPT-CATEGORY>CAT-1</INTERRUPT-CATEGORY>
                [!ENDIF!][!//
                  <INTERRUPT-SOURCE>Hardware</INTERRUPT-SOURCE>
                </BSW-INTERRUPT-ENTITY>
              [!ENDIF!][!//
              [!IF "num:i($CddChannel) = '21'"!][!//
                <BSW-INTERRUPT-ENTITY UUID="579d390b-edbc-4ad8-8921-18c3f8d53e22">
                  <SHORT-NAME>Cdd_Pwm_G1_Ch21Isr</SHORT-NAME>
                  <MINIMUM-START-INTERVAL>0.0</MINIMUM-START-INTERVAL>
                  <REENTRANCY-LEVEL>NON-REENTRANT</REENTRANCY-LEVEL>
                  <IMPLEMENTED-ENTRY-REF DEST="BSW-MODULE-ENTRY">/Cdd_Pwm_TI_AM263x/Cdd_Pwm_ModuleEntry/Cdd_Pwm_G1_Ch21Isr</IMPLEMENTED-ENTRY-REF>
                [!IF "as:modconf('Cdd_Pwm')[1]/CddPwmGeneral/CddPwmTypeofInterruptFunction = 'CDD_PWM_ISR_CAT2'"!][!//
                  <INTERRUPT-CATEGORY>CAT-2</INTERRUPT-CATEGORY>
                [!ELSE!][!//
                  <INTERRUPT-CATEGORY>CAT-1</INTERRUPT-CATEGORY>
                [!ENDIF!][!//
                  <INTERRUPT-SOURCE>Hardware</INTERRUPT-SOURCE>
                </BSW-INTERRUPT-ENTITY>
              [!ENDIF!][!//
              [!IF "num:i($CddChannel) = '22'"!][!//
                <BSW-INTERRUPT-ENTITY UUID="2294c3ba-2fc1-4f9b-88a5-ad895ccc01b4">
                  <SHORT-NAME>Cdd_Pwm_G1_Ch22Isr</SHORT-NAME>
                  <MINIMUM-START-INTERVAL>0.0</MINIMUM-START-INTERVAL>
                  <REENTRANCY-LEVEL>NON-REENTRANT</REENTRANCY-LEVEL>
                  <IMPLEMENTED-ENTRY-REF DEST="BSW-MODULE-ENTRY">/Cdd_Pwm_TI_AM263x/Cdd_Pwm_ModuleEntry/Cdd_Pwm_G1_Ch22Isr</IMPLEMENTED-ENTRY-REF>
                [!IF "as:modconf('Cdd_Pwm')[1]/CddPwmGeneral/CddPwmTypeofInterruptFunction = 'CDD_PWM_ISR_CAT2'"!][!//
                  <INTERRUPT-CATEGORY>CAT-2</INTERRUPT-CATEGORY>
                [!ELSE!][!//
                  <INTERRUPT-CATEGORY>CAT-1</INTERRUPT-CATEGORY>
                [!ENDIF!][!//
                  <INTERRUPT-SOURCE>Hardware</INTERRUPT-SOURCE>
                </BSW-INTERRUPT-ENTITY>
              [!ENDIF!][!//
              [!IF "num:i($CddChannel) = '23'"!][!//
                <BSW-INTERRUPT-ENTITY UUID="bbbbc0ee-e053-442e-8b97-213edf87efe8">
                  <SHORT-NAME>Cdd_Pwm_G1_Ch23Isr</SHORT-NAME>
                  <MINIMUM-START-INTERVAL>0.0</MINIMUM-START-INTERVAL>
                  <REENTRANCY-LEVEL>NON-REENTRANT</REENTRANCY-LEVEL>
                  <IMPLEMENTED-ENTRY-REF DEST="BSW-MODULE-ENTRY">/Cdd_Pwm_TI_AM263x/Cdd_Pwm_ModuleEntry/Cdd_Pwm_G1_Ch23Isr</IMPLEMENTED-ENTRY-REF>
                [!IF "as:modconf('Cdd_Pwm')[1]/CddPwmGeneral/CddPwmTypeofInterruptFunction = 'CDD_PWM_ISR_CAT2'"!][!//
                  <INTERRUPT-CATEGORY>CAT-2</INTERRUPT-CATEGORY>
                [!ELSE!][!//
                  <INTERRUPT-CATEGORY>CAT-1</INTERRUPT-CATEGORY>
                [!ENDIF!][!//
                  <INTERRUPT-SOURCE>Hardware</INTERRUPT-SOURCE>
                </BSW-INTERRUPT-ENTITY>
              [!ENDIF!][!//
              [!IF "num:i($CddChannel) = '24'"!][!//
                <BSW-INTERRUPT-ENTITY UUID="618c2883-bff2-4371-85b2-367a8dd2c407">
                  <SHORT-NAME>Cdd_Pwm_G1_Ch24Isr</SHORT-NAME>
                  <MINIMUM-START-INTERVAL>0.0</MINIMUM-START-INTERVAL>
                  <REENTRANCY-LEVEL>NON-REENTRANT</REENTRANCY-LEVEL>
                  <IMPLEMENTED-ENTRY-REF DEST="BSW-MODULE-ENTRY">/Cdd_Pwm_TI_AM263x/Cdd_Pwm_ModuleEntry/Cdd_Pwm_G1_Ch24Isr</IMPLEMENTED-ENTRY-REF>
                [!IF "as:modconf('Cdd_Pwm')[1]/CddPwmGeneral/CddPwmTypeofInterruptFunction = 'CDD_PWM_ISR_CAT2'"!][!//
                  <INTERRUPT-CATEGORY>CAT-2</INTERRUPT-CATEGORY>
                [!ELSE!][!//
                  <INTERRUPT-CATEGORY>CAT-1</INTERRUPT-CATEGORY>
                [!ENDIF!][!//
                  <INTERRUPT-SOURCE>Hardware</INTERRUPT-SOURCE>
                </BSW-INTERRUPT-ENTITY>
              [!ENDIF!][!//
              [!IF "num:i($CddChannel) = '25'"!][!//
                <BSW-INTERRUPT-ENTITY UUID="e1bf86c2-ce4c-4777-9693-8b585aa8c803">
                  <SHORT-NAME>Cdd_Pwm_G1_Ch25Isr</SHORT-NAME>
                  <MINIMUM-START-INTERVAL>0.0</MINIMUM-START-INTERVAL>
                  <REENTRANCY-LEVEL>NON-REENTRANT</REENTRANCY-LEVEL>
                  <IMPLEMENTED-ENTRY-REF DEST="BSW-MODULE-ENTRY">/Cdd_Pwm_TI_AM263x/Cdd_Pwm_ModuleEntry/Cdd_Pwm_G1_Ch25Isr</IMPLEMENTED-ENTRY-REF>
                [!IF "as:modconf('Cdd_Pwm')[1]/CddPwmGeneral/CddPwmTypeofInterruptFunction = 'CDD_PWM_ISR_CAT2'"!][!//
                  <INTERRUPT-CATEGORY>CAT-2</INTERRUPT-CATEGORY>
                [!ELSE!][!//
                  <INTERRUPT-CATEGORY>CAT-1</INTERRUPT-CATEGORY>
                [!ENDIF!][!//
                  <INTERRUPT-SOURCE>Hardware</INTERRUPT-SOURCE>
                </BSW-INTERRUPT-ENTITY>
              [!ENDIF!][!//
              [!IF "num:i($CddChannel) = '26'"!][!//
                <BSW-INTERRUPT-ENTITY UUID="0f4a0e00-7f37-4237-9e1e-1dae6d1f8c56">
                  <SHORT-NAME>Cdd_Pwm_G1_Ch26Isr</SHORT-NAME>
                  <MINIMUM-START-INTERVAL>0.0</MINIMUM-START-INTERVAL>
                  <REENTRANCY-LEVEL>NON-REENTRANT</REENTRANCY-LEVEL>
                  <IMPLEMENTED-ENTRY-REF DEST="BSW-MODULE-ENTRY">/Cdd_Pwm_TI_AM263x/Cdd_Pwm_ModuleEntry/Cdd_Pwm_G1_Ch26Isr</IMPLEMENTED-ENTRY-REF>
                [!IF "as:modconf('Cdd_Pwm')[1]/CddPwmGeneral/CddPwmTypeofInterruptFunction = 'CDD_PWM_ISR_CAT2'"!][!//
                  <INTERRUPT-CATEGORY>CAT-2</INTERRUPT-CATEGORY>
                [!ELSE!][!//
                  <INTERRUPT-CATEGORY>CAT-1</INTERRUPT-CATEGORY>
                [!ENDIF!][!//
                  <INTERRUPT-SOURCE>Hardware</INTERRUPT-SOURCE>
                </BSW-INTERRUPT-ENTITY>
              [!ENDIF!][!//
              [!IF "num:i($CddChannel) = '27'"!][!//
                <BSW-INTERRUPT-ENTITY UUID="b5d29d75-88d0-4eec-b04b-ad6d9011cda9">
                  <SHORT-NAME>Cdd_Pwm_G1_Ch27Isr</SHORT-NAME>
                  <MINIMUM-START-INTERVAL>0.0</MINIMUM-START-INTERVAL>
                  <REENTRANCY-LEVEL>NON-REENTRANT</REENTRANCY-LEVEL>
                  <IMPLEMENTED-ENTRY-REF DEST="BSW-MODULE-ENTRY">/Cdd_Pwm_TI_AM263x/Cdd_Pwm_ModuleEntry/Cdd_Pwm_G1_Ch27Isr</IMPLEMENTED-ENTRY-REF>
                [!IF "as:modconf('Cdd_Pwm')[1]/CddPwmGeneral/CddPwmTypeofInterruptFunction = 'CDD_PWM_ISR_CAT2'"!][!//
                  <INTERRUPT-CATEGORY>CAT-2</INTERRUPT-CATEGORY>
                [!ELSE!][!//
                  <INTERRUPT-CATEGORY>CAT-1</INTERRUPT-CATEGORY>
                [!ENDIF!][!//
                  <INTERRUPT-SOURCE>Hardware</INTERRUPT-SOURCE>
                </BSW-INTERRUPT-ENTITY>
              [!ENDIF!][!//
              [!IF "num:i($CddChannel) = '28'"!][!//
                <BSW-INTERRUPT-ENTITY UUID="c6932eff-4239-40df-836b-01bc140db277">
                  <SHORT-NAME>Cdd_Pwm_G1_Ch28Isr</SHORT-NAME>
                  <MINIMUM-START-INTERVAL>0.0</MINIMUM-START-INTERVAL>
                  <REENTRANCY-LEVEL>NON-REENTRANT</REENTRANCY-LEVEL>
                  <IMPLEMENTED-ENTRY-REF DEST="BSW-MODULE-ENTRY">/Cdd_Pwm_TI_AM263x/Cdd_Pwm_ModuleEntry/Cdd_Pwm_G1_Ch28Isr</IMPLEMENTED-ENTRY-REF>
                [!IF "as:modconf('Cdd_Pwm')[1]/CddPwmGeneral/CddPwmTypeofInterruptFunction = 'CDD_PWM_ISR_CAT2'"!][!//
                  <INTERRUPT-CATEGORY>CAT-2</INTERRUPT-CATEGORY>
                [!ELSE!][!//
                  <INTERRUPT-CATEGORY>CAT-1</INTERRUPT-CATEGORY>
                [!ENDIF!][!//
                  <INTERRUPT-SOURCE>Hardware</INTERRUPT-SOURCE>
                </BSW-INTERRUPT-ENTITY>
              [!ENDIF!][!//
              [!IF "num:i($CddChannel) = '29'"!][!//
                <BSW-INTERRUPT-ENTITY UUID="a934a087-0265-4a96-98fe-fba4c713d336">
                  <SHORT-NAME>Cdd_Pwm_G1_Ch29Isr</SHORT-NAME>
                  <MINIMUM-START-INTERVAL>0.0</MINIMUM-START-INTERVAL>
                  <REENTRANCY-LEVEL>NON-REENTRANT</REENTRANCY-LEVEL>
                  <IMPLEMENTED-ENTRY-REF DEST="BSW-MODULE-ENTRY">/Cdd_Pwm_TI_AM263x/Cdd_Pwm_ModuleEntry/Cdd_Pwm_G1_Ch29Isr</IMPLEMENTED-ENTRY-REF>
                [!IF "as:modconf('Cdd_Pwm')[1]/CddPwmGeneral/CddPwmTypeofInterruptFunction = 'CDD_PWM_ISR_CAT2'"!][!//
                  <INTERRUPT-CATEGORY>CAT-2</INTERRUPT-CATEGORY>
                [!ELSE!][!//
                  <INTERRUPT-CATEGORY>CAT-1</INTERRUPT-CATEGORY>
                [!ENDIF!][!//
                  <INTERRUPT-SOURCE>Hardware</INTERRUPT-SOURCE>
                </BSW-INTERRUPT-ENTITY>
              [!ENDIF!][!//
              [!IF "num:i($CddChannel) = '2'"!][!//
                <BSW-INTERRUPT-ENTITY UUID="ee66c5e3-53e8-4e30-afbc-c3e028716e0c">
                  <SHORT-NAME>Cdd_Pwm_G1_Ch2Isr</SHORT-NAME>
                  <MINIMUM-START-INTERVAL>0.0</MINIMUM-START-INTERVAL>
                  <REENTRANCY-LEVEL>NON-REENTRANT</REENTRANCY-LEVEL>
                  <IMPLEMENTED-ENTRY-REF DEST="BSW-MODULE-ENTRY">/Cdd_Pwm_TI_AM263x/Cdd_Pwm_ModuleEntry/Cdd_Pwm_G1_Ch2Isr</IMPLEMENTED-ENTRY-REF>
                [!IF "as:modconf('Cdd_Pwm')[1]/CddPwmGeneral/CddPwmTypeofInterruptFunction = 'CDD_PWM_ISR_CAT2'"!][!//
                  <INTERRUPT-CATEGORY>CAT-2</INTERRUPT-CATEGORY>
                [!ELSE!][!//
                  <INTERRUPT-CATEGORY>CAT-1</INTERRUPT-CATEGORY>
                [!ENDIF!][!//
                  <INTERRUPT-SOURCE>Hardware</INTERRUPT-SOURCE>
                </BSW-INTERRUPT-ENTITY>
              [!ENDIF!][!//
              [!IF "num:i($CddChannel) = '30'"!][!//
                <BSW-INTERRUPT-ENTITY UUID="3c19d484-37a2-4f8d-acaf-183cb5c331cb">
                  <SHORT-NAME>Cdd_Pwm_G1_Ch30Isr</SHORT-NAME>
                  <MINIMUM-START-INTERVAL>0.0</MINIMUM-START-INTERVAL>
                  <REENTRANCY-LEVEL>NON-REENTRANT</REENTRANCY-LEVEL>
                  <IMPLEMENTED-ENTRY-REF DEST="BSW-MODULE-ENTRY">/Cdd_Pwm_TI_AM263x/Cdd_Pwm_ModuleEntry/Cdd_Pwm_G1_Ch30Isr</IMPLEMENTED-ENTRY-REF>
                [!IF "as:modconf('Cdd_Pwm')[1]/CddPwmGeneral/CddPwmTypeofInterruptFunction = 'CDD_PWM_ISR_CAT2'"!][!//
                  <INTERRUPT-CATEGORY>CAT-2</INTERRUPT-CATEGORY>
                [!ELSE!][!//
                  <INTERRUPT-CATEGORY>CAT-1</INTERRUPT-CATEGORY>
                [!ENDIF!][!//
                  <INTERRUPT-SOURCE>Hardware</INTERRUPT-SOURCE>
                </BSW-INTERRUPT-ENTITY>
              [!ENDIF!][!//
              [!IF "num:i($CddChannel) = '31'"!][!//
                <BSW-INTERRUPT-ENTITY UUID="ed8402ce-1bb7-4d64-8637-b526b4a8966a">
                  <SHORT-NAME>Cdd_Pwm_G1_Ch31Isr</SHORT-NAME>
                  <MINIMUM-START-INTERVAL>0.0</MINIMUM-START-INTERVAL>
                  <REENTRANCY-LEVEL>NON-REENTRANT</REENTRANCY-LEVEL>
                  <IMPLEMENTED-ENTRY-REF DEST="BSW-MODULE-ENTRY">/Cdd_Pwm_TI_AM263x/Cdd_Pwm_ModuleEntry/Cdd_Pwm_G1_Ch31Isr</IMPLEMENTED-ENTRY-REF>
                [!IF "as:modconf('Cdd_Pwm')[1]/CddPwmGeneral/CddPwmTypeofInterruptFunction = 'CDD_PWM_ISR_CAT2'"!][!//
                  <INTERRUPT-CATEGORY>CAT-2</INTERRUPT-CATEGORY>
                [!ELSE!][!//
                  <INTERRUPT-CATEGORY>CAT-1</INTERRUPT-CATEGORY>
                [!ENDIF!][!//
                  <INTERRUPT-SOURCE>Hardware</INTERRUPT-SOURCE>
                </BSW-INTERRUPT-ENTITY>
              [!ENDIF!][!//
              [!IF "num:i($CddChannel) = '3'"!][!//
                <BSW-INTERRUPT-ENTITY UUID="9941a789-709c-42e4-9bd9-02e0f91d30ec">
                  <SHORT-NAME>Cdd_Pwm_G1_Ch3Isr</SHORT-NAME>
                  <MINIMUM-START-INTERVAL>0.0</MINIMUM-START-INTERVAL>
                  <REENTRANCY-LEVEL>NON-REENTRANT</REENTRANCY-LEVEL>
                  <IMPLEMENTED-ENTRY-REF DEST="BSW-MODULE-ENTRY">/Cdd_Pwm_TI_AM263x/Cdd_Pwm_ModuleEntry/Cdd_Pwm_G1_Ch3Isr</IMPLEMENTED-ENTRY-REF>
                [!IF "as:modconf('Cdd_Pwm')[1]/CddPwmGeneral/CddPwmTypeofInterruptFunction = 'CDD_PWM_ISR_CAT2'"!][!//
                  <INTERRUPT-CATEGORY>CAT-2</INTERRUPT-CATEGORY>
                [!ELSE!][!//
                  <INTERRUPT-CATEGORY>CAT-1</INTERRUPT-CATEGORY>
                [!ENDIF!][!//
                  <INTERRUPT-SOURCE>Hardware</INTERRUPT-SOURCE>
                </BSW-INTERRUPT-ENTITY>
              [!ENDIF!][!//
              [!IF "num:i($CddChannel) = '4'"!][!//
                <BSW-INTERRUPT-ENTITY UUID="19bb55b1-98f8-4f9b-b64c-483fd41a4da7">
                  <SHORT-NAME>Cdd_Pwm_G1_Ch4Isr</SHORT-NAME>
                  <MINIMUM-START-INTERVAL>0.0</MINIMUM-START-INTERVAL>
                  <REENTRANCY-LEVEL>NON-REENTRANT</REENTRANCY-LEVEL>
                  <IMPLEMENTED-ENTRY-REF DEST="BSW-MODULE-ENTRY">/Cdd_Pwm_TI_AM263x/Cdd_Pwm_ModuleEntry/Cdd_Pwm_G1_Ch4Isr</IMPLEMENTED-ENTRY-REF>
                [!IF "as:modconf('Cdd_Pwm')[1]/CddPwmGeneral/CddPwmTypeofInterruptFunction = 'CDD_PWM_ISR_CAT2'"!][!//
                  <INTERRUPT-CATEGORY>CAT-2</INTERRUPT-CATEGORY>
                [!ELSE!][!//
                  <INTERRUPT-CATEGORY>CAT-1</INTERRUPT-CATEGORY>
                [!ENDIF!][!//
                  <INTERRUPT-SOURCE>Hardware</INTERRUPT-SOURCE>
                </BSW-INTERRUPT-ENTITY>
              [!ENDIF!][!//
              [!IF "num:i($CddChannel) = '5'"!][!//
                <BSW-INTERRUPT-ENTITY UUID="f4e6422b-7278-42bb-af21-81956b41af89">
                  <SHORT-NAME>Cdd_Pwm_G1_Ch5Isr</SHORT-NAME>
                  <MINIMUM-START-INTERVAL>0.0</MINIMUM-START-INTERVAL>
                  <REENTRANCY-LEVEL>NON-REENTRANT</REENTRANCY-LEVEL>
                  <IMPLEMENTED-ENTRY-REF DEST="BSW-MODULE-ENTRY">/Cdd_Pwm_TI_AM263x/Cdd_Pwm_ModuleEntry/Cdd_Pwm_G1_Ch5Isr</IMPLEMENTED-ENTRY-REF>
                [!IF "as:modconf('Cdd_Pwm')[1]/CddPwmGeneral/CddPwmTypeofInterruptFunction = 'CDD_PWM_ISR_CAT2'"!][!//
                  <INTERRUPT-CATEGORY>CAT-2</INTERRUPT-CATEGORY>
                [!ELSE!][!//
                  <INTERRUPT-CATEGORY>CAT-1</INTERRUPT-CATEGORY>
                [!ENDIF!][!//
                  <INTERRUPT-SOURCE>Hardware</INTERRUPT-SOURCE>
                </BSW-INTERRUPT-ENTITY>
              [!ENDIF!][!//
