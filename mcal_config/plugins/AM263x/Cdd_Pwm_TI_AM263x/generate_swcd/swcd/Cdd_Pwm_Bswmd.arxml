[part 2 of 4]
				<BSW-CALLED-ENTITY UUID="c218a2be-3247-4a22-8057-900dbda002cf">  (continued)
              [!IF "num:i($CddChannel) = '6'"!][!//
                <BSW-INTERRUPT-ENTITY UUID="ee95a0ff-69c3-40a6-999f-100dc3716793">
                  <SHORT-NAME>Cdd_Pwm_G1_Ch6Isr</SHORT-NAME>
                  <MINIMUM-START-INTERVAL>0.0</MINIMUM-START-INTERVAL>
                  <REENTRANCY-LEVEL>NON-REENTRANT</REENTRANCY-LEVEL>
                  <IMPLEMENTED-ENTRY-REF DEST="BSW-MODULE-ENTRY">/Cdd_Pwm_TI_AM263x/Cdd_Pwm_ModuleEntry/Cdd_Pwm_G1_Ch6Isr</IMPLEMENTED-ENTRY-REF>
                [!IF "as:modconf('Cdd_Pwm')[1]/CddPwmGeneral/CddPwmTypeofInterruptFunction = 'CDD_PWM_ISR_CAT2'"!][!//
                  <INTERRUPT-CATEGORY>CAT-2</INTERRUPT-CATEGORY>
                [!ELSE!][!//
                  <INTERRUPT-CATEGORY>CAT-1</INTERRUPT-CATEGORY>
                [!ENDIF!][!//
                  <INTERRUPT-SOURCE>Hardware</INTERRUPT-SOURCE>
                </BSW-INTERRUPT-ENTITY>
              [!ENDIF!][!//
              [!IF "num:i($CddChannel) = '7'"!][!//
                <BSW-INTERRUPT-ENTITY UUID="7233dd79-1a9a-42ee-8988-419b111c3845">
                  <SHORT-NAME>Cdd_Pwm_G1_Ch7Isr</SHORT-NAME>
                  <MINIMUM-START-INTERVAL>0.0</MINIMUM-START-INTERVAL>
                  <REENTRANCY-LEVEL>NON-REENTRANT</REENTRANCY-LEVEL>
                  <IMPLEMENTED-ENTRY-REF DEST="BSW-MODULE-ENTRY">/Cdd_Pwm_TI_AM263x/Cdd_Pwm_ModuleEntry/Cdd_Pwm_G1_Ch7Isr</IMPLEMENTED-ENTRY-REF>
                [!IF "as:modconf('Cdd_Pwm')[1]/CddPwmGeneral/CddPwmTypeofInterruptFunction = 'CDD_PWM_ISR_CAT2'"!][!//
                  <INTERRUPT-CATEGORY>CAT-2</INTERRUPT-CATEGORY>
                [!ELSE!][!//
                  <INTERRUPT-CATEGORY>CAT-1</INTERRUPT-CATEGORY>
                [!ENDIF!][!//
                  <INTERRUPT-SOURCE>Hardware</INTERRUPT-SOURCE>
                </BSW-INTERRUPT-ENTITY>
              [!ENDIF!][!//
              [!IF "num:i($CddChannel) = '8'"!][!//
                <BSW-INTERRUPT-ENTITY UUID="6e3683f5-7bf4-4848-b7fd-d271efa8edf0">
                  <SHORT-NAME>Cdd_Pwm_G1_Ch8Isr</SHORT-NAME>
                  <MINIMUM-START-INTERVAL>0.0</MINIMUM-START-INTERVAL>
                  <REENTRANCY-LEVEL>NON-REENTRANT</REENTRANCY-LEVEL>
                  <IMPLEMENTED-ENTRY-REF DEST="BSW-MODULE-ENTRY">/Cdd_Pwm_TI_AM263x/Cdd_Pwm_ModuleEntry/Cdd_Pwm_G1_Ch8Isr</IMPLEMENTED-ENTRY-REF>
                [!IF "as:modconf('Cdd_Pwm')[1]/CddPwmGeneral/CddPwmTypeofInterruptFunction = 'CDD_PWM_ISR_CAT2'"!][!//
                  <INTERRUPT-CATEGORY>CAT-2</INTERRUPT-CATEGORY>
                [!ELSE!][!//
                  <INTERRUPT-CATEGORY>CAT-1</INTERRUPT-CATEGORY>
                [!ENDIF!][!//
                  <INTERRUPT-SOURCE>Hardware</INTERRUPT-SOURCE>
                </BSW-INTERRUPT-ENTITY>
              [!ENDIF!][!//
              [!IF "num:i($CddChannel) = '9'"!][!//
                <BSW-INTERRUPT-ENTITY UUID="24e390b3-8b68-4234-92da-34b2ca5d20c7">
                  <SHORT-NAME>Cdd_Pwm_G1_Ch9Isr</SHORT-NAME>
                  <MINIMUM-START-INTERVAL>0.0</MINIMUM-START-INTERVAL>
                  <REENTRANCY-LEVEL>NON-REENTRANT</REENTRANCY-LEVEL>
                  <IMPLEMENTED-ENTRY-REF DEST="BSW-MODULE-ENTRY">/Cdd_Pwm_TI_AM263x/Cdd_Pwm_ModuleEntry/Cdd_Pwm_G1_Ch9Isr</IMPLEMENTED-ENTRY-REF>
                [!IF "as:modconf('Cdd_Pwm')[1]/CddPwmGeneral/CddPwmTypeofInterruptFunction = 'CDD_PWM_ISR_CAT2'"!][!//
                  <INTERRUPT-CATEGORY>CAT-2</INTERRUPT-CATEGORY>
                [!ELSE!][!//
                  <INTERRUPT-CATEGORY>CAT-1</INTERRUPT-CATEGORY>
                [!ENDIF!][!//
                  <INTERRUPT-SOURCE>Hardware</INTERRUPT-SOURCE>
                </BSW-INTERRUPT-ENTITY>
              [!ENDIF!][!//
              [!IF "num:i($CddChannel) = '0'"!][!//
                <BSW-INTERRUPT-ENTITY UUID="be022eff-276d-45cd-8fdc-140eae1843b1">
                  <SHORT-NAME>Cdd_Pwm_G1_TzCh0Isr</SHORT-NAME>
                  <MINIMUM-START-INTERVAL>0.0</MINIMUM-START-INTERVAL>
                  <REENTRANCY-LEVEL>NON-REENTRANT</REENTRANCY-LEVEL>
                  <IMPLEMENTED-ENTRY-REF DEST="BSW-MODULE-ENTRY">/Cdd_Pwm_TI_AM263x/Cdd_Pwm_ModuleEntry/Cdd_Pwm_G1_TzCh0Isr</IMPLEMENTED-ENTRY-REF>
                [!IF "as:modconf('Cdd_Pwm')[1]/CddPwmGeneral/CddPwmTypeofInterruptFunction = 'CDD_PWM_ISR_CAT2'"!][!//
                  <INTERRUPT-CATEGORY>CAT-2</INTERRUPT-CATEGORY>
                [!ELSE!][!//
                  <INTERRUPT-CATEGORY>CAT-1</INTERRUPT-CATEGORY>
                [!ENDIF!][!//
                  <INTERRUPT-SOURCE>Hardware</INTERRUPT-SOURCE>
                </BSW-INTERRUPT-ENTITY>
              [!ENDIF!][!//
              [!IF "num:i($CddChannel) = '10'"!][!//
                <BSW-INTERRUPT-ENTITY UUID="a562bfe2-fc48-4ab5-8e70-e8d2ef409d12">
                  <SHORT-NAME>Cdd_Pwm_G1_TzCh10Isr</SHORT-NAME>
                  <MINIMUM-START-INTERVAL>0.0</MINIMUM-START-INTERVAL>
                  <REENTRANCY-LEVEL>NON-REENTRANT</REENTRANCY-LEVEL>
                  <IMPLEMENTED-ENTRY-REF DEST="BSW-MODULE-ENTRY">/Cdd_Pwm_TI_AM263x/Cdd_Pwm_ModuleEntry/Cdd_Pwm_G1_TzCh10Isr</IMPLEMENTED-ENTRY-REF>
                [!IF "as:modconf('Cdd_Pwm')[1]/CddPwmGeneral/CddPwmTypeofInterruptFunction = 'CDD_PWM_ISR_CAT2'"!][!//
                  <INTERRUPT-CATEGORY>CAT-2</INTERRUPT-CATEGORY>
                [!ELSE!][!//
                  <INTERRUPT-CATEGORY>CAT-1</INTERRUPT-CATEGORY>
                [!ENDIF!][!//
                  <INTERRUPT-SOURCE>Hardware</INTERRUPT-SOURCE>
                </BSW-INTERRUPT-ENTITY>
              [!ENDIF!][!//
              [!IF "num:i($CddChannel) = '11'"!][!//
                <BSW-INTERRUPT-ENTITY UUID="ef245bf9-07c0-4f44-8537-dae6b1447b31">
                  <SHORT-NAME>Cdd_Pwm_G1_TzCh11Isr</SHORT-NAME>
                  <MINIMUM-START-INTERVAL>0.0</MINIMUM-START-INTERVAL>
                  <REENTRANCY-LEVEL>NON-REENTRANT</REENTRANCY-LEVEL>
                  <IMPLEMENTED-ENTRY-REF DEST="BSW-MODULE-ENTRY">/Cdd_Pwm_TI_AM263x/Cdd_Pwm_ModuleEntry/Cdd_Pwm_G1_TzCh11Isr</IMPLEMENTED-ENTRY-REF>
                [!IF "as:modconf('Cdd_Pwm')[1]/CddPwmGeneral/CddPwmTypeofInterruptFunction = 'CDD_PWM_ISR_CAT2'"!][!//
                  <INTERRUPT-CATEGORY>CAT-2</INTERRUPT-CATEGORY>
                [!ELSE!][!//
                  <INTERRUPT-CATEGORY>CAT-1</INTERRUPT-CATEGORY>
                [!ENDIF!][!//
                  <INTERRUPT-SOURCE>Hardware</INTERRUPT-SOURCE>
                </BSW-INTERRUPT-ENTITY>
              [!ENDIF!][!//
              [!IF "num:i($CddChannel) = '12'"!][!//
                <BSW-INTERRUPT-ENTITY UUID="f8753957-f299-45fe-b23a-ac57ae950f43">
                  <SHORT-NAME>Cdd_Pwm_G1_TzCh12Isr</SHORT-NAME>
                  <MINIMUM-START-INTERVAL>0.0</MINIMUM-START-INTERVAL>
                  <REENTRANCY-LEVEL>NON-REENTRANT</REENTRANCY-LEVEL>
                  <IMPLEMENTED-ENTRY-REF DEST="BSW-MODULE-ENTRY">/Cdd_Pwm_TI_AM263x/Cdd_Pwm_ModuleEntry/Cdd_Pwm_G1_TzCh12Isr</IMPLEMENTED-ENTRY-REF>
                [!IF "as:modconf('Cdd_Pwm')[1]/CddPwmGeneral/CddPwmTypeofInterruptFunction = 'CDD_PWM_ISR_CAT2'"!][!//
                  <INTERRUPT-CATEGORY>CAT-2</INTERRUPT-CATEGORY>
                [!ELSE!][!//
                  <INTERRUPT-CATEGORY>CAT-1</INTERRUPT-CATEGORY>
                [!ENDIF!][!//
                  <INTERRUPT-SOURCE>Hardware</INTERRUPT-SOURCE>
                </BSW-INTERRUPT-ENTITY>
              [!ENDIF!][!//
              [!IF "num:i($CddChannel) = '13'"!][!//
                <BSW-INTERRUPT-ENTITY UUID="2b92fef5-8bce-426e-b380-84196bff2763">
                  <SHORT-NAME>Cdd_Pwm_G1_TzCh13Isr</SHORT-NAME>
                  <MINIMUM-START-INTERVAL>0.0</MINIMUM-START-INTERVAL>
                  <REENTRANCY-LEVEL>NON-REENTRANT</REENTRANCY-LEVEL>
                  <IMPLEMENTED-ENTRY-REF DEST="BSW-MODULE-ENTRY">/Cdd_Pwm_TI_AM263x/Cdd_Pwm_ModuleEntry/Cdd_Pwm_G1_TzCh13Isr</IMPLEMENTED-ENTRY-REF>
                [!IF "as:modconf('Cdd_Pwm')[1]/CddPwmGeneral/CddPwmTypeofInterruptFunction = 'CDD_PWM_ISR_CAT2'"!][!//
                  <INTERRUPT-CATEGORY>CAT-2</INTERRUPT-CATEGORY>
                [!ELSE!][!//
                  <INTERRUPT-CATEGORY>CAT-1</INTERRUPT-CATEGORY>
                [!ENDIF!][!//
                  <INTERRUPT-SOURCE>Hardware</INTERRUPT-SOURCE>
                </BSW-INTERRUPT-ENTITY>
              [!ENDIF!][!//
              [!IF "num:i($CddChannel) = '14'"!][!//
                <BSW-INTERRUPT-ENTITY UUID="c3004c49-2323-498e-929f-32ea36315db7">
                  <SHORT-NAME>Cdd_Pwm_G1_TzCh14Isr</SHORT-NAME>
                  <MINIMUM-START-INTERVAL>0.0</MINIMUM-START-INTERVAL>
                  <REENTRANCY-LEVEL>NON-REENTRANT</REENTRANCY-LEVEL>
                  <IMPLEMENTED-ENTRY-REF DEST="BSW-MODULE-ENTRY">/Cdd_Pwm_TI_AM263x/Cdd_Pwm_ModuleEntry/Cdd_Pwm_G1_TzCh14Isr</IMPLEMENTED-ENTRY-REF>
                [!IF "as:modconf('Cdd_Pwm')[1]/CddPwmGeneral/CddPwmTypeofInterruptFunction = 'CDD_PWM_ISR_CAT2'"!][!//
                  <INTERRUPT-CATEGORY>CAT-2</INTERRUPT-CATEGORY>
                [!ELSE!][!//
                  <INTERRUPT-CATEGORY>CAT-1</INTERRUPT-CATEGORY>
                [!ENDIF!][!//
                  <INTERRUPT-SOURCE>Hardware</INTERRUPT-SOURCE>
                </BSW-INTERRUPT-ENTITY>
              [!ENDIF!][!//
              [!IF "num:i($CddChannel) = '15'"!][!//
                <BSW-INTERRUPT-ENTITY UUID="0659ce37-4b27-4ad3-8d6d-92f3f040c339">
                  <SHORT-NAME>Cdd_Pwm_G1_TzCh15Isr</SHORT-NAME>
                  <MINIMUM-START-INTERVAL>0.0</MINIMUM-START-INTERVAL>
                  <REENTRANCY-LEVEL>NON-REENTRANT</REENTRANCY-LEVEL>
                  <IMPLEMENTED-ENTRY-REF DEST="BSW-MODULE-ENTRY">/Cdd_Pwm_TI_AM263x/Cdd_Pwm_ModuleEntry/Cdd_Pwm_G1_TzCh15Isr</IMPLEMENTED-ENTRY-REF>
                [!IF "as:modconf('Cdd_Pwm')[1]/CddPwmGeneral/CddPwmTypeofInterruptFunction = 'CDD_PWM_ISR_CAT2'"!][!//
                  <INTERRUPT-CATEGORY>CAT-2</INTERRUPT-CATEGORY>
                [!ELSE!][!//
                  <INTERRUPT-CATEGORY>CAT-1</INTERRUPT-CATEGORY>
                [!ENDIF!][!//
                  <INTERRUPT-SOURCE>Hardware</INTERRUPT-SOURCE>
                </BSW-INTERRUPT-ENTITY>
              [!ENDIF!][!//
              [!IF "num:i($CddChannel) = '16'"!][!//
                <BSW-INTERRUPT-ENTITY UUID="6c96438a-d028-42a9-8f45-ccb327774771">
                  <SHORT-NAME>Cdd_Pwm_G1_TzCh16Isr</SHORT-NAME>
                  <MINIMUM-START-INTERVAL>0.0</MINIMUM-START-INTERVAL>
                  <REENTRANCY-LEVEL>NON-REENTRANT</REENTRANCY-LEVEL>
                  <IMPLEMENTED-ENTRY-REF DEST="BSW-MODULE-ENTRY">/Cdd_Pwm_TI_AM263x/Cdd_Pwm_ModuleEntry/Cdd_Pwm_G1_TzCh16Isr</IMPLEMENTED-ENTRY-REF>
                [!IF "as:modconf('Cdd_Pwm')[1]/CddPwmGeneral/CddPwmTypeofInterruptFunction = 'CDD_PWM_ISR_CAT2'"!][!//
                  <INTERRUPT-CATEGORY>CAT-2</INTERRUPT-CATEGORY>
                [!ELSE!][!//
                  <INTERRUPT-CATEGORY>CAT-1</INTERRUPT-CATEGORY>
                [!ENDIF!][!//
                  <INTERRUPT-SOURCE>Hardware</INTERRUPT-SOURCE>
                </BSW-INTERRUPT-ENTITY>
              [!ENDIF!][!//
              [!IF "num:i($CddChannel) = '17'"!][!//
                <BSW-INTERRUPT-ENTITY UUID="e239e5f7-8c4e-46f0-8b4e-186e558b465b">
                  <SHORT-NAME>Cdd_Pwm_G1_TzCh17Isr</SHORT-NAME>
                  <MINIMUM-START-INTERVAL>0.0</MINIMUM-START-INTERVAL>
                  <REENTRANCY-LEVEL>NON-REENTRANT</REENTRANCY-LEVEL>
                  <IMPLEMENTED-ENTRY-REF DEST="BSW-MODULE-ENTRY">/Cdd_Pwm_TI_AM263x/Cdd_Pwm_ModuleEntry/Cdd_Pwm_G1_TzCh17Isr</IMPLEMENTED-ENTRY-REF>
                [!IF "as:modconf('Cdd_Pwm')[1]/CddPwmGeneral/CddPwmTypeofInterruptFunction = 'CDD_PWM_ISR_CAT2'"!][!//
                  <INTERRUPT-CATEGORY>CAT-2</INTERRUPT-CATEGORY>
                [!ELSE!][!//
                  <INTERRUPT-CATEGORY>CAT-1</INTERRUPT-CATEGORY>
                [!ENDIF!][!//
                  <INTERRUPT-SOURCE>Hardware</INTERRUPT-SOURCE>
                </BSW-INTERRUPT-ENTITY>
              [!ENDIF!][!//
              [!IF "num:i($CddChannel) = '18'"!][!//
                <BSW-INTERRUPT-ENTITY UUID="e08720d7-d5a8-4381-9aac-0ff855504bcd">
                  <SHORT-NAME>Cdd_Pwm_G1_TzCh18Isr</SHORT-NAME>
                  <MINIMUM-START-INTERVAL>0.0</MINIMUM-START-INTERVAL>
                  <REENTRANCY-LEVEL>NON-REENTRANT</REENTRANCY-LEVEL>
                  <IMPLEMENTED-ENTRY-REF DEST="BSW-MODULE-ENTRY">/Cdd_Pwm_TI_AM263x/Cdd_Pwm_ModuleEntry/Cdd_Pwm_G1_TzCh18Isr</IMPLEMENTED-ENTRY-REF>
                [!IF "as:modconf('Cdd_Pwm')[1]/CddPwmGeneral/CddPwmTypeofInterruptFunction = 'CDD_PWM_ISR_CAT2'"!][!//
                  <INTERRUPT-CATEGORY>CAT-2</INTERRUPT-CATEGORY>
                [!ELSE!][!//
                  <INTERRUPT-CATEGORY>CAT-1</INTERRUPT-CATEGORY>
                [!ENDIF!][!//
                  <INTERRUPT-SOURCE>Hardware</INTERRUPT-SOURCE>
                </BSW-INTERRUPT-ENTITY>
              [!ENDIF!][!//
              [!IF "num:i($CddChannel) = '19'"!][!//
                <BSW-INTERRUPT-ENTITY UUID="a8c835b1-5dbe-4c0f-92d9-aaa65640ed1a">
                  <SHORT-NAME>Cdd_Pwm_G1_TzCh19Isr</SHORT-NAME>
                  <MINIMUM-START-INTERVAL>0.0</MINIMUM-START-INTERVAL>
                  <REENTRANCY-LEVEL>NON-REENTRANT</REENTRANCY-LEVEL>
                  <IMPLEMENTED-ENTRY-REF DEST="BSW-MODULE-ENTRY">/Cdd_Pwm_TI_AM263x/Cdd_Pwm_ModuleEntry/Cdd_Pwm_G1_TzCh19Isr</IMPLEMENTED-ENTRY-REF>
                [!IF "as:modconf('Cdd_Pwm')[1]/CddPwmGeneral/CddPwmTypeofInterruptFunction = 'CDD_PWM_ISR_CAT2'"!][!//
                  <INTERRUPT-CATEGORY>CAT-2</INTERRUPT-CATEGORY>
                [!ELSE!][!//
                  <INTERRUPT-CATEGORY>CAT-1</INTERRUPT-CATEGORY>
                [!ENDIF!][!//
                  <INTERRUPT-SOURCE>Hardware</INTERRUPT-SOURCE>
                </BSW-INTERRUPT-ENTITY>
              [!ENDIF!][!//
              [!IF "num:i($CddChannel) = '1'"!][!//
                <BSW-INTERRUPT-ENTITY UUID="4920369e-8c19-4aec-9405-6fbe4d930d48">
                  <SHORT-NAME>Cdd_Pwm_G1_TzCh1Isr</SHORT-NAME>
                  <MINIMUM-START-INTERVAL>0.0</MINIMUM-START-INTERVAL>
                  <REENTRANCY-LEVEL>NON-REENTRANT</REENTRANCY-LEVEL>
                  <IMPLEMENTED-ENTRY-REF DEST="BSW-MODULE-ENTRY">/Cdd_Pwm_TI_AM263x/Cdd_Pwm_ModuleEntry/Cdd_Pwm_G1_TzCh1Isr</IMPLEMENTED-ENTRY-REF>
                [!IF "as:modconf('Cdd_Pwm')[1]/CddPwmGeneral/CddPwmTypeofInterruptFunction = 'CDD_PWM_ISR_CAT2'"!][!//
                  <INTERRUPT-CATEGORY>CAT-2</INTERRUPT-CATEGORY>
                [!ELSE!][!//
                  <INTERRUPT-CATEGORY>CAT-1</INTERRUPT-CATEGORY>
                [!ENDIF!][!//
                  <INTERRUPT-SOURCE>Hardware</INTERRUPT-SOURCE>
                </BSW-INTERRUPT-ENTITY>
              [!ENDIF!][!//
              [!IF "num:i($CddChannel) = '20'"!][!//
                <BSW-INTERRUPT-ENTITY UUID="73dd5502-82a1-4473-88c6-21b60dd97eff">
                  <SHORT-NAME>Cdd_Pwm_G1_TzCh20Isr</SHORT-NAME>
                  <MINIMUM-START-INTERVAL>0.0</MINIMUM-START-INTERVAL>
                  <REENTRANCY-LEVEL>NON-REENTRANT</REENTRANCY-LEVEL>
                  <IMPLEMENTED-ENTRY-REF DEST="BSW-MODULE-ENTRY">/Cdd_Pwm_TI_AM263x/Cdd_Pwm_ModuleEntry/Cdd_Pwm_G1_TzCh20Isr</IMPLEMENTED-ENTRY-REF>
                [!IF "as:modconf('Cdd_Pwm')[1]/CddPwmGeneral/CddPwmTypeofInterruptFunction = 'CDD_PWM_ISR_CAT2'"!][!//
                  <INTERRUPT-CATEGORY>CAT-2</INTERRUPT-CATEGORY>
                [!ELSE!][!//
                  <INTERRUPT-CATEGORY>CAT-1</INTERRUPT-CATEGORY>
                [!ENDIF!][!//
                  <INTERRUPT-SOURCE>Hardware</INTERRUPT-SOURCE>
                </BSW-INTERRUPT-ENTITY>
              [!ENDIF!][!//
              [!IF "num:i($CddChannel) = '21'"!][!//
                <BSW-INTERRUPT-ENTITY UUID="685a3a20-e9a0-4173-9029-886f37f51e5d">
                  <SHORT-NAME>Cdd_Pwm_G1_TzCh21Isr</SHORT-NAME>
                  <MINIMUM-START-INTERVAL>0.0</MINIMUM-START-INTERVAL>
                  <REENTRANCY-LEVEL>NON-REENTRANT</REENTRANCY-LEVEL>
                  <IMPLEMENTED-ENTRY-REF DEST="BSW-MODULE-ENTRY">/Cdd_Pwm_TI_AM263x/Cdd_Pwm_ModuleEntry/Cdd_Pwm_G1_TzCh21Isr</IMPLEMENTED-ENTRY-REF>
                [!IF "as:modconf('Cdd_Pwm')[1]/CddPwmGeneral/CddPwmTypeofInterruptFunction = 'CDD_PWM_ISR_CAT2'"!][!//
                  <INTERRUPT-CATEGORY>CAT-2</INTERRUPT-CATEGORY>
                [!ELSE!][!//
                  <INTERRUPT-CATEGORY>CAT-1</INTERRUPT-CATEGORY>
                [!ENDIF!][!//
                  <INTERRUPT-SOURCE>Hardware</INTERRUPT-SOURCE>
                </BSW-INTERRUPT-ENTITY>
              [!ENDIF!][!//
              [!IF "num:i($CddChannel) = '22'"!][!//
                <BSW-INTERRUPT-ENTITY UUID="e9be4805-4cc4-4b9b-b36b-32aba2923dbe">
                  <SHORT-NAME>Cdd_Pwm_G1_TzCh22Isr</SHORT-NAME>
                  <MINIMUM-START-INTERVAL>0.0</MINIMUM-START-INTERVAL>
                  <REENTRANCY-LEVEL>NON-REENTRANT</REENTRANCY-LEVEL>
                  <IMPLEMENTED-ENTRY-REF DEST="BSW-MODULE-ENTRY">/Cdd_Pwm_TI_AM263x/Cdd_Pwm_ModuleEntry/Cdd_Pwm_G1_TzCh22Isr</IMPLEMENTED-ENTRY-REF>
                [!IF "as:modconf('Cdd_Pwm')[1]/CddPwmGeneral/CddPwmTypeofInterruptFunction = 'CDD_PWM_ISR_CAT2'"!][!//
                  <INTERRUPT-CATEGORY>CAT-2</INTERRUPT-CATEGORY>
                [!ELSE!][!//
                  <INTERRUPT-CATEGORY>CAT-1</INTERRUPT-CATEGORY>
                [!ENDIF!][!//
                  <INTERRUPT-SOURCE>Hardware</INTERRUPT-SOURCE>
                </BSW-INTERRUPT-ENTITY>
              [!ENDIF!][!//
              [!IF "num:i($CddChannel) = '23'"!][!//
                <BSW-INTERRUPT-ENTITY UUID="c7b6a855-78ef-4108-99f9-68cad7340de3">
                  <SHORT-NAME>Cdd_Pwm_G1_TzCh23Isr</SHORT-NAME>
                  <MINIMUM-START-INTERVAL>0.0</MINIMUM-START-INTERVAL>
                  <REENTRANCY-LEVEL>NON-REENTRANT</REENTRANCY-LEVEL>
                  <IMPLEMENTED-ENTRY-REF DEST="BSW-MODULE-ENTRY">/Cdd_Pwm_TI_AM263x/Cdd_Pwm_ModuleEntry/Cdd_Pwm_G1_TzCh23Isr</IMPLEMENTED-ENTRY-REF>
                [!IF "as:modconf('Cdd_Pwm')[1]/CddPwmGeneral/CddPwmTypeofInterruptFunction = 'CDD_PWM_ISR_CAT2'"!][!//
                  <INTERRUPT-CATEGORY>CAT-2</INTERRUPT-CATEGORY>
                [!ELSE!][!//
                  <INTERRUPT-CATEGORY>CAT-1</INTERRUPT-CATEGORY>
                [!ENDIF!][!//
                  <INTERRUPT-SOURCE>Hardware</INTERRUPT-SOURCE>
                </BSW-INTERRUPT-ENTITY>
              [!ENDIF!][!//
              [!IF "num:i($CddChannel) = '24'"!][!//
                <BSW-INTERRUPT-ENTITY UUID="44db183e-c4b1-4cd7-95be-dccea5442050">
                  <SHORT-NAME>Cdd_Pwm_G1_TzCh24Isr</SHORT-NAME>
                  <MINIMUM-START-INTERVAL>0.0</MINIMUM-START-INTERVAL>
                  <REENTRANCY-LEVEL>NON-REENTRANT</REENTRANCY-LEVEL>
                  <IMPLEMENTED-ENTRY-REF DEST="BSW-MODULE-ENTRY">/Cdd_Pwm_TI_AM263x/Cdd_Pwm_ModuleEntry/Cdd_Pwm_G1_TzCh24Isr</IMPLEMENTED-ENTRY-REF>
                [!IF "as:modconf('Cdd_Pwm')[1]/CddPwmGeneral/CddPwmTypeofInterruptFunction = 'CDD_PWM_ISR_CAT2'"!][!//
                  <INTERRUPT-CATEGORY>CAT-2</INTERRUPT-CATEGORY>
                [!ELSE!][!//
                  <INTERRUPT-CATEGORY>CAT-1</INTERRUPT-CATEGORY>
                [!ENDIF!][!//
                  <INTERRUPT-SOURCE>Hardware</INTERRUPT-SOURCE>
                </BSW-INTERRUPT-ENTITY>
              [!ENDIF!][!//
              [!IF "num:i($CddChannel) = '25'"!][!//
                <BSW-INTERRUPT-ENTITY UUID="ad5fb2a0-3312-4495-aec2-b726bab9ed93">
                  <SHORT-NAME>Cdd_Pwm_G1_TzCh25Isr</SHORT-NAME>
                  <MINIMUM-START-INTERVAL>0.0</MINIMUM-START-INTERVAL>
                  <REENTRANCY-LEVEL>NON-REENTRANT</REENTRANCY-LEVEL>
                  <IMPLEMENTED-ENTRY-REF DEST="BSW-MODULE-ENTRY">/Cdd_Pwm_TI_AM263x/Cdd_Pwm_ModuleEntry/Cdd_Pwm_G1_TzCh25Isr</IMPLEMENTED-ENTRY-REF>
                [!IF "as:modconf('Cdd_Pwm')[1]/CddPwmGeneral/CddPwmTypeofInterruptFunction = 'CDD_PWM_ISR_CAT2'"!][!//
                  <INTERRUPT-CATEGORY>CAT-2</INTERRUPT-CATEGORY>
                [!ELSE!][!//
                  <INTERRUPT-CATEGORY>CAT-1</INTERRUPT-CATEGORY>
                [!ENDIF!][!//
                  <INTERRUPT-SOURCE>Hardware</INTERRUPT-SOURCE>
                </BSW-INTERRUPT-ENTITY>
              [!ENDIF!][!//
              [!IF "num:i($CddChannel) = '26'"!][!//
                <BSW-INTERRUPT-ENTITY UUID="66a3b743-669a-4e21-97d4-541c40a8a263">
                  <SHORT-NAME>Cdd_Pwm_G1_TzCh26Isr</SHORT-NAME>
                  <MINIMUM-START-INTERVAL>0.0</MINIMUM-START-INTERVAL>
                  <REENTRANCY-LEVEL>NON-REENTRANT</REENTRANCY-LEVEL>
                  <IMPLEMENTED-ENTRY-REF DEST="BSW-MODULE-ENTRY">/Cdd_Pwm_TI_AM263x/Cdd_Pwm_ModuleEntry/Cdd_Pwm_G1_TzCh26Isr</IMPLEMENTED-ENTRY-REF>
                [!IF "as:modconf('Cdd_Pwm')[1]/CddPwmGeneral/CddPwmTypeofInterruptFunction = 'CDD_PWM_ISR_CAT2'"!][!//
                  <INTERRUPT-CATEGORY>CAT-2</INTERRUPT-CATEGORY>
                [!ELSE!][!//
                  <INTERRUPT-CATEGORY>CAT-1</INTERRUPT-CATEGORY>
                [!ENDIF!][!//
                  <INTERRUPT-SOURCE>Hardware</INTERRUPT-SOURCE>
                </BSW-INTERRUPT-ENTITY>
              [!ENDIF!][!//
              [!IF "num:i($CddChannel) = '27'"!][!//
                <BSW-INTERRUPT-ENTITY UUID="3512e1a0-1023-44f6-9e1e-d50f2102c853">
                  <SHORT-NAME>Cdd_Pwm_G1_TzCh27Isr</SHORT-NAME>
                  <MINIMUM-START-INTERVAL>0.0</MINIMUM-START-INTERVAL>
                  <REENTRANCY-LEVEL>NON-REENTRANT</REENTRANCY-LEVEL>
                  <IMPLEMENTED-ENTRY-REF DEST="BSW-MODULE-ENTRY">/Cdd_Pwm_TI_AM263x/Cdd_Pwm_ModuleEntry/Cdd_Pwm_G1_TzCh27Isr</IMPLEMENTED-ENTRY-REF>
                [!IF "as:modconf('Cdd_Pwm')[1]/CddPwmGeneral/CddPwmTypeofInterruptFunction = 'CDD_PWM_ISR_CAT2'"!][!//
                  <INTERRUPT-CATEGORY>CAT-2</INTERRUPT-CATEGORY>
                [!ELSE!][!//
                  <INTERRUPT-CATEGORY>CAT-1</INTERRUPT-CATEGORY>
                [!ENDIF!][!//
                  <INTERRUPT-SOURCE>Hardware</INTERRUPT-SOURCE>
                </BSW-INTERRUPT-ENTITY>
              [!ENDIF!][!//
              [!IF "num:i($CddChannel) = '28'"!][!//
                <BSW-INTERRUPT-ENTITY UUID="4a5dd17c-4046-4017-a843-41bdb58dbf58">
                  <SHORT-NAME>Cdd_Pwm_G1_TzCh28Isr</SHORT-NAME>
                  <MINIMUM-START-INTERVAL>0.0</MINIMUM-START-INTERVAL>
                  <REENTRANCY-LEVEL>NON-REENTRANT</REENTRANCY-LEVEL>
                  <IMPLEMENTED-ENTRY-REF DEST="BSW-MODULE-ENTRY">/Cdd_Pwm_TI_AM263x/Cdd_Pwm_ModuleEntry/Cdd_Pwm_G1_TzCh28Isr</IMPLEMENTED-ENTRY-REF>
                [!IF "as:modconf('Cdd_Pwm')[1]/CddPwmGeneral/CddPwmTypeofInterruptFunction = 'CDD_PWM_ISR_CAT2'"!][!//
                  <INTERRUPT-CATEGORY>CAT-2</INTERRUPT-CATEGORY>
                [!ELSE!][!//
                  <INTERRUPT-CATEGORY>CAT-1</INTERRUPT-CATEGORY>
                [!ENDIF!][!//
                  <INTERRUPT-SOURCE>Hardware</INTERRUPT-SOURCE>
                </BSW-INTERRUPT-ENTITY>
              [!ENDIF!][!//
              [!IF "num:i($CddChannel) = '29'"!][!//
                <BSW-INTERRUPT-ENTITY UUID="03b922dd-43cf-4ff5-8bee-4f000e30f6fe">
                  <SHORT-NAME>Cdd_Pwm_G1_TzCh29Isr</SHORT-NAME>
                  <MINIMUM-START-INTERVAL>0.0</MINIMUM-START-INTERVAL>
                  <REENTRANCY-LEVEL>NON-REENTRANT</REENTRANCY-LEVEL>
                  <IMPLEMENTED-ENTRY-REF DEST="BSW-MODULE-ENTRY">/Cdd_Pwm_TI_AM263x/Cdd_Pwm_ModuleEntry/Cdd_Pwm_G1_TzCh29Isr</IMPLEMENTED-ENTRY-REF>
                [!IF "as:modconf('Cdd_Pwm')[1]/CddPwmGeneral/CddPwmTypeofInterruptFunction = 'CDD_PWM_ISR_CAT2'"!][!//
                  <INTERRUPT-CATEGORY>CAT-2</INTERRUPT-CATEGORY>
                [!ELSE!][!//
                  <INTERRUPT-CATEGORY>CAT-1</INTERRUPT-CATEGORY>
                [!ENDIF!][!//
                  <INTERRUPT-SOURCE>Hardware</INTERRUPT-SOURCE>
                </BSW-INTERRUPT-ENTITY>
              [!ENDIF!][!//
              [!IF "num:i($CddChannel) = '2'"!][!//
                <BSW-INTERRUPT-ENTITY UUID="4fe92b6f-9d32-4946-b37b-6ca928ca06fa">
                  <SHORT-NAME>Cdd_Pwm_G1_TzCh2Isr</SHORT-NAME>
                  <MINIMUM-START-INTERVAL>0.0</MINIMUM-START-INTERVAL>
                  <REENTRANCY-LEVEL>NON-REENTRANT</REENTRANCY-LEVEL>
                  <IMPLEMENTED-ENTRY-REF DEST="BSW-MODULE-ENTRY">/Cdd_Pwm_TI_AM263x/Cdd_Pwm_ModuleEntry/Cdd_Pwm_G1_TzCh2Isr</IMPLEMENTED-ENTRY-REF>
                [!IF "as:modconf('Cdd_Pwm')[1]/CddPwmGeneral/CddPwmTypeofInterruptFunction = 'CDD_PWM_ISR_CAT2'"!][!//
                  <INTERRUPT-CATEGORY>CAT-2</INTERRUPT-CATEGORY>
                [!ELSE!][!//
                  <INTERRUPT-CATEGORY>CAT-1</INTERRUPT-CATEGORY>
                [!ENDIF!][!//
                  <INTERRUPT-SOURCE>Hardware</INTERRUPT-SOURCE>
                </BSW-INTERRUPT-ENTITY>
              [!ENDIF!][!//
              [!IF "num:i($CddChannel) = '30'"!][!//
                <BSW-INTERRUPT-ENTITY UUID="8bba5392-f53c-4b30-be94-a43692cb3686">
                  <SHORT-NAME>Cdd_Pwm_G1_TzCh30Isr</SHORT-NAME>
                  <MINIMUM-START-INTERVAL>0.0</MINIMUM-START-INTERVAL>
                  <REENTRANCY-LEVEL>NON-REENTRANT</REENTRANCY-LEVEL>
                  <IMPLEMENTED-ENTRY-REF DEST="BSW-MODULE-ENTRY">/Cdd_Pwm_TI_AM263x/Cdd_Pwm_ModuleEntry/Cdd_Pwm_G1_TzCh30Isr</IMPLEMENTED-ENTRY-REF>
                [!IF "as:modconf('Cdd_Pwm')[1]/CddPwmGeneral/CddPwmTypeofInterruptFunction = 'CDD_PWM_ISR_CAT2'"!][!//
                  <INTERRUPT-CATEGORY>CAT-2</INTERRUPT-CATEGORY>
                [!ELSE!][!//
                  <INTERRUPT-CATEGORY>CAT-1</INTERRUPT-CATEGORY>
                [!ENDIF!][!//
                  <INTERRUPT-SOURCE>Hardware</INTERRUPT-SOURCE>
                </BSW-INTERRUPT-ENTITY>
              [!ENDIF!][!//
              [!IF "num:i($CddChannel) = '31'"!][!//
                <BSW-INTERRUPT-ENTITY UUID="e6504326-e05f-4cf6-89c4-69182a98a1c4">
                  <SHORT-NAME>Cdd_Pwm_G1_TzCh31Isr</SHORT-NAME>
                  <MINIMUM-START-INTERVAL>0.0</MINIMUM-START-INTERVAL>
                  <REENTRANCY-LEVEL>NON-REENTRANT</REENTRANCY-LEVEL>
                  <IMPLEMENTED-ENTRY-REF DEST="BSW-MODULE-ENTRY">/Cdd_Pwm_TI_AM263x/Cdd_Pwm_ModuleEntry/Cdd_Pwm_G1_TzCh31Isr</IMPLEMENTED-ENTRY-REF>
                [!IF "as:modconf('Cdd_Pwm')[1]/CddPwmGeneral/CddPwmTypeofInterruptFunction = 'CDD_PWM_ISR_CAT2'"!][!//
                  <INTERRUPT-CATEGORY>CAT-2</INTERRUPT-CATEGORY>
                [!ELSE!][!//
                  <INTERRUPT-CATEGORY>CAT-1</INTERRUPT-CATEGORY>
                [!ENDIF!][!//
                  <INTERRUPT-SOURCE>Hardware</INTERRUPT-SOURCE>
                </BSW-INTERRUPT-ENTITY>
              [!ENDIF!][!//
              [!IF "num:i($CddChannel) = '3'"!][!//
                <BSW-INTERRUPT-ENTITY UUID="504654ca-f8b6-42e0-aefb-9017289e6509">
                  <SHORT-NAME>Cdd_Pwm_G1_TzCh3Isr</SHORT-NAME>
                  <MINIMUM-START-INTERVAL>0.0</MINIMUM-START-INTERVAL>
                  <REENTRANCY-LEVEL>NON-REENTRANT</REENTRANCY-LEVEL>
                  <IMPLEMENTED-ENTRY-REF DEST="BSW-MODULE-ENTRY">/Cdd_Pwm_TI_AM263x/Cdd_Pwm_ModuleEntry/Cdd_Pwm_G1_TzCh3Isr</IMPLEMENTED-ENTRY-REF>
                [!IF "as:modconf('Cdd_Pwm')[1]/CddPwmGeneral/CddPwmTypeofInterruptFunction = 'CDD_PWM_ISR_CAT2'"!][!//
                  <INTERRUPT-CATEGORY>CAT-2</INTERRUPT-CATEGORY>
                [!ELSE!][!//
                  <INTERRUPT-CATEGORY>CAT-1</INTERRUPT-CATEGORY>
                [!ENDIF!][!//
                  <INTERRUPT-SOURCE>Hardware</INTERRUPT-SOURCE>
                </BSW-INTERRUPT-ENTITY>
              [!ENDIF!][!//
              [!IF "num:i($CddChannel) = '4'"!][!//
                <BSW-INTERRUPT-ENTITY UUID="0e2f99dc-3687-42f4-bf19-b303fdc68b40">
                  <SHORT-NAME>Cdd_Pwm_G1_TzCh4Isr</SHORT-NAME>
                  <MINIMUM-START-INTERVAL>0.0</MINIMUM-START-INTERVAL>
                  <REENTRANCY-LEVEL>NON-REENTRANT</REENTRANCY-LEVEL>
                  <IMPLEMENTED-ENTRY-REF DEST="BSW-MODULE-ENTRY">/Cdd_Pwm_TI_AM263x/Cdd_Pwm_ModuleEntry/Cdd_Pwm_G1_TzCh4Isr</IMPLEMENTED-ENTRY-REF>
                [!IF "as:modconf('Cdd_Pwm')[1]/CddPwmGeneral/CddPwmTypeofInterruptFunction = 'CDD_PWM_ISR_CAT2'"!][!//
                  <INTERRUPT-CATEGORY>CAT-2</INTERRUPT-CATEGORY>
                [!ELSE!][!//
                  <INTERRUPT-CATEGORY>CAT-1</INTERRUPT-CATEGORY>
                [!ENDIF!][!//
                  <INTERRUPT-SOURCE>Hardware</INTERRUPT-SOURCE>
                </BSW-INTERRUPT-ENTITY>
              [!ENDIF!][!//
              [!IF "num:i($CddChannel) = '5'"!][!//
                <BSW-INTERRUPT-ENTITY UUID="e65ec496-d912-4150-b56e-9cff78637515">
                  <SHORT-NAME>Cdd_Pwm_G1_TzCh5Isr</SHORT-NAME>
                  <MINIMUM-START-INTERVAL>0.0</MINIMUM-START-INTERVAL>
                  <REENTRANCY-LEVEL>NON-REENTRANT</REENTRANCY-LEVEL>
                  <IMPLEMENTED-ENTRY-REF DEST="BSW-MODULE-ENTRY">/Cdd_Pwm_TI_AM263x/Cdd_Pwm_ModuleEntry/Cdd_Pwm_G1_TzCh5Isr</IMPLEMENTED-ENTRY-REF>
                [!IF "as:modconf('Cdd_Pwm')[1]/CddPwmGeneral/CddPwmTypeofInterruptFunction = 'CDD_PWM_ISR_CAT2'"!][!//
                  <INTERRUPT-CATEGORY>CAT-2</INTERRUPT-CATEGORY>
                [!ELSE!][!//
                  <INTERRUPT-CATEGORY>CAT-1</INTERRUPT-CATEGORY>
                [!ENDIF!][!//
                  <INTERRUPT-SOURCE>Hardware</INTERRUPT-SOURCE>
                </BSW-INTERRUPT-ENTITY>
              [!ENDIF!][!//
              [!IF "num:i($CddChannel) = '6'"!][!//
                <BSW-INTERRUPT-ENTITY UUID="ed3d59d1-0741-4621-84b9-47ee286efa8d">
                  <SHORT-NAME>Cdd_Pwm_G1_TzCh6Isr</SHORT-NAME>
                  <MINIMUM-START-INTERVAL>0.0</MINIMUM-START-INTERVAL>
                  <REENTRANCY-LEVEL>NON-REENTRANT</REENTRANCY-LEVEL>
                  <IMPLEMENTED-ENTRY-REF DEST="BSW-MODULE-ENTRY">/Cdd_Pwm_TI_AM263x/Cdd_Pwm_ModuleEntry/Cdd_Pwm_G1_TzCh6Isr</IMPLEMENTED-ENTRY-REF>
                [!IF "as:modconf('Cdd_Pwm')[1]/CddPwmGeneral/CddPwmTypeofInterruptFunction = 'CDD_PWM_ISR_CAT2'"!][!//
                  <INTERRUPT-CATEGORY>CAT-2</INTERRUPT-CATEGORY>
                [!ELSE!][!//
                  <INTERRUPT-CATEGORY>CAT-1</INTERRUPT-CATEGORY>
                [!ENDIF!][!//
                  <INTERRUPT-SOURCE>Hardware</INTERRUPT-SOURCE>
                </BSW-INTERRUPT-ENTITY>
              [!ENDIF!][!//
              [!IF "num:i($CddChannel) = '7'"!][!//
                <BSW-INTERRUPT-ENTITY UUID="e440004f-8c25-44da-ba98-2c4bb42f1ae6">
                  <SHORT-NAME>Cdd_Pwm_G1_TzCh7Isr</SHORT-NAME>
                  <MINIMUM-START-INTERVAL>0.0</MINIMUM-START-INTERVAL>
                  <REENTRANCY-LEVEL>NON-REENTRANT</REENTRANCY-LEVEL>
                  <IMPLEMENTED-ENTRY-REF DEST="BSW-MODULE-ENTRY">/Cdd_Pwm_TI_AM263x/Cdd_Pwm_ModuleEntry/Cdd_Pwm_G1_TzCh7Isr</IMPLEMENTED-ENTRY-REF>
                [!IF "as:modconf('Cdd_Pwm')[1]/CddPwmGeneral/CddPwmTypeofInterruptFunction = 'CDD_PWM_ISR_CAT2'"!][!//
                  <INTERRUPT-CATEGORY>CAT-2</INTERRUPT-CATEGORY>
                [!ELSE!][!//
                  <INTERRUPT-CATEGORY>CAT-1</INTERRUPT-CATEGORY>
                [!ENDIF!][!//
                  <INTERRUPT-SOURCE>Hardware</INTERRUPT-SOURCE>
                </BSW-INTERRUPT-ENTITY>
              [!ENDIF!][!//
              [!IF "num:i($CddChannel) = '8'"!][!//
                <BSW-INTERRUPT-ENTITY UUID="c9e0b2fb-d38e-4599-bca6-ed787bcd4eed">
                  <SHORT-NAME>Cdd_Pwm_G1_TzCh8Isr</SHORT-NAME>
                  <MINIMUM-START-INTERVAL>0.0</MINIMUM-START-INTERVAL>
                  <REENTRANCY-LEVEL>NON-REENTRANT</REENTRANCY-LEVEL>
                  <IMPLEMENTED-ENTRY-REF DEST="BSW-MODULE-ENTRY">/Cdd_Pwm_TI_AM263x/Cdd_Pwm_ModuleEntry/Cdd_Pwm_G1_TzCh8Isr</IMPLEMENTED-ENTRY-REF>
                [!IF "as:modconf('Cdd_Pwm')[1]/CddPwmGeneral/CddPwmTypeofInterruptFunction = 'CDD_PWM_ISR_CAT2'"!][!//
                  <INTERRUPT-CATEGORY>CAT-2</INTERRUPT-CATEGORY>
                [!ELSE!][!//
                  <INTERRUPT-CATEGORY>CAT-1</INTERRUPT-CATEGORY>
                [!ENDIF!][!//
                  <INTERRUPT-SOURCE>Hardware</INTERRUPT-SOURCE>
                </BSW-INTERRUPT-ENTITY>
              [!ENDIF!][!//
              [!IF "num:i($CddChannel) = '9'"!][!//
                <BSW-INTERRUPT-ENTITY UUID="554ed145-10ca-43cf-ad8c-4452e32e32a6">
                  <SHORT-NAME>Cdd_Pwm_G1_TzCh9Isr</SHORT-NAME>
                  <MINIMUM-START-INTERVAL>0.0</MINIMUM-START-INTERVAL>
                  <REENTRANCY-LEVEL>NON-REENTRANT</REENTRANCY-LEVEL>
                  <IMPLEMENTED-ENTRY-REF DEST="BSW-MODULE-ENTRY">/Cdd_Pwm_TI_AM263x/Cdd_Pwm_ModuleEntry/Cdd_Pwm_G1_TzCh9Isr</IMPLEMENTED-ENTRY-REF>
                [!IF "as:modconf('Cdd_Pwm')[1]/CddPwmGeneral/CddPwmTypeofInterruptFunction = 'CDD_PWM_ISR_CAT2'"!][!//
                  <INTERRUPT-CATEGORY>CAT-2</INTERRUPT-CATEGORY>
                [!ELSE!][!//
                  <INTERRUPT-CATEGORY>CAT-1</INTERRUPT-CATEGORY>
                [!ENDIF!][!//
                  <INTERRUPT-SOURCE>Hardware</INTERRUPT-SOURCE>
                </BSW-INTERRUPT-ENTITY>
              [!ENDIF!][!//
              [!ELSEIF "num:i($CddGroup) = '2'"!][!//
              [!IF "num:i($CddChannel) = '0'"!][!//
                <BSW-INTERRUPT-ENTITY UUID="bb5af6bf-f279-4857-97e2-1ebf81b90850">
                  <SHORT-NAME>Cdd_Pwm_G2_Ch0Isr</SHORT-NAME>
                  <MINIMUM-START-INTERVAL>0.0</MINIMUM-START-INTERVAL>
                  <REENTRANCY-LEVEL>NON-REENTRANT</REENTRANCY-LEVEL>
                  <IMPLEMENTED-ENTRY-REF DEST="BSW-MODULE-ENTRY">/Cdd_Pwm_TI_AM263x/Cdd_Pwm_ModuleEntry/Cdd_Pwm_G2_Ch0Isr</IMPLEMENTED-ENTRY-REF>
                [!IF "as:modconf('Cdd_Pwm')[1]/CddPwmGeneral/CddPwmTypeofInterruptFunction = 'CDD_PWM_ISR_CAT2'"!][!//
                  <INTERRUPT-CATEGORY>CAT-2</INTERRUPT-CATEGORY>
                [!ELSE!][!//
                  <INTERRUPT-CATEGORY>CAT-1</INTERRUPT-CATEGORY>
                [!ENDIF!][!//
                  <INTERRUPT-SOURCE>Hardware</INTERRUPT-SOURCE>
                </BSW-INTERRUPT-ENTITY>
              [!ENDIF!][!//
              [!IF "num:i($CddChannel) = '10'"!][!//
                <BSW-INTERRUPT-ENTITY UUID="ad34d164-3b70-4b01-be55-9a0d9d6865b9">
                  <SHORT-NAME>Cdd_Pwm_G2_Ch10Isr</SHORT-NAME>
                  <MINIMUM-START-INTERVAL>0.0</MINIMUM-START-INTERVAL>
                  <REENTRANCY-LEVEL>NON-REENTRANT</REENTRANCY-LEVEL>
                  <IMPLEMENTED-ENTRY-REF DEST="BSW-MODULE-ENTRY">/Cdd_Pwm_TI_AM263x/Cdd_Pwm_ModuleEntry/Cdd_Pwm_G2_Ch10Isr</IMPLEMENTED-ENTRY-REF>
                [!IF "as:modconf('Cdd_Pwm')[1]/CddPwmGeneral/CddPwmTypeofInterruptFunction = 'CDD_PWM_ISR_CAT2'"!][!//
                  <INTERRUPT-CATEGORY>CAT-2</INTERRUPT-CATEGORY>
                [!ELSE!][!//
                  <INTERRUPT-CATEGORY>CAT-1</INTERRUPT-CATEGORY>
                [!ENDIF!][!//
                  <INTERRUPT-SOURCE>Hardware</INTERRUPT-SOURCE>
                </BSW-INTERRUPT-ENTITY>
              [!ENDIF!][!//
              [!IF "num:i($CddChannel) = '11'"!][!//
                <BSW-INTERRUPT-ENTITY UUID="ebf5e58b-6923-45fd-be4d-11303c493f8e">
                  <SHORT-NAME>Cdd_Pwm_G2_Ch11Isr</SHORT-NAME>
                  <MINIMUM-START-INTERVAL>0.0</MINIMUM-START-INTERVAL>
                  <REENTRANCY-LEVEL>NON-REENTRANT</REENTRANCY-LEVEL>
                  <IMPLEMENTED-ENTRY-REF DEST="BSW-MODULE-ENTRY">/Cdd_Pwm_TI_AM263x/Cdd_Pwm_ModuleEntry/Cdd_Pwm_G2_Ch11Isr</IMPLEMENTED-ENTRY-REF>
                [!IF "as:modconf('Cdd_Pwm')[1]/CddPwmGeneral/CddPwmTypeofInterruptFunction = 'CDD_PWM_ISR_CAT2'"!][!//
                  <INTERRUPT-CATEGORY>CAT-2</INTERRUPT-CATEGORY>
                [!ELSE!][!//
                  <INTERRUPT-CATEGORY>CAT-1</INTERRUPT-CATEGORY>
                [!ENDIF!][!//
                  <INTERRUPT-SOURCE>Hardware</INTERRUPT-SOURCE>
                </BSW-INTERRUPT-ENTITY>
              [!ENDIF!][!//
              [!IF "num:i($CddChannel) = '12'"!][!//
                <BSW-INTERRUPT-ENTITY UUID="415abe2b-ee87-4b0f-8052-867616ae55dd">
                  <SHORT-NAME>Cdd_Pwm_G2_Ch12Isr</SHORT-NAME>
                  <MINIMUM-START-INTERVAL>0.0</MINIMUM-START-INTERVAL>
                  <REENTRANCY-LEVEL>NON-REENTRANT</REENTRANCY-LEVEL>
                  <IMPLEMENTED-ENTRY-REF DEST="BSW-MODULE-ENTRY">/Cdd_Pwm_TI_AM263x/Cdd_Pwm_ModuleEntry/Cdd_Pwm_G2_Ch12Isr</IMPLEMENTED-ENTRY-REF>
                [!IF "as:modconf('Cdd_Pwm')[1]/CddPwmGeneral/CddPwmTypeofInterruptFunction = 'CDD_PWM_ISR_CAT2'"!][!//
                  <INTERRUPT-CATEGORY>CAT-2</INTERRUPT-CATEGORY>
                [!ELSE!][!//
                  <INTERRUPT-CATEGORY>CAT-1</INTERRUPT-CATEGORY>
                [!ENDIF!][!//
                  <INTERRUPT-SOURCE>Hardware</INTERRUPT-SOURCE>
                </BSW-INTERRUPT-ENTITY>
              [!ENDIF!][!//
              [!IF "num:i($CddChannel) = '13'"!][!//
                <BSW-INTERRUPT-ENTITY UUID="01b008cf-850d-499b-8fe3-2e163eb7b1dd">
                  <SHORT-NAME>Cdd_Pwm_G2_Ch13Isr</SHORT-NAME>
                  <MINIMUM-START-INTERVAL>0.0</MINIMUM-START-INTERVAL>
                  <REENTRANCY-LEVEL>NON-REENTRANT</REENTRANCY-LEVEL>
                  <IMPLEMENTED-ENTRY-REF DEST="BSW-MODULE-ENTRY">/Cdd_Pwm_TI_AM263x/Cdd_Pwm_ModuleEntry/Cdd_Pwm_G2_Ch13Isr</IMPLEMENTED-ENTRY-REF>
                [!IF "as:modconf('Cdd_Pwm')[1]/CddPwmGeneral/CddPwmTypeofInterruptFunction = 'CDD_PWM_ISR_CAT2'"!][!//
                  <INTERRUPT-CATEGORY>CAT-2</INTERRUPT-CATEGORY>
                [!ELSE!][!//
                  <INTERRUPT-CATEGORY>CAT-1</INTERRUPT-CATEGORY>
                [!ENDIF!][!//
                  <INTERRUPT-SOURCE>Hardware</INTERRUPT-SOURCE>
                </BSW-INTERRUPT-ENTITY>
              [!ENDIF!][!//
              [!IF "num:i($CddChannel) = '14'"!][!//
                <BSW-INTERRUPT-ENTITY UUID="a019c7a6-da8a-4f86-ba49-1cb0285e6666">
                  <SHORT-NAME>Cdd_Pwm_G2_Ch14Isr</SHORT-NAME>
                  <MINIMUM-START-INTERVAL>0.0</MINIMUM-START-INTERVAL>
                  <REENTRANCY-LEVEL>NON-REENTRANT</REENTRANCY-LEVEL>
                  <IMPLEMENTED-ENTRY-REF DEST="BSW-MODULE-ENTRY">/Cdd_Pwm_TI_AM263x/Cdd_Pwm_ModuleEntry/Cdd_Pwm_G2_Ch14Isr</IMPLEMENTED-ENTRY-REF>
                [!IF "as:modconf('Cdd_Pwm')[1]/CddPwmGeneral/CddPwmTypeofInterruptFunction = 'CDD_PWM_ISR_CAT2'"!][!//
                  <INTERRUPT-CATEGORY>CAT-2</INTERRUPT-CATEGORY>
                [!ELSE!][!//
                  <INTERRUPT-CATEGORY>CAT-1</INTERRUPT-CATEGORY>
                [!ENDIF!][!//
                  <INTERRUPT-SOURCE>Hardware</INTERRUPT-SOURCE>
                </BSW-INTERRUPT-ENTITY>
              [!ENDIF!][!//
              [!IF "num:i($CddChannel) = '15'"!][!//
                <BSW-INTERRUPT-ENTITY UUID="37b63def-01ff-48c1-8138-4e40e8af4220">
                  <SHORT-NAME>Cdd_Pwm_G2_Ch15Isr</SHORT-NAME>
                  <MINIMUM-START-INTERVAL>0.0</MINIMUM-START-INTERVAL>
                  <REENTRANCY-LEVEL>NON-REENTRANT</REENTRANCY-LEVEL>
                  <IMPLEMENTED-ENTRY-REF DEST="BSW-MODULE-ENTRY">/Cdd_Pwm_TI_AM263x/Cdd_Pwm_ModuleEntry/Cdd_Pwm_G2_Ch15Isr</IMPLEMENTED-ENTRY-REF>
                [!IF "as:modconf('Cdd_Pwm')[1]/CddPwmGeneral/CddPwmTypeofInterruptFunction = 'CDD_PWM_ISR_CAT2'"!][!//
                  <INTERRUPT-CATEGORY>CAT-2</INTERRUPT-CATEGORY>
                [!ELSE!][!//
                  <INTERRUPT-CATEGORY>CAT-1</INTERRUPT-CATEGORY>
                [!ENDIF!][!//
                  <INTERRUPT-SOURCE>Hardware</INTERRUPT-SOURCE>
                </BSW-INTERRUPT-ENTITY>
              [!ENDIF!][!//
              [!IF "num:i($CddChannel) = '16'"!][!//
                <BSW-INTERRUPT-ENTITY UUID="ea2a692a-26cc-478a-a342-10398619d0d8">
                  <SHORT-NAME>Cdd_Pwm_G2_Ch16Isr</SHORT-NAME>
                  <MINIMUM-START-INTERVAL>0.0</MINIMUM-START-INTERVAL>
                  <REENTRANCY-LEVEL>NON-REENTRANT</REENTRANCY-LEVEL>
                  <IMPLEMENTED-ENTRY-REF DEST="BSW-MODULE-ENTRY">/Cdd_Pwm_TI_AM263x/Cdd_Pwm_ModuleEntry/Cdd_Pwm_G2_Ch16Isr</IMPLEMENTED-ENTRY-REF>
                [!IF "as:modconf('Cdd_Pwm')[1]/CddPwmGeneral/CddPwmTypeofInterruptFunction = 'CDD_PWM_ISR_CAT2'"!][!//
                  <INTERRUPT-CATEGORY>CAT-2</INTERRUPT-CATEGORY>
                [!ELSE!][!//
                  <INTERRUPT-CATEGORY>CAT-1</INTERRUPT-CATEGORY>
                [!ENDIF!][!//
                  <INTERRUPT-SOURCE>Hardware</INTERRUPT-SOURCE>
                </BSW-INTERRUPT-ENTITY>
              [!ENDIF!][!//
              [!IF "num:i($CddChannel) = '17'"!][!//
                <BSW-INTERRUPT-ENTITY UUID="016ae4ee-16c4-4f48-80c8-a50475050abf">
                  <SHORT-NAME>Cdd_Pwm_G2_Ch17Isr</SHORT-NAME>
                  <MINIMUM-START-INTERVAL>0.0</MINIMUM-START-INTERVAL>
                  <REENTRANCY-LEVEL>NON-REENTRANT</REENTRANCY-LEVEL>
                  <IMPLEMENTED-ENTRY-REF DEST="BSW-MODULE-ENTRY">/Cdd_Pwm_TI_AM263x/Cdd_Pwm_ModuleEntry/Cdd_Pwm_G2_Ch17Isr</IMPLEMENTED-ENTRY-REF>
                [!IF "as:modconf('Cdd_Pwm')[1]/CddPwmGeneral/CddPwmTypeofInterruptFunction = 'CDD_PWM_ISR_CAT2'"!][!//
                  <INTERRUPT-CATEGORY>CAT-2</INTERRUPT-CATEGORY>
                [!ELSE!][!//
                  <INTERRUPT-CATEGORY>CAT-1</INTERRUPT-CATEGORY>
                [!ENDIF!][!//
                  <INTERRUPT-SOURCE>Hardware</INTERRUPT-SOURCE>
                </BSW-INTERRUPT-ENTITY>
              [!ENDIF!][!//
              [!IF "num:i($CddChannel) = '18'"!][!//
                <BSW-INTERRUPT-ENTITY UUID="e4a65ca2-8837-4f37-b942-1381fbec7fe7">
                  <SHORT-NAME>Cdd_Pwm_G2_Ch18Isr</SHORT-NAME>
                  <MINIMUM-START-INTERVAL>0.0</MINIMUM-START-INTERVAL>
                  <REENTRANCY-LEVEL>NON-REENTRANT</REENTRANCY-LEVEL>
                  <IMPLEMENTED-ENTRY-REF DEST="BSW-MODULE-ENTRY">/Cdd_Pwm_TI_AM263x/Cdd_Pwm_ModuleEntry/Cdd_Pwm_G2_Ch18Isr</IMPLEMENTED-ENTRY-REF>
                [!IF "as:modconf('Cdd_Pwm')[1]/CddPwmGeneral/CddPwmTypeofInterruptFunction = 'CDD_PWM_ISR_CAT2'"!][!//
                  <INTERRUPT-CATEGORY>CAT-2</INTERRUPT-CATEGORY>
                [!ELSE!][!//
                  <INTERRUPT-CATEGORY>CAT-1</INTERRUPT-CATEGORY>
                [!ENDIF!][!//
                  <INTERRUPT-SOURCE>Hardware</INTERRUPT-SOURCE>
                </BSW-INTERRUPT-ENTITY>
              [!ENDIF!][!//
              [!IF "num:i($CddChannel) = '19'"!][!//
                <BSW-INTERRUPT-ENTITY UUID="4ea4e8b3-63f0-4fe4-8d9e-0c19ef1d1d27">
                  <SHORT-NAME>Cdd_Pwm_G2_Ch19Isr</SHORT-NAME>
                  <MINIMUM-START-INTERVAL>0.0</MINIMUM-START-INTERVAL>
                  <REENTRANCY-LEVEL>NON-REENTRANT</REENTRANCY-LEVEL>
                  <IMPLEMENTED-ENTRY-REF DEST="BSW-MODULE-ENTRY">/Cdd_Pwm_TI_AM263x/Cdd_Pwm_ModuleEntry/Cdd_Pwm_G2_Ch19Isr</IMPLEMENTED-ENTRY-REF>
                [!IF "as:modconf('Cdd_Pwm')[1]/CddPwmGeneral/CddPwmTypeofInterruptFunction = 'CDD_PWM_ISR_CAT2'"!][!//
                  <INTERRUPT-CATEGORY>CAT-2</INTERRUPT-CATEGORY>
                [!ELSE!][!//
                  <INTERRUPT-CATEGORY>CAT-1</INTERRUPT-CATEGORY>
                [!ENDIF!][!//
                  <INTERRUPT-SOURCE>Hardware</INTERRUPT-SOURCE>
                </BSW-INTERRUPT-ENTITY>
              [!ENDIF!][!//
              [!IF "num:i($CddChannel) = '1'"!][!//
                <BSW-INTERRUPT-ENTITY UUID="6f90d731-e931-4aad-b33d-28539f78d007">
                  <SHORT-NAME>Cdd_Pwm_G2_Ch1Isr</SHORT-NAME>
                  <MINIMUM-START-INTERVAL>0.0</MINIMUM-START-INTERVAL>
                  <REENTRANCY-LEVEL>NON-REENTRANT</REENTRANCY-LEVEL>
                  <IMPLEMENTED-ENTRY-REF DEST="BSW-MODULE-ENTRY">/Cdd_Pwm_TI_AM263x/Cdd_Pwm_ModuleEntry/Cdd_Pwm_G2_Ch1Isr</IMPLEMENTED-ENTRY-REF>
                [!IF "as:modconf('Cdd_Pwm')[1]/CddPwmGeneral/CddPwmTypeofInterruptFunction = 'CDD_PWM_ISR_CAT2'"!][!//
                  <INTERRUPT-CATEGORY>CAT-2</INTERRUPT-CATEGORY>
                [!ELSE!][!//
                  <INTERRUPT-CATEGORY>CAT-1</INTERRUPT-CATEGORY>
                [!ENDIF!][!//
                  <INTERRUPT-SOURCE>Hardware</INTERRUPT-SOURCE>
                </BSW-INTERRUPT-ENTITY>
              [!ENDIF!][!//
              [!IF "num:i($CddChannel) = '20'"!][!//
                <BSW-INTERRUPT-ENTITY UUID="ba3f1bf7-6674-404a-9858-75c15074699c">
                  <SHORT-NAME>Cdd_Pwm_G2_Ch20Isr</SHORT-NAME>
                  <MINIMUM-START-INTERVAL>0.0</MINIMUM-START-INTERVAL>
                  <REENTRANCY-LEVEL>NON-REENTRANT</REENTRANCY-LEVEL>
                  <IMPLEMENTED-ENTRY-REF DEST="BSW-MODULE-ENTRY">/Cdd_Pwm_TI_AM263x/Cdd_Pwm_ModuleEntry/Cdd_Pwm_G2_Ch20Isr</IMPLEMENTED-ENTRY-REF>
                [!IF "as:modconf('Cdd_Pwm')[1]/CddPwmGeneral/CddPwmTypeofInterruptFunction = 'CDD_PWM_ISR_CAT2'"!][!//
                  <INTERRUPT-CATEGORY>CAT-2</INTERRUPT-CATEGORY>
                [!ELSE!][!//
                  <INTERRUPT-CATEGORY>CAT-1</INTERRUPT-CATEGORY>
                [!ENDIF!][!//
                  <INTERRUPT-SOURCE>Hardware</INTERRUPT-SOURCE>
                </BSW-INTERRUPT-ENTITY>
              [!ENDIF!][!//
              [!IF "num:i($CddChannel) = '21'"!][!//
                <BSW-INTERRUPT-ENTITY UUID="792d5c1d-f54f-4f5d-a82f-b30fabee4557">
                  <SHORT-NAME>Cdd_Pwm_G2_Ch21Isr</SHORT-NAME>
                  <MINIMUM-START-INTERVAL>0.0</MINIMUM-START-INTERVAL>
                  <REENTRANCY-LEVEL>NON-REENTRANT</REENTRANCY-LEVEL>
                  <IMPLEMENTED-ENTRY-REF DEST="BSW-MODULE-ENTRY">/Cdd_Pwm_TI_AM263x/Cdd_Pwm_ModuleEntry/Cdd_Pwm_G2_Ch21Isr</IMPLEMENTED-ENTRY-REF>
                [!IF "as:modconf('Cdd_Pwm')[1]/CddPwmGeneral/CddPwmTypeofInterruptFunction = 'CDD_PWM_ISR_CAT2'"!][!//
                  <INTERRUPT-CATEGORY>CAT-2</INTERRUPT-CATEGORY>
                [!ELSE!][!//
                  <INTERRUPT-CATEGORY>CAT-1</INTERRUPT-CATEGORY>
                [!ENDIF!][!//
                  <INTERRUPT-SOURCE>Hardware</INTERRUPT-SOURCE>
                </BSW-INTERRUPT-ENTITY>
              [!ENDIF!][!//
              [!IF "num:i($CddChannel) = '22'"!][!//
                <BSW-INTERRUPT-ENTITY UUID="a00742ea-5753-423c-8c17-c71887ecb260">
                  <SHORT-NAME>Cdd_Pwm_G2_Ch22Isr</SHORT-NAME>
                  <MINIMUM-START-INTERVAL>0.0</MINIMUM-START-INTERVAL>
                  <REENTRANCY-LEVEL>NON-REENTRANT</REENTRANCY-LEVEL>
                  <IMPLEMENTED-ENTRY-REF DEST="BSW-MODULE-ENTRY">/Cdd_Pwm_TI_AM263x/Cdd_Pwm_ModuleEntry/Cdd_Pwm_G2_Ch22Isr</IMPLEMENTED-ENTRY-REF>
                [!IF "as:modconf('Cdd_Pwm')[1]/CddPwmGeneral/CddPwmTypeofInterruptFunction = 'CDD_PWM_ISR_CAT2'"!][!//
                  <INTERRUPT-CATEGORY>CAT-2</INTERRUPT-CATEGORY>
                [!ELSE!][!//
                  <INTERRUPT-CATEGORY>CAT-1</INTERRUPT-CATEGORY>
                [!ENDIF!][!//
                  <INTERRUPT-SOURCE>Hardware</INTERRUPT-SOURCE>
                </BSW-INTERRUPT-ENTITY>
              [!ENDIF!][!//
              [!IF "num:i($CddChannel) = '23'"!][!//
                <BSW-INTERRUPT-ENTITY UUID="d2106c48-3d13-4f0d-bc22-4d52f51c66ba">
                  <SHORT-NAME>Cdd_Pwm_G2_Ch23Isr</SHORT-NAME>
                  <MINIMUM-START-INTERVAL>0.0</MINIMUM-START-INTERVAL>
                  <REENTRANCY-LEVEL>NON-REENTRANT</REENTRANCY-LEVEL>
                  <IMPLEMENTED-ENTRY-REF DEST="BSW-MODULE-ENTRY">/Cdd_Pwm_TI_AM263x/Cdd_Pwm_ModuleEntry/Cdd_Pwm_G2_Ch23Isr</IMPLEMENTED-ENTRY-REF>
                [!IF "as:modconf('Cdd_Pwm')[1]/CddPwmGeneral/CddPwmTypeofInterruptFunction = 'CDD_PWM_ISR_CAT2'"!][!//
                  <INTERRUPT-CATEGORY>CAT-2</INTERRUPT-CATEGORY>
                [!ELSE!][!//
                  <INTERRUPT-CATEGORY>CAT-1</INTERRUPT-CATEGORY>
                [!ENDIF!][!//
                  <INTERRUPT-SOURCE>Hardware</INTERRUPT-SOURCE>
                </BSW-INTERRUPT-ENTITY>
              [!ENDIF!][!//
              [!IF "num:i($CddChannel) = '24'"!][!//
                <BSW-INTERRUPT-ENTITY UUID="558f55e0-31a6-48e1-a24b-8a14c9c530fc">
                  <SHORT-NAME>Cdd_Pwm_G2_Ch24Isr</SHORT-NAME>
                  <MINIMUM-START-INTERVAL>0.0</MINIMUM-START-INTERVAL>
                  <REENTRANCY-LEVEL>NON-REENTRANT</REENTRANCY-LEVEL>
                  <IMPLEMENTED-ENTRY-REF DEST="BSW-MODULE-ENTRY">/Cdd_Pwm_TI_AM263x/Cdd_Pwm_ModuleEntry/Cdd_Pwm_G2_Ch24Isr</IMPLEMENTED-ENTRY-REF>
                [!IF "as:modconf('Cdd_Pwm')[1]/CddPwmGeneral/CddPwmTypeofInterruptFunction = 'CDD_PWM_ISR_CAT2'"!][!//
                  <INTERRUPT-CATEGORY>CAT-2</INTERRUPT-CATEGORY>
                [!ELSE!][!//
                  <INTERRUPT-CATEGORY>CAT-1</INTERRUPT-CATEGORY>
                [!ENDIF!][!//
                  <INTERRUPT-SOURCE>Hardware</INTERRUPT-SOURCE>
                </BSW-INTERRUPT-ENTITY>
              [!ENDIF!][!//
              [!IF "num:i($CddChannel) = '25'"!][!//
                <BSW-INTERRUPT-ENTITY UUID="81eaad57-cab4-47b9-b82f-f716b1d91610">
                  <SHORT-NAME>Cdd_Pwm_G2_Ch25Isr</SHORT-NAME>
                  <MINIMUM-START-INTERVAL>0.0</MINIMUM-START-INTERVAL>
                  <REENTRANCY-LEVEL>NON-REENTRANT</REENTRANCY-LEVEL>
                  <IMPLEMENTED-ENTRY-REF DEST="BSW-MODULE-ENTRY">/Cdd_Pwm_TI_AM263x/Cdd_Pwm_ModuleEntry/Cdd_Pwm_G2_Ch25Isr</IMPLEMENTED-ENTRY-REF>
                [!IF "as:modconf('Cdd_Pwm')[1]/CddPwmGeneral/CddPwmTypeofInterruptFunction = 'CDD_PWM_ISR_CAT2'"!][!//
                  <INTERRUPT-CATEGORY>CAT-2</INTERRUPT-CATEGORY>
                [!ELSE!][!//
                  <INTERRUPT-CATEGORY>CAT-1</INTERRUPT-CATEGORY>
                [!ENDIF!][!//
                  <INTERRUPT-SOURCE>Hardware</INTERRUPT-SOURCE>
                </BSW-INTERRUPT-ENTITY>
              [!ENDIF!][!//
              [!IF "num:i($CddChannel) = '26'"!][!//
                <BSW-INTERRUPT-ENTITY UUID="b9ccd13f-00d4-4189-b13d-44139c9c11de">
                  <SHORT-NAME>Cdd_Pwm_G2_Ch26Isr</SHORT-NAME>
                  <MINIMUM-START-INTERVAL>0.0</MINIMUM-START-INTERVAL>
                  <REENTRANCY-LEVEL>NON-REENTRANT</REENTRANCY-LEVEL>
                  <IMPLEMENTED-ENTRY-REF DEST="BSW-MODULE-ENTRY">/Cdd_Pwm_TI_AM263x/Cdd_Pwm_ModuleEntry/Cdd_Pwm_G2_Ch26Isr</IMPLEMENTED-ENTRY-REF>
                [!IF "as:modconf('Cdd_Pwm')[1]/CddPwmGeneral/CddPwmTypeofInterruptFunction = 'CDD_PWM_ISR_CAT2'"!][!//
                  <INTERRUPT-CATEGORY>CAT-2</INTERRUPT-CATEGORY>
                [!ELSE!][!//
                  <INTERRUPT-CATEGORY>CAT-1</INTERRUPT-CATEGORY>
                [!ENDIF!][!//
                  <INTERRUPT-SOURCE>Hardware</INTERRUPT-SOURCE>
                </BSW-INTERRUPT-ENTITY>
              [!ENDIF!][!//
              [!IF "num:i($CddChannel) = '27'"!][!//
                <BSW-INTERRUPT-ENTITY UUID="7229a3ee-5207-49b5-a751-754ab3f8740c">
                  <SHORT-NAME>Cdd_Pwm_G2_Ch27Isr</SHORT-NAME>
                  <MINIMUM-START-INTERVAL>0.0</MINIMUM-START-INTERVAL>
                  <REENTRANCY-LEVEL>NON-REENTRANT</REENTRANCY-LEVEL>
                  <IMPLEMENTED-ENTRY-REF DEST="BSW-MODULE-ENTRY">/Cdd_Pwm_TI_AM263x/Cdd_Pwm_ModuleEntry/Cdd_Pwm_G2_Ch27Isr</IMPLEMENTED-ENTRY-REF>
                [!IF "as:modconf('Cdd_Pwm')[1]/CddPwmGeneral/CddPwmTypeofInterruptFunction = 'CDD_PWM_ISR_CAT2'"!][!//
                  <INTERRUPT-CATEGORY>CAT-2</INTERRUPT-CATEGORY>
                [!ELSE!][!//
                  <INTERRUPT-CATEGORY>CAT-1</INTERRUPT-CATEGORY>
                [!ENDIF!][!//
                  <INTERRUPT-SOURCE>Hardware</INTERRUPT-SOURCE>
                </BSW-INTERRUPT-ENTITY>
              [!ENDIF!][!//
              [!IF "num:i($CddChannel) = '28'"!][!//
                <BSW-INTERRUPT-ENTITY UUID="c76c552c-b04a-44f7-9eb3-a43ce5d226cf">
                  <SHORT-NAME>Cdd_Pwm_G2_Ch28Isr</SHORT-NAME>
                  <MINIMUM-START-INTERVAL>0.0</MINIMUM-START-INTERVAL>
                  <REENTRANCY-LEVEL>NON-REENTRANT</REENTRANCY-LEVEL>
                  <IMPLEMENTED-ENTRY-REF DEST="BSW-MODULE-ENTRY">/Cdd_Pwm_TI_AM263x/Cdd_Pwm_ModuleEntry/Cdd_Pwm_G2_Ch28Isr</IMPLEMENTED-ENTRY-REF>
                [!IF "as:modconf('Cdd_Pwm')[1]/CddPwmGeneral/CddPwmTypeofInterruptFunction = 'CDD_PWM_ISR_CAT2'"!][!//
                  <INTERRUPT-CATEGORY>CAT-2</INTERRUPT-CATEGORY>
                [!ELSE!][!//
                  <INTERRUPT-CATEGORY>CAT-1</INTERRUPT-CATEGORY>
                [!ENDIF!][!//
                  <INTERRUPT-SOURCE>Hardware</INTERRUPT-SOURCE>
                </BSW-INTERRUPT-ENTITY>
              [!ENDIF!][!//
              [!IF "num:i($CddChannel) = '29'"!][!//
                <BSW-INTERRUPT-ENTITY UUID="085c637c-14b8-4cf6-bd04-d156b75bc1d8">
                  <SHORT-NAME>Cdd_Pwm_G2_Ch29Isr</SHORT-NAME>
                  <MINIMUM-START-INTERVAL>0.0</MINIMUM-START-INTERVAL>
                  <REENTRANCY-LEVEL>NON-REENTRANT</REENTRANCY-LEVEL>
                  <IMPLEMENTED-ENTRY-REF DEST="BSW-MODULE-ENTRY">/Cdd_Pwm_TI_AM263x/Cdd_Pwm_ModuleEntry/Cdd_Pwm_G2_Ch29Isr</IMPLEMENTED-ENTRY-REF>
                [!IF "as:modconf('Cdd_Pwm')[1]/CddPwmGeneral/CddPwmTypeofInterruptFunction = 'CDD_PWM_ISR_CAT2'"!][!//
                  <INTERRUPT-CATEGORY>CAT-2</INTERRUPT-CATEGORY>
                [!ELSE!][!//
                  <INTERRUPT-CATEGORY>CAT-1</INTERRUPT-CATEGORY>
                [!ENDIF!][!//
                  <INTERRUPT-SOURCE>Hardware</INTERRUPT-SOURCE>
                </BSW-INTERRUPT-ENTITY>
              [!ENDIF!][!//
              [!IF "num:i($CddChannel) = '2'"!][!//
                <BSW-INTERRUPT-ENTITY UUID="ae7aa84c-3870-4c2f-9ef0-21f1c7c73471">
                  <SHORT-NAME>Cdd_Pwm_G2_Ch2Isr</SHORT-NAME>
                  <MINIMUM-START-INTERVAL>0.0</MINIMUM-START-INTERVAL>
                  <REENTRANCY-LEVEL>NON-REENTRANT</REENTRANCY-LEVEL>
                  <IMPLEMENTED-ENTRY-REF DEST="BSW-MODULE-ENTRY">/Cdd_Pwm_TI_AM263x/Cdd_Pwm_ModuleEntry/Cdd_Pwm_G2_Ch2Isr</IMPLEMENTED-ENTRY-REF>
                [!IF "as:modconf('Cdd_Pwm')[1]/CddPwmGeneral/CddPwmTypeofInterruptFunction = 'CDD_PWM_ISR_CAT2'"!][!//
                  <INTERRUPT-CATEGORY>CAT-2</INTERRUPT-CATEGORY>
                [!ELSE!][!//
                  <INTERRUPT-CATEGORY>CAT-1</INTERRUPT-CATEGORY>
                [!ENDIF!][!//
                  <INTERRUPT-SOURCE>Hardware</INTERRUPT-SOURCE>
                </BSW-INTERRUPT-ENTITY>
              [!ENDIF!][!//
              [!IF "num:i($CddChannel) = '30'"!][!//
                <BSW-INTERRUPT-ENTITY UUID="d5916150-0d34-4bdd-9eb9-67d5598ad1ce">
                  <SHORT-NAME>Cdd_Pwm_G2_Ch30Isr</SHORT-NAME>
                  <MINIMUM-START-INTERVAL>0.0</MINIMUM-START-INTERVAL>
                  <REENTRANCY-LEVEL>NON-REENTRANT</REENTRANCY-LEVEL>
                  <IMPLEMENTED-ENTRY-REF DEST="BSW-MODULE-ENTRY">/Cdd_Pwm_TI_AM263x/Cdd_Pwm_ModuleEntry/Cdd_Pwm_G2_Ch30Isr</IMPLEMENTED-ENTRY-REF>
                [!IF "as:modconf('Cdd_Pwm')[1]/CddPwmGeneral/CddPwmTypeofInterruptFunction = 'CDD_PWM_ISR_CAT2'"!][!//
                  <INTERRUPT-CATEGORY>CAT-2</INTERRUPT-CATEGORY>
                [!ELSE!][!//
                  <INTERRUPT-CATEGORY>CAT-1</INTERRUPT-CATEGORY>
                [!ENDIF!][!//
                  <INTERRUPT-SOURCE>Hardware</INTERRUPT-SOURCE>
                </BSW-INTERRUPT-ENTITY>
              [!ENDIF!][!//
              [!IF "num:i($CddChannel) = '31'"!][!//
                <BSW-INTERRUPT-ENTITY UUID="367ace40-c6b0-4f53-bdda-63ba7bb77cb3">
                  <SHORT-NAME>Cdd_Pwm_G2_Ch31Isr</SHORT-NAME>
                  <MINIMUM-START-INTERVAL>0.0</MINIMUM-START-INTERVAL>
                  <REENTRANCY-LEVEL>NON-REENTRANT</REENTRANCY-LEVEL>
                  <IMPLEMENTED-ENTRY-REF DEST="BSW-MODULE-ENTRY">/Cdd_Pwm_TI_AM263x/Cdd_Pwm_ModuleEntry/Cdd_Pwm_G2_Ch31Isr</IMPLEMENTED-ENTRY-REF>
                [!IF "as:modconf('Cdd_Pwm')[1]/CddPwmGeneral/CddPwmTypeofInterruptFunction = 'CDD_PWM_ISR_CAT2'"!][!//
                  <INTERRUPT-CATEGORY>CAT-2</INTERRUPT-CATEGORY>
                [!ELSE!][!//
                  <INTERRUPT-CATEGORY>CAT-1</INTERRUPT-CATEGORY>
                [!ENDIF!][!//
                  <INTERRUPT-SOURCE>Hardware</INTERRUPT-SOURCE>
                </BSW-INTERRUPT-ENTITY>
              [!ENDIF!][!//
              [!IF "num:i($CddChannel) = '3'"!][!//
                <BSW-INTERRUPT-ENTITY UUID="d9fedeff-d63a-4691-9b8d-cb18a0dd5bb0">
                  <SHORT-NAME>Cdd_Pwm_G2_Ch3Isr</SHORT-NAME>
                  <MINIMUM-START-INTERVAL>0.0</MINIMUM-START-INTERVAL>
                  <REENTRANCY-LEVEL>NON-REENTRANT</REENTRANCY-LEVEL>
                  <IMPLEMENTED-ENTRY-REF DEST="BSW-MODULE-ENTRY">/Cdd_Pwm_TI_AM263x/Cdd_Pwm_ModuleEntry/Cdd_Pwm_G2_Ch3Isr</IMPLEMENTED-ENTRY-REF>
                [!IF "as:modconf('Cdd_Pwm')[1]/CddPwmGeneral/CddPwmTypeofInterruptFunction = 'CDD_PWM_ISR_CAT2'"!][!//
                  <INTERRUPT-CATEGORY>CAT-2</INTERRUPT-CATEGORY>
                [!ELSE!][!//
                  <INTERRUPT-CATEGORY>CAT-1</INTERRUPT-CATEGORY>
                [!ENDIF!][!//
                  <INTERRUPT-SOURCE>Hardware</INTERRUPT-SOURCE>
                </BSW-INTERRUPT-ENTITY>
              [!ENDIF!][!//
              [!IF "num:i($CddChannel) = '4'"!][!//
                <BSW-INTERRUPT-ENTITY UUID="744c42bc-c856-4300-962c-cc5516a597bf">
                  <SHORT-NAME>Cdd_Pwm_G2_Ch4Isr</SHORT-NAME>
                  <MINIMUM-START-INTERVAL>0.0</MINIMUM-START-INTERVAL>
                  <REENTRANCY-LEVEL>NON-REENTRANT</REENTRANCY-LEVEL>
                  <IMPLEMENTED-ENTRY-REF DEST="BSW-MODULE-ENTRY">/Cdd_Pwm_TI_AM263x/Cdd_Pwm_ModuleEntry/Cdd_Pwm_G2_Ch4Isr</IMPLEMENTED-ENTRY-REF>
                [!IF "as:modconf('Cdd_Pwm')[1]/CddPwmGeneral/CddPwmTypeofInterruptFunction = 'CDD_PWM_ISR_CAT2'"!][!//
                  <INTERRUPT-CATEGORY>CAT-2</INTERRUPT-CATEGORY>
                [!ELSE!][!//
                  <INTERRUPT-CATEGORY>CAT-1</INTERRUPT-CATEGORY>
                [!ENDIF!][!//
                  <INTERRUPT-SOURCE>Hardware</INTERRUPT-SOURCE>
                </BSW-INTERRUPT-ENTITY>
              [!ENDIF!][!//
              [!IF "num:i($CddChannel) = '5'"!][!//
                <BSW-INTERRUPT-ENTITY UUID="edfb5b24-d820-4d00-b00f-e74edbca3a50">
                  <SHORT-NAME>Cdd_Pwm_G2_Ch5Isr</SHORT-NAME>
                  <MINIMUM-START-INTERVAL>0.0</MINIMUM-START-INTERVAL>
                  <REENTRANCY-LEVEL>NON-REENTRANT</REENTRANCY-LEVEL>
                  <IMPLEMENTED-ENTRY-REF DEST="BSW-MODULE-ENTRY">/Cdd_Pwm_TI_AM263x/Cdd_Pwm_ModuleEntry/Cdd_Pwm_G2_Ch5Isr</IMPLEMENTED-ENTRY-REF>
                [!IF "as:modconf('Cdd_Pwm')[1]/CddPwmGeneral/CddPwmTypeofInterruptFunction = 'CDD_PWM_ISR_CAT2'"!][!//
                  <INTERRUPT-CATEGORY>CAT-2</INTERRUPT-CATEGORY>
                [!ELSE!][!//
                  <INTERRUPT-CATEGORY>CAT-1</INTERRUPT-CATEGORY>
                [!ENDIF!][!//
                  <INTERRUPT-SOURCE>Hardware</INTERRUPT-SOURCE>
                </BSW-INTERRUPT-ENTITY>
              [!ENDIF!][!//
              [!IF "num:i($CddChannel) = '6'"!][!//
                <BSW-INTERRUPT-ENTITY UUID="08864aa7-1992-4c96-8c0b-31fd3a3ebc19">
                  <SHORT-NAME>Cdd_Pwm_G2_Ch6Isr</SHORT-NAME>
                  <MINIMUM-START-INTERVAL>0.0</MINIMUM-START-INTERVAL>
                  <REENTRANCY-LEVEL>NON-REENTRANT</REENTRANCY-LEVEL>
                  <IMPLEMENTED-ENTRY-REF DEST="BSW-MODULE-ENTRY">/Cdd_Pwm_TI_AM263x/Cdd_Pwm_ModuleEntry/Cdd_Pwm_G2_Ch6Isr</IMPLEMENTED-ENTRY-REF>
                [!IF "as:modconf('Cdd_Pwm')[1]/CddPwmGeneral/CddPwmTypeofInterruptFunction = 'CDD_PWM_ISR_CAT2'"!][!//
                  <INTERRUPT-CATEGORY>CAT-2</INTERRUPT-CATEGORY>
                [!ELSE!][!//
                  <INTERRUPT-CATEGORY>CAT-1</INTERRUPT-CATEGORY>
                [!ENDIF!][!//
                  <INTERRUPT-SOURCE>Hardware</INTERRUPT-SOURCE>
                </BSW-INTERRUPT-ENTITY>
              [!ENDIF!][!//
              [!IF "num:i($CddChannel) = '7'"!][!//
                <BSW-INTERRUPT-ENTITY UUID="a14312bf-776a-4dd1-8f12-15d82c819f6a">
                  <SHORT-NAME>Cdd_Pwm_G2_Ch7Isr</SHORT-NAME>
                  <MINIMUM-START-INTERVAL>0.0</MINIMUM-START-INTERVAL>
                  <REENTRANCY-LEVEL>NON-REENTRANT</REENTRANCY-LEVEL>
                  <IMPLEMENTED-ENTRY-REF DEST="BSW-MODULE-ENTRY">/Cdd_Pwm_TI_AM263x/Cdd_Pwm_ModuleEntry/Cdd_Pwm_G2_Ch7Isr</IMPLEMENTED-ENTRY-REF>
                [!IF "as:modconf('Cdd_Pwm')[1]/CddPwmGeneral/CddPwmTypeofInterruptFunction = 'CDD_PWM_ISR_CAT2'"!][!//
                  <INTERRUPT-CATEGORY>CAT-2</INTERRUPT-CATEGORY>
                [!ELSE!][!//
                  <INTERRUPT-CATEGORY>CAT-1</INTERRUPT-CATEGORY>
                [!ENDIF!][!//
                  <INTERRUPT-SOURCE>Hardware</INTERRUPT-SOURCE>
                </BSW-INTERRUPT-ENTITY>
              [!ENDIF!][!//
              [!IF "num:i($CddChannel) = '8'"!][!//
                <BSW-INTERRUPT-ENTITY UUID="4af20958-c92e-4192-958a-c2182edb7b61">
                  <SHORT-NAME>Cdd_Pwm_G2_Ch8Isr</SHORT-NAME>
                  <MINIMUM-START-INTERVAL>0.0</MINIMUM-START-INTERVAL>
                  <REENTRANCY-LEVEL>NON-REENTRANT</REENTRANCY-LEVEL>
                  <IMPLEMENTED-ENTRY-REF DEST="BSW-MODULE-ENTRY">/Cdd_Pwm_TI_AM263x/Cdd_Pwm_ModuleEntry/Cdd_Pwm_G2_Ch8Isr</IMPLEMENTED-ENTRY-REF>
                [!IF "as:modconf('Cdd_Pwm')[1]/CddPwmGeneral/CddPwmTypeofInterruptFunction = 'CDD_PWM_ISR_CAT2'"!][!//
                  <INTERRUPT-CATEGORY>CAT-2</INTERRUPT-CATEGORY>
                [!ELSE!][!//
                  <INTERRUPT-CATEGORY>CAT-1</INTERRUPT-CATEGORY>
                [!ENDIF!][!//
                  <INTERRUPT-SOURCE>Hardware</INTERRUPT-SOURCE>
                </BSW-INTERRUPT-ENTITY>
              [!ENDIF!][!//
              [!IF "num:i($CddChannel) = '9'"!][!//
                <BSW-INTERRUPT-ENTITY UUID="a0199071-e71e-4789-ac1e-36c8cb6db331">
                  <SHORT-NAME>Cdd_Pwm_G2_Ch9Isr</SHORT-NAME>
                  <MINIMUM-START-INTERVAL>0.0</MINIMUM-START-INTERVAL>
                  <REENTRANCY-LEVEL>NON-REENTRANT</REENTRANCY-LEVEL>
                  <IMPLEMENTED-ENTRY-REF DEST="BSW-MODULE-ENTRY">/Cdd_Pwm_TI_AM263x/Cdd_Pwm_ModuleEntry/Cdd_Pwm_G2_Ch9Isr</IMPLEMENTED-ENTRY-REF>
                [!IF "as:modconf('Cdd_Pwm')[1]/CddPwmGeneral/CddPwmTypeofInterruptFunction = 'CDD_PWM_ISR_CAT2'"!][!//
                  <INTERRUPT-CATEGORY>CAT-2</INTERRUPT-CATEGORY>
                [!ELSE!][!//
                  <INTERRUPT-CATEGORY>CAT-1</INTERRUPT-CATEGORY>
                [!ENDIF!][!//
                  <INTERRUPT-SOURCE>Hardware</INTERRUPT-SOURCE>
                </BSW-INTERRUPT-ENTITY>
              [!ENDIF!][!//
              [!IF "num:i($CddChannel) = '0'"!][!//
                <BSW-INTERRUPT-ENTITY UUID="bc61de34-115d-4b45-8882-8ae26f307627">
                  <SHORT-NAME>Cdd_Pwm_G2_TzCh0Isr</SHORT-NAME>
                  <MINIMUM-START-INTERVAL>0.0</MINIMUM-START-INTERVAL>
                  <REENTRANCY-LEVEL>NON-REENTRANT</REENTRANCY-LEVEL>
                  <IMPLEMENTED-ENTRY-REF DEST="BSW-MODULE-ENTRY">/Cdd_Pwm_TI_AM263x/Cdd_Pwm_ModuleEntry/Cdd_Pwm_G2_TzCh0Isr</IMPLEMENTED-ENTRY-REF>
                [!IF "as:modconf('Cdd_Pwm')[1]/CddPwmGeneral/CddPwmTypeofInterruptFunction = 'CDD_PWM_ISR_CAT2'"!][!//
                  <INTERRUPT-CATEGORY>CAT-2</INTERRUPT-CATEGORY>
                [!ELSE!][!//
                  <INTERRUPT-CATEGORY>CAT-1</INTERRUPT-CATEGORY>
                [!ENDIF!][!//
                  <INTERRUPT-SOURCE>Hardware</INTERRUPT-SOURCE>
                </BSW-INTERRUPT-ENTITY>
              [!ENDIF!][!//
              [!IF "num:i($CddChannel) = '10'"!][!//
                <BSW-INTERRUPT-ENTITY UUID="fcfc1a5d-e86b-492c-9c58-78f5402674d1">
                  <SHORT-NAME>Cdd_Pwm_G2_TzCh10Isr</SHORT-NAME>
                  <MINIMUM-START-INTERVAL>0.0</MINIMUM-START-INTERVAL>
                  <REENTRANCY-LEVEL>NON-REENTRANT</REENTRANCY-LEVEL>
                  <IMPLEMENTED-ENTRY-REF DEST="BSW-MODULE-ENTRY">/Cdd_Pwm_TI_AM263x/Cdd_Pwm_ModuleEntry/Cdd_Pwm_G2_TzCh10Isr</IMPLEMENTED-ENTRY-REF>
                [!IF "as:modconf('Cdd_Pwm')[1]/CddPwmGeneral/CddPwmTypeofInterruptFunction = 'CDD_PWM_ISR_CAT2'"!][!//
                  <INTERRUPT-CATEGORY>CAT-2</INTERRUPT-CATEGORY>
                [!ELSE!][!//
                  <INTERRUPT-CATEGORY>CAT-1</INTERRUPT-CATEGORY>
                [!ENDIF!][!//
                  <INTERRUPT-SOURCE>Hardware</INTERRUPT-SOURCE>
                </BSW-INTERRUPT-ENTITY>
              [!ENDIF!][!//
              [!IF "num:i($CddChannel) = '11'"!][!//
                <BSW-INTERRUPT-ENTITY UUID="a659869f-e70a-4adf-b861-fdc195c642ee">
                  <SHORT-NAME>Cdd_Pwm_G2_TzCh11Isr</SHORT-NAME>
                  <MINIMUM-START-INTERVAL>0.0</MINIMUM-START-INTERVAL>
                  <REENTRANCY-LEVEL>NON-REENTRANT</REENTRANCY-LEVEL>
                  <IMPLEMENTED-ENTRY-REF DEST="BSW-MODULE-ENTRY">/Cdd_Pwm_TI_AM263x/Cdd_Pwm_ModuleEntry/Cdd_Pwm_G2_TzCh11Isr</IMPLEMENTED-ENTRY-REF>
                [!IF "as:modconf('Cdd_Pwm')[1]/CddPwmGeneral/CddPwmTypeofInterruptFunction = 'CDD_PWM_ISR_CAT2'"!][!//
                  <INTERRUPT-CATEGORY>CAT-2</INTERRUPT-CATEGORY>
                [!ELSE!][!//
                  <INTERRUPT-CATEGORY>CAT-1</INTERRUPT-CATEGORY>
                [!ENDIF!][!//
                  <INTERRUPT-SOURCE>Hardware</INTERRUPT-SOURCE>
                </BSW-INTERRUPT-ENTITY>
              [!ENDIF!][!//
              [!IF "num:i($CddChannel) = '12'"!][!//
                <BSW-INTERRUPT-ENTITY UUID="4de4323d-08d7-4a58-bf0a-d580e60c78e6">
                  <SHORT-NAME>Cdd_Pwm_G2_TzCh12Isr</SHORT-NAME>
                  <MINIMUM-START-INTERVAL>0.0</MINIMUM-START-INTERVAL>
                  <REENTRANCY-LEVEL>NON-REENTRANT</REENTRANCY-LEVEL>
                  <IMPLEMENTED-ENTRY-REF DEST="BSW-MODULE-ENTRY">/Cdd_Pwm_TI_AM263x/Cdd_Pwm_ModuleEntry/Cdd_Pwm_G2_TzCh12Isr</IMPLEMENTED-ENTRY-REF>
                [!IF "as:modconf('Cdd_Pwm')[1]/CddPwmGeneral/CddPwmTypeofInterruptFunction = 'CDD_PWM_ISR_CAT2'"!][!//
                  <INTERRUPT-CATEGORY>CAT-2</INTERRUPT-CATEGORY>
                [!ELSE!][!//
                  <INTERRUPT-CATEGORY>CAT-1</INTERRUPT-CATEGORY>
                [!ENDIF!][!//
                  <INTERRUPT-SOURCE>Hardware</INTERRUPT-SOURCE>
                </BSW-INTERRUPT-ENTITY>
              [!ENDIF!][!//
              [!IF "num:i($CddChannel) = '13'"!][!//
                <BSW-INTERRUPT-ENTITY UUID="748bdeb6-48c6-4bce-8180-6759b5e74e35">
                  <SHORT-NAME>Cdd_Pwm_G2_TzCh13Isr</SHORT-NAME>
                  <MINIMUM-START-INTERVAL>0.0</MINIMUM-START-INTERVAL>
                  <REENTRANCY-LEVEL>NON-REENTRANT</REENTRANCY-LEVEL>
                  <IMPLEMENTED-ENTRY-REF DEST="BSW-MODULE-ENTRY">/Cdd_Pwm_TI_AM263x/Cdd_Pwm_ModuleEntry/Cdd_Pwm_G2_TzCh13Isr</IMPLEMENTED-ENTRY-REF>
                [!IF "as:modconf('Cdd_Pwm')[1]/CddPwmGeneral/CddPwmTypeofInterruptFunction = 'CDD_PWM_ISR_CAT2'"!][!//
                  <INTERRUPT-CATEGORY>CAT-2</INTERRUPT-CATEGORY>
                [!ELSE!][!//
                  <INTERRUPT-CATEGORY>CAT-1</INTERRUPT-CATEGORY>
                [!ENDIF!][!//
                  <INTERRUPT-SOURCE>Hardware</INTERRUPT-SOURCE>
                </BSW-INTERRUPT-ENTITY>
              [!ENDIF!][!//
              [!IF "num:i($CddChannel) = '14'"!][!//
                <BSW-INTERRUPT-ENTITY UUID="fe89f02a-8e11-4980-ab76-ba4d63ee84e9">
                  <SHORT-NAME>Cdd_Pwm_G2_TzCh14Isr</SHORT-NAME>
                  <MINIMUM-START-INTERVAL>0.0</MINIMUM-START-INTERVAL>
                  <REENTRANCY-LEVEL>NON-REENTRANT</REENTRANCY-LEVEL>
                  <IMPLEMENTED-ENTRY-REF DEST="BSW-MODULE-ENTRY">/Cdd_Pwm_TI_AM263x/Cdd_Pwm_ModuleEntry/Cdd_Pwm_G2_TzCh14Isr</IMPLEMENTED-ENTRY-REF>
                [!IF "as:modconf('Cdd_Pwm')[1]/CddPwmGeneral/CddPwmTypeofInterruptFunction = 'CDD_PWM_ISR_CAT2'"!][!//
                  <INTERRUPT-CATEGORY>CAT-2</INTERRUPT-CATEGORY>
                [!ELSE!][!//
                  <INTERRUPT-CATEGORY>CAT-1</INTERRUPT-CATEGORY>
                [!ENDIF!][!//
                  <INTERRUPT-SOURCE>Hardware</INTERRUPT-SOURCE>
                </BSW-INTERRUPT-ENTITY>
              [!ENDIF!][!//
              [!IF "num:i($CddChannel) = '15'"!][!//
                <BSW-INTERRUPT-ENTITY UUID="f487d802-2bbf-4a2c-a01c-7b5dd24d838a">
                  <SHORT-NAME>Cdd_Pwm_G2_TzCh15Isr</SHORT-NAME>
                  <MINIMUM-START-INTERVAL>0.0</MINIMUM-START-INTERVAL>
                  <REENTRANCY-LEVEL>NON-REENTRANT</REENTRANCY-LEVEL>
                  <IMPLEMENTED-ENTRY-REF DEST="BSW-MODULE-ENTRY">/Cdd_Pwm_TI_AM263x/Cdd_Pwm_ModuleEntry/Cdd_Pwm_G2_TzCh15Isr</IMPLEMENTED-ENTRY-REF>
                [!IF "as:modconf('Cdd_Pwm')[1]/CddPwmGeneral/CddPwmTypeofInterruptFunction = 'CDD_PWM_ISR_CAT2'"!][!//
                  <INTERRUPT-CATEGORY>CAT-2</INTERRUPT-CATEGORY>
                [!ELSE!][!//
                  <INTERRUPT-CATEGORY>CAT-1</INTERRUPT-CATEGORY>
                [!ENDIF!][!//
                  <INTERRUPT-SOURCE>Hardware</INTERRUPT-SOURCE>
                </BSW-INTERRUPT-ENTITY>
              [!ENDIF!][!//
              [!IF "num:i($CddChannel) = '16'"!][!//
                <BSW-INTERRUPT-ENTITY UUID="c2649f11-4295-4080-9423-bfa836d359e4">
                  <SHORT-NAME>Cdd_Pwm_G2_TzCh16Isr</SHORT-NAME>
                  <MINIMUM-START-INTERVAL>0.0</MINIMUM-START-INTERVAL>
                  <REENTRANCY-LEVEL>NON-REENTRANT</REENTRANCY-LEVEL>
                  <IMPLEMENTED-ENTRY-REF DEST="BSW-MODULE-ENTRY">/Cdd_Pwm_TI_AM263x/Cdd_Pwm_ModuleEntry/Cdd_Pwm_G2_TzCh16Isr</IMPLEMENTED-ENTRY-REF>
                [!IF "as:modconf('Cdd_Pwm')[1]/CddPwmGeneral/CddPwmTypeofInterruptFunction = 'CDD_PWM_ISR_CAT2'"!][!//
                  <INTERRUPT-CATEGORY>CAT-2</INTERRUPT-CATEGORY>
                [!ELSE!][!//
                  <INTERRUPT-CATEGORY>CAT-1</INTERRUPT-CATEGORY>
                [!ENDIF!][!//
                  <INTERRUPT-SOURCE>Hardware</INTERRUPT-SOURCE>
                </BSW-INTERRUPT-ENTITY>
              [!ENDIF!][!//
              [!IF "num:i($CddChannel) = '17'"!][!//
                <BSW-INTERRUPT-ENTITY UUID="0b8e6f30-f486-4e79-a534-349168637140">
                  <SHORT-NAME>Cdd_Pwm_G2_TzCh17Isr</SHORT-NAME>
                  <MINIMUM-START-INTERVAL>0.0</MINIMUM-START-INTERVAL>
                  <REENTRANCY-LEVEL>NON-REENTRANT</REENTRANCY-LEVEL>
                  <IMPLEMENTED-ENTRY-REF DEST="BSW-MODULE-ENTRY">/Cdd_Pwm_TI_AM263x/Cdd_Pwm_ModuleEntry/Cdd_Pwm_G2_TzCh17Isr</IMPLEMENTED-ENTRY-REF>
                [!IF "as:modconf('Cdd_Pwm')[1]/CddPwmGeneral/CddPwmTypeofInterruptFunction = 'CDD_PWM_ISR_CAT2'"!][!//
                  <INTERRUPT-CATEGORY>CAT-2</INTERRUPT-CATEGORY>
                [!ELSE!][!//
                  <INTERRUPT-CATEGORY>CAT-1</INTERRUPT-CATEGORY>
                [!ENDIF!][!//
                  <INTERRUPT-SOURCE>Hardware</INTERRUPT-SOURCE>
                </BSW-INTERRUPT-ENTITY>
              [!ENDIF!][!//
              [!IF "num:i($CddChannel) = '18'"!][!//
                <BSW-INTERRUPT-ENTITY UUID="449d7a15-745e-4d0e-b415-b49645c9789d">
                  <SHORT-NAME>Cdd_Pwm_G2_TzCh18Isr</SHORT-NAME>
                  <MINIMUM-START-INTERVAL>0.0</MINIMUM-START-INTERVAL>
                  <REENTRANCY-LEVEL>NON-REENTRANT</REENTRANCY-LEVEL>
                  <IMPLEMENTED-ENTRY-REF DEST="BSW-MODULE-ENTRY">/Cdd_Pwm_TI_AM263x/Cdd_Pwm_ModuleEntry/Cdd_Pwm_G2_TzCh18Isr</IMPLEMENTED-ENTRY-REF>
                [!IF "as:modconf('Cdd_Pwm')[1]/CddPwmGeneral/CddPwmTypeofInterruptFunction = 'CDD_PWM_ISR_CAT2'"!][!//
                  <INTERRUPT-CATEGORY>CAT-2</INTERRUPT-CATEGORY>
                [!ELSE!][!//
                  <INTERRUPT-CATEGORY>CAT-1</INTERRUPT-CATEGORY>
                [!ENDIF!][!//
                  <INTERRUPT-SOURCE>Hardware</INTERRUPT-SOURCE>
                </BSW-INTERRUPT-ENTITY>
              [!ENDIF!][!//
              [!IF "num:i($CddChannel) = '19'"!][!//
                <BSW-INTERRUPT-ENTITY UUID="c666df3e-0eb3-4e95-bb70-8609c5d290ff">
                  <SHORT-NAME>Cdd_Pwm_G2_TzCh19Isr</SHORT-NAME>
                  <MINIMUM-START-INTERVAL>0.0</MINIMUM-START-INTERVAL>
                  <REENTRANCY-LEVEL>NON-REENTRANT</REENTRANCY-LEVEL>
                  <IMPLEMENTED-ENTRY-REF DEST="BSW-MODULE-ENTRY">/Cdd_Pwm_TI_AM263x/Cdd_Pwm_ModuleEntry/Cdd_Pwm_G2_TzCh19Isr</IMPLEMENTED-ENTRY-REF>
                [!IF "as:modconf('Cdd_Pwm')[1]/CddPwmGeneral/CddPwmTypeofInterruptFunction = 'CDD_PWM_ISR_CAT2'"!][!//
                  <INTERRUPT-CATEGORY>CAT-2</INTERRUPT-CATEGORY>
                [!ELSE!][!//
                  <INTERRUPT-CATEGORY>CAT-1</INTERRUPT-CATEGORY>
                [!ENDIF!][!//
                  <INTERRUPT-SOURCE>Hardware</INTERRUPT-SOURCE>
                </BSW-INTERRUPT-ENTITY>
              [!ENDIF!][!//
              [!IF "num:i($CddChannel) = '1'"!][!//
                <BSW-INTERRUPT-ENTITY UUID="74ef8253-7a8b-4df0-bf05-76c4cf26f448">
                  <SHORT-NAME>Cdd_Pwm_G2_TzCh1Isr</SHORT-NAME>
                  <MINIMUM-START-INTERVAL>0.0</MINIMUM-START-INTERVAL>
                  <REENTRANCY-LEVEL>NON-REENTRANT</REENTRANCY-LEVEL>
                  <IMPLEMENTED-ENTRY-REF DEST="BSW-MODULE-ENTRY">/Cdd_Pwm_TI_AM263x/Cdd_Pwm_ModuleEntry/Cdd_Pwm_G2_TzCh1Isr</IMPLEMENTED-ENTRY-REF>
                [!IF "as:modconf('Cdd_Pwm')[1]/CddPwmGeneral/CddPwmTypeofInterruptFunction = 'CDD_PWM_ISR_CAT2'"!][!//
                  <INTERRUPT-CATEGORY>CAT-2</INTERRUPT-CATEGORY>
                [!ELSE!][!//
                  <INTERRUPT-CATEGORY>CAT-1</INTERRUPT-CATEGORY>
                [!ENDIF!][!//
                  <INTERRUPT-SOURCE>Hardware</INTERRUPT-SOURCE>
                </BSW-INTERRUPT-ENTITY>
              [!ENDIF!][!//
              [!IF "num:i($CddChannel) = '20'"!][!//
                <BSW-INTERRUPT-ENTITY UUID="41f152fc-6587-494f-befc-aee8e840de22">
                  <SHORT-NAME>Cdd_Pwm_G2_TzCh20Isr</SHORT-NAME>
                  <MINIMUM-START-INTERVAL>0.0</MINIMUM-START-INTERVAL>
                  <REENTRANCY-LEVEL>NON-REENTRANT</REENTRANCY-LEVEL>
                  <IMPLEMENTED-ENTRY-REF DEST="BSW-MODULE-ENTRY">/Cdd_Pwm_TI_AM263x/Cdd_Pwm_ModuleEntry/Cdd_Pwm_G2_TzCh20Isr</IMPLEMENTED-ENTRY-REF>
                [!IF "as:modconf('Cdd_Pwm')[1]/CddPwmGeneral/CddPwmTypeofInterruptFunction = 'CDD_PWM_ISR_CAT2'"!][!//
                  <INTERRUPT-CATEGORY>CAT-2</INTERRUPT-CATEGORY>
                [!ELSE!][!//
                  <INTERRUPT-CATEGORY>CAT-1</INTERRUPT-CATEGORY>
                [!ENDIF!][!//
                  <INTERRUPT-SOURCE>Hardware</INTERRUPT-SOURCE>
                </BSW-INTERRUPT-ENTITY>
              [!ENDIF!][!//
              [!IF "num:i($CddChannel) = '21'"!][!//
                <BSW-INTERRUPT-ENTITY UUID="d0374968-6aa0-4bd2-aa74-427f04039d32">
                  <SHORT-NAME>Cdd_Pwm_G2_TzCh21Isr</SHORT-NAME>
                  <MINIMUM-START-INTERVAL>0.0</MINIMUM-START-INTERVAL>
                  <REENTRANCY-LEVEL>NON-REENTRANT</REENTRANCY-LEVEL>
                  <IMPLEMENTED-ENTRY-REF DEST="BSW-MODULE-ENTRY">/Cdd_Pwm_TI_AM263x/Cdd_Pwm_ModuleEntry/Cdd_Pwm_G2_TzCh21Isr</IMPLEMENTED-ENTRY-REF>
                [!IF "as:modconf('Cdd_Pwm')[1]/CddPwmGeneral/CddPwmTypeofInterruptFunction = 'CDD_PWM_ISR_CAT2'"!][!//
                  <INTERRUPT-CATEGORY>CAT-2</INTERRUPT-CATEGORY>
                [!ELSE!][!//
                  <INTERRUPT-CATEGORY>CAT-1</INTERRUPT-CATEGORY>
                [!ENDIF!][!//
                  <INTERRUPT-SOURCE>Hardware</INTERRUPT-SOURCE>
                </BSW-INTERRUPT-ENTITY>
              [!ENDIF!][!//
              [!IF "num:i($CddChannel) = '22'"!][!//
                <BSW-INTERRUPT-ENTITY UUID="3837aabf-bec8-4f2c-83d8-284881c2b452">
                  <SHORT-NAME>Cdd_Pwm_G2_TzCh22Isr</SHORT-NAME>
                  <MINIMUM-START-INTERVAL>0.0</MINIMUM-START-INTERVAL>
                  <REENTRANCY-LEVEL>NON-REENTRANT</REENTRANCY-LEVEL>
                  <IMPLEMENTED-ENTRY-REF DEST="BSW-MODULE-ENTRY">/Cdd_Pwm_TI_AM263x/Cdd_Pwm_ModuleEntry/Cdd_Pwm_G2_TzCh22Isr</IMPLEMENTED-ENTRY-REF>
                [!IF "as:modconf('Cdd_Pwm')[1]/CddPwmGeneral/CddPwmTypeofInterruptFunction = 'CDD_PWM_ISR_CAT2'"!][!//
                  <INTERRUPT-CATEGORY>CAT-2</INTERRUPT-CATEGORY>
                [!ELSE!][!//
                  <INTERRUPT-CATEGORY>CAT-1</INTERRUPT-CATEGORY>
                [!ENDIF!][!//
                  <INTERRUPT-SOURCE>Hardware</INTERRUPT-SOURCE>
                </BSW-INTERRUPT-ENTITY>
              [!ENDIF!][!//
              [!IF "num:i($CddChannel) = '23'"!][!//
                <BSW-INTERRUPT-ENTITY UUID="7889011c-5bf0-491d-8952-902c6b09e588">
                  <SHORT-NAME>Cdd_Pwm_G2_TzCh23Isr</SHORT-NAME>
                  <MINIMUM-START-INTERVAL>0.0</MINIMUM-START-INTERVAL>
                  <REENTRANCY-LEVEL>NON-REENTRANT</REENTRANCY-LEVEL>
                  <IMPLEMENTED-ENTRY-REF DEST="BSW-MODULE-ENTRY">/Cdd_Pwm_TI_AM263x/Cdd_Pwm_ModuleEntry/Cdd_Pwm_G2_TzCh23Isr</IMPLEMENTED-ENTRY-REF>
                [!IF "as:modconf('Cdd_Pwm')[1]/CddPwmGeneral/CddPwmTypeofInterruptFunction = 'CDD_PWM_ISR_CAT2'"!][!//
                  <INTERRUPT-CATEGORY>CAT-2</INTERRUPT-CATEGORY>
                [!ELSE!][!//
                  <INTERRUPT-CATEGORY>CAT-1</INTERRUPT-CATEGORY>
                [!ENDIF!][!//
                  <INTERRUPT-SOURCE>Hardware</INTERRUPT-SOURCE>
                </BSW-INTERRUPT-ENTITY>
              [!ENDIF!][!//
              [!IF "num:i($CddChannel) = '24'"!][!//
                <BSW-INTERRUPT-ENTITY UUID="b31e77a9-0cfa-4183-8a58-7294b25c7f95">
                  <SHORT-NAME>Cdd_Pwm_G2_TzCh24Isr</SHORT-NAME>
                  <MINIMUM-START-INTERVAL>0.0</MINIMUM-START-INTERVAL>
                  <REENTRANCY-LEVEL>NON-REENTRANT</REENTRANCY-LEVEL>
                  <IMPLEMENTED-ENTRY-REF DEST="BSW-MODULE-ENTRY">/Cdd_Pwm_TI_AM263x/Cdd_Pwm_ModuleEntry/Cdd_Pwm_G2_TzCh24Isr</IMPLEMENTED-ENTRY-REF>
                [!IF "as:modconf('Cdd_Pwm')[1]/CddPwmGeneral/CddPwmTypeofInterruptFunction = 'CDD_PWM_ISR_CAT2'"!][!//
                  <INTERRUPT-CATEGORY>CAT-2</INTERRUPT-CATEGORY>
                [!ELSE!][!//
                  <INTERRUPT-CATEGORY>CAT-1</INTERRUPT-CATEGORY>
                [!ENDIF!][!//
                  <INTERRUPT-SOURCE>Hardware</INTERRUPT-SOURCE>
                </BSW-INTERRUPT-ENTITY>
              [!ENDIF!][!//
              [!IF "num:i($CddChannel) = '25'"!][!//
                <BSW-INTERRUPT-ENTITY UUID="f056d6fb-e426-419f-8d1b-95daa9551e73">
                  <SHORT-NAME>Cdd_Pwm_G2_TzCh25Isr</SHORT-NAME>
                  <MINIMUM-START-INTERVAL>0.0</MINIMUM-START-INTERVAL>
                  <REENTRANCY-LEVEL>NON-REENTRANT</REENTRANCY-LEVEL>
                  <IMPLEMENTED-ENTRY-REF DEST="BSW-MODULE-ENTRY">/Cdd_Pwm_TI_AM263x/Cdd_Pwm_ModuleEntry/Cdd_Pwm_G2_TzCh25Isr</IMPLEMENTED-ENTRY-REF>
                [!IF "as:modconf('Cdd_Pwm')[1]/CddPwmGeneral/CddPwmTypeofInterruptFunction = 'CDD_PWM_ISR_CAT2'"!][!//
                  <INTERRUPT-CATEGORY>CAT-2</INTERRUPT-CATEGORY>
                [!ELSE!][!//
                  <INTERRUPT-CATEGORY>CAT-1</INTERRUPT-CATEGORY>
                [!ENDIF!][!//
                  <INTERRUPT-SOURCE>Hardware</INTERRUPT-SOURCE>
                </BSW-INTERRUPT-ENTITY>
              [!ENDIF!][!//
              [!IF "num:i($CddChannel) = '26'"!][!//
                <BSW-INTERRUPT-ENTITY UUID="0e4d73d0-9c64-49df-a146-4271abe06a94">
                  <SHORT-NAME>Cdd_Pwm_G2_TzCh26Isr</SHORT-NAME>
                  <MINIMUM-START-INTERVAL>0.0</MINIMUM-START-INTERVAL>
                  <REENTRANCY-LEVEL>NON-REENTRANT</REENTRANCY-LEVEL>
                  <IMPLEMENTED-ENTRY-REF DEST="BSW-MODULE-ENTRY">/Cdd_Pwm_TI_AM263x/Cdd_Pwm_ModuleEntry/Cdd_Pwm_G2_TzCh26Isr</IMPLEMENTED-ENTRY-REF>
                [!IF "as:modconf('Cdd_Pwm')[1]/CddPwmGeneral/CddPwmTypeofInterruptFunction = 'CDD_PWM_ISR_CAT2'"!][!//
                  <INTERRUPT-CATEGORY>CAT-2</INTERRUPT-CATEGORY>
                [!ELSE!][!//
                  <INTERRUPT-CATEGORY>CAT-1</INTERRUPT-CATEGORY>
                [!ENDIF!][!//
                  <INTERRUPT-SOURCE>Hardware</INTERRUPT-SOURCE>
                </BSW-INTERRUPT-ENTITY>
              [!ENDIF!][!//
              [!IF "num:i($CddChannel) = '27'"!][!//
                <BSW-INTERRUPT-ENTITY UUID="fc6ec32d-66a2-4701-a2ad-f8a0919a5ad2">
                  <SHORT-NAME>Cdd_Pwm_G2_TzCh27Isr</SHORT-NAME>
                  <MINIMUM-START-INTERVAL>0.0</MINIMUM-START-INTERVAL>
                  <REENTRANCY-LEVEL>NON-REENTRANT</REENTRANCY-LEVEL>
                  <IMPLEMENTED-ENTRY-REF DEST="BSW-MODULE-ENTRY">/Cdd_Pwm_TI_AM263x/Cdd_Pwm_ModuleEntry/Cdd_Pwm_G2_TzCh27Isr</IMPLEMENTED-ENTRY-REF>
                [!IF "as:modconf('Cdd_Pwm')[1]/CddPwmGeneral/CddPwmTypeofInterruptFunction = 'CDD_PWM_ISR_CAT2'"!][!//
                  <INTERRUPT-CATEGORY>CAT-2</INTERRUPT-CATEGORY>
                [!ELSE!][!//
                  <INTERRUPT-CATEGORY>CAT-1</INTERRUPT-CATEGORY>
                [!ENDIF!][!//
                  <INTERRUPT-SOURCE>Hardware</INTERRUPT-SOURCE>
                </BSW-INTERRUPT-ENTITY>
              [!ENDIF!][!//
              [!IF "num:i($CddChannel) = '28'"!][!//
                <BSW-INTERRUPT-ENTITY UUID="0433d290-2566-4607-be47-88aa3e78ca13">
                  <SHORT-NAME>Cdd_Pwm_G2_TzCh28Isr</SHORT-NAME>
                  <MINIMUM-START-INTERVAL>0.0</MINIMUM-START-INTERVAL>
                  <REENTRANCY-LEVEL>NON-REENTRANT</REENTRANCY-LEVEL>
                  <IMPLEMENTED-ENTRY-REF DEST="BSW-MODULE-ENTRY">/Cdd_Pwm_TI_AM263x/Cdd_Pwm_ModuleEntry/Cdd_Pwm_G2_TzCh28Isr</IMPLEMENTED-ENTRY-REF>
                [!IF "as:modconf('Cdd_Pwm')[1]/CddPwmGeneral/CddPwmTypeofInterruptFunction = 'CDD_PWM_ISR_CAT2'"!][!//
                  <INTERRUPT-CATEGORY>CAT-2</INTERRUPT-CATEGORY>
                [!ELSE!][!//
                  <INTERRUPT-CATEGORY>CAT-1</INTERRUPT-CATEGORY>
                [!ENDIF!][!//
                  <INTERRUPT-SOURCE>Hardware</INTERRUPT-SOURCE>
                </BSW-INTERRUPT-ENTITY>
              [!ENDIF!][!//
              [!IF "num:i($CddChannel) = '29'"!][!//
                <BSW-INTERRUPT-ENTITY UUID="8b71630b-37e8-4621-a5ea-11590374d7d8">
                  <SHORT-NAME>Cdd_Pwm_G2_TzCh29Isr</SHORT-NAME>
                  <MINIMUM-START-INTERVAL>0.0</MINIMUM-START-INTERVAL>
                  <REENTRANCY-LEVEL>NON-REENTRANT</REENTRANCY-LEVEL>
                  <IMPLEMENTED-ENTRY-REF DEST="BSW-MODULE-ENTRY">/Cdd_Pwm_TI_AM263x/Cdd_Pwm_ModuleEntry/Cdd_Pwm_G2_TzCh29Isr</IMPLEMENTED-ENTRY-REF>
                [!IF "as:modconf('Cdd_Pwm')[1]/CddPwmGeneral/CddPwmTypeofInterruptFunction = 'CDD_PWM_ISR_CAT2'"!][!//
                  <INTERRUPT-CATEGORY>CAT-2</INTERRUPT-CATEGORY>
                [!ELSE!][!//
                  <INTERRUPT-CATEGORY>CAT-1</INTERRUPT-CATEGORY>
                [!ENDIF!][!//
                  <INTERRUPT-SOURCE>Hardware</INTERRUPT-SOURCE>
                </BSW-INTERRUPT-ENTITY>
              [!ENDIF!][!//
              [!IF "num:i($CddChannel) = '2'"!][!//
                <BSW-INTERRUPT-ENTITY UUID="6ab93a39-76c5-4c8f-aa92-3ff5fa008772">
                  <SHORT-NAME>Cdd_Pwm_G2_TzCh2Isr</SHORT-NAME>
                  <MINIMUM-START-INTERVAL>0.0</MINIMUM-START-INTERVAL>
                  <REENTRANCY-LEVEL>NON-REENTRANT</REENTRANCY-LEVEL>
                  <IMPLEMENTED-ENTRY-REF DEST="BSW-MODULE-ENTRY">/Cdd_Pwm_TI_AM263x/Cdd_Pwm_ModuleEntry/Cdd_Pwm_G2_TzCh2Isr</IMPLEMENTED-ENTRY-REF>
                [!IF "as:modconf('Cdd_Pwm')[1]/CddPwmGeneral/CddPwmTypeofInterruptFunction = 'CDD_PWM_ISR_CAT2'"!][!//
                  <INTERRUPT-CATEGORY>CAT-2</INTERRUPT-CATEGORY>
                [!ELSE!][!//
                  <INTERRUPT-CATEGORY>CAT-1</INTERRUPT-CATEGORY>
                [!ENDIF!][!//
                  <INTERRUPT-SOURCE>Hardware</INTERRUPT-SOURCE>
                </BSW-INTERRUPT-ENTITY>
              [!ENDIF!][!//
              [!IF "num:i($CddChannel) = '30'"!][!//
                <BSW-INTERRUPT-ENTITY UUID="2a888667-6dfa-4030-b499-de2ec273884b">
                  <SHORT-NAME>Cdd_Pwm_G2_TzCh30Isr</SHORT-NAME>
                  <MINIMUM-START-INTERVAL>0.0</MINIMUM-START-INTERVAL>
                  <REENTRANCY-LEVEL>NON-REENTRANT</REENTRANCY-LEVEL>
                  <IMPLEMENTED-ENTRY-REF DEST="BSW-MODULE-ENTRY">/Cdd_Pwm_TI_AM263x/Cdd_Pwm_ModuleEntry/Cdd_Pwm_G2_TzCh30Isr</IMPLEMENTED-ENTRY-REF>
                [!IF "as:modconf('Cdd_Pwm')[1]/CddPwmGeneral/CddPwmTypeofInterruptFunction = 'CDD_PWM_ISR_CAT2'"!][!//
                  <INTERRUPT-CATEGORY>CAT-2</INTERRUPT-CATEGORY>
                [!ELSE!][!//
                  <INTERRUPT-CATEGORY>CAT-1</INTERRUPT-CATEGORY>
                [!ENDIF!][!//
                  <INTERRUPT-SOURCE>Hardware</INTERRUPT-SOURCE>
                </BSW-INTERRUPT-ENTITY>
              [!ENDIF!][!//
              [!IF "num:i($CddChannel) = '31'"!][!//
                <BSW-INTERRUPT-ENTITY UUID="625e2c91-e1ff-4e0e-89f2-8e1e43a016b3">
                  <SHORT-NAME>Cdd_Pwm_G2_TzCh31Isr</SHORT-NAME>
                  <MINIMUM-START-INTERVAL>0.0</MINIMUM-START-INTERVAL>
                  <REENTRANCY-LEVEL>NON-REENTRANT</REENTRANCY-LEVEL>
                  <IMPLEMENTED-ENTRY-REF DEST="BSW-MODULE-ENTRY">/Cdd_Pwm_TI_AM263x/Cdd_Pwm_ModuleEntry/Cdd_Pwm_G2_TzCh31Isr</IMPLEMENTED-ENTRY-REF>
                [!IF "as:modconf('Cdd_Pwm')[1]/CddPwmGeneral/CddPwmTypeofInterruptFunction = 'CDD_PWM_ISR_CAT2'"!][!//
                  <INTERRUPT-CATEGORY>CAT-2</INTERRUPT-CATEGORY>
                [!ELSE!][!//
                  <INTERRUPT-CATEGORY>CAT-1</INTERRUPT-CATEGORY>
                [!ENDIF!][!//
                  <INTERRUPT-SOURCE>Hardware</INTERRUPT-SOURCE>
                </BSW-INTERRUPT-ENTITY>
              [!ENDIF!][!//
              [!IF "num:i($CddChannel) = '3'"!][!//
                <BSW-INTERRUPT-ENTITY UUID="20a7ecf4-bdb5-4b0e-8a45-401c713c3a45">
                  <SHORT-NAME>Cdd_Pwm_G2_TzCh3Isr</SHORT-NAME>
                  <MINIMUM-START-INTERVAL>0.0</MINIMUM-START-INTERVAL>
                  <REENTRANCY-LEVEL>NON-REENTRANT</REENTRANCY-LEVEL>
                  <IMPLEMENTED-ENTRY-REF DEST="BSW-MODULE-ENTRY">/Cdd_Pwm_TI_AM263x/Cdd_Pwm_ModuleEntry/Cdd_Pwm_G2_TzCh3Isr</IMPLEMENTED-ENTRY-REF>
                [!IF "as:modconf('Cdd_Pwm')[1]/CddPwmGeneral/CddPwmTypeofInterruptFunction = 'CDD_PWM_ISR_CAT2'"!][!//
                  <INTERRUPT-CATEGORY>CAT-2</INTERRUPT-CATEGORY>
                [!ELSE!][!//
                  <INTERRUPT-CATEGORY>CAT-1</INTERRUPT-CATEGORY>
                [!ENDIF!][!//
                  <INTERRUPT-SOURCE>Hardware</INTERRUPT-SOURCE>
                </BSW-INTERRUPT-ENTITY>
              [!ENDIF!][!//
              [!IF "num:i($CddChannel) = '4'"!][!//
                <BSW-INTERRUPT-ENTITY UUID="b6d65779-ae19-4430-932e-d953e648bacf">
                  <SHORT-NAME>Cdd_Pwm_G2_TzCh4Isr</SHORT-NAME>
                  <MINIMUM-START-INTERVAL>0.0</MINIMUM-START-INTERVAL>
                  <REENTRANCY-LEVEL>NON-REENTRANT</REENTRANCY-LEVEL>
                  <IMPLEMENTED-ENTRY-REF DEST="BSW-MODULE-ENTRY">/Cdd_Pwm_TI_AM263x/Cdd_Pwm_ModuleEntry/Cdd_Pwm_G2_TzCh4Isr</IMPLEMENTED-ENTRY-REF>
                [!IF "as:modconf('Cdd_Pwm')[1]/CddPwmGeneral/CddPwmTypeofInterruptFunction = 'CDD_PWM_ISR_CAT2'"!][!//
                  <INTERRUPT-CATEGORY>CAT-2</INTERRUPT-CATEGORY>
                [!ELSE!][!//
                  <INTERRUPT-CATEGORY>CAT-1</INTERRUPT-CATEGORY>
                [!ENDIF!][!//
                  <INTERRUPT-SOURCE>Hardware</INTERRUPT-SOURCE>
                </BSW-INTERRUPT-ENTITY>
              [!ENDIF!][!//
              [!IF "num:i($CddChannel) = '5'"!][!//
                <BSW-INTERRUPT-ENTITY UUID="bc56cd0e-ec88-4978-a180-c84bdd02b4f3">
                  <SHORT-NAME>Cdd_Pwm_G2_TzCh5Isr</SHORT-NAME>
                  <MINIMUM-START-INTERVAL>0.0</MINIMUM-START-INTERVAL>
                  <REENTRANCY-LEVEL>NON-REENTRANT</REENTRANCY-LEVEL>
                  <IMPLEMENTED-ENTRY-REF DEST="BSW-MODULE-ENTRY">/Cdd_Pwm_TI_AM263x/Cdd_Pwm_ModuleEntry/Cdd_Pwm_G2_TzCh5Isr</IMPLEMENTED-ENTRY-REF>
                [!IF "as:modconf('Cdd_Pwm')[1]/CddPwmGeneral/CddPwmTypeofInterruptFunction = 'CDD_PWM_ISR_CAT2'"!][!//
                  <INTERRUPT-CATEGORY>CAT-2</INTERRUPT-CATEGORY>
                [!ELSE!][!//
                  <INTERRUPT-CATEGORY>CAT-1</INTERRUPT-CATEGORY>
                [!ENDIF!][!//
                  <INTERRUPT-SOURCE>Hardware</INTERRUPT-SOURCE>
                </BSW-INTERRUPT-ENTITY>
              [!ENDIF!][!//
              [!IF "num:i($CddChannel) = '6'"!][!//
                <BSW-INTERRUPT-ENTITY UUID="71abf57b-5ae3-4634-8a7e-6187d9ef9522">
                  <SHORT-NAME>Cdd_Pwm_G2_TzCh6Isr</SHORT-NAME>
                  <MINIMUM-START-INTERVAL>0.0</MINIMUM-START-INTERVAL>
                  <REENTRANCY-LEVEL>NON-REENTRANT</REENTRANCY-LEVEL>
                  <IMPLEMENTED-ENTRY-REF DEST="BSW-MODULE-ENTRY">/Cdd_Pwm_TI_AM263x/Cdd_Pwm_ModuleEntry/Cdd_Pwm_G2_TzCh6Isr</IMPLEMENTED-ENTRY-REF>
                [!IF "as:modconf('Cdd_Pwm')[1]/CddPwmGeneral/CddPwmTypeofInterruptFunction = 'CDD_PWM_ISR_CAT2'"!][!//
                  <INTERRUPT-CATEGORY>CAT-2</INTERRUPT-CATEGORY>
                [!ELSE!][!//
                  <INTERRUPT-CATEGORY>CAT-1</INTERRUPT-CATEGORY>
                [!ENDIF!][!//
                  <INTERRUPT-SOURCE>Hardware</INTERRUPT-SOURCE>
                </BSW-INTERRUPT-ENTITY>
              [!ENDIF!][!//
              [!IF "num:i($CddChannel) = '7'"!][!//
                <BSW-INTERRUPT-ENTITY UUID="9b49031a-eb03-4d64-a8b0-667d0d9ee0f3">
                  <SHORT-NAME>Cdd_Pwm_G2_TzCh7Isr</SHORT-NAME>
                  <MINIMUM-START-INTERVAL>0.0</MINIMUM-START-INTERVAL>
                  <REENTRANCY-LEVEL>NON-REENTRANT</REENTRANCY-LEVEL>
                  <IMPLEMENTED-ENTRY-REF DEST="BSW-MODULE-ENTRY">/Cdd_Pwm_TI_AM263x/Cdd_Pwm_ModuleEntry/Cdd_Pwm_G2_TzCh7Isr</IMPLEMENTED-ENTRY-REF>
                [!IF "as:modconf('Cdd_Pwm')[1]/CddPwmGeneral/CddPwmTypeofInterruptFunction = 'CDD_PWM_ISR_CAT2'"!][!//
                  <INTERRUPT-CATEGORY>CAT-2</INTERRUPT-CATEGORY>
                [!ELSE!][!//
                  <INTERRUPT-CATEGORY>CAT-1</INTERRUPT-CATEGORY>
                [!ENDIF!][!//
                  <INTERRUPT-SOURCE>Hardware</INTERRUPT-SOURCE>
                </BSW-INTERRUPT-ENTITY>
              [!ENDIF!][!//
              [!IF "num:i($CddChannel) = '8'"!][!//
                <BSW-INTERRUPT-ENTITY UUID="b0a33923-527a-4656-9c55-0a131c6c5cde">
                  <SHORT-NAME>Cdd_Pwm_G2_TzCh8Isr</SHORT-NAME>
                  <MINIMUM-START-INTERVAL>0.0</MINIMUM-START-INTERVAL>
                  <REENTRANCY-LEVEL>NON-REENTRANT</REENTRANCY-LEVEL>
                  <IMPLEMENTED-ENTRY-REF DEST="BSW-MODULE-ENTRY">/Cdd_Pwm_TI_AM263x/Cdd_Pwm_ModuleEntry/Cdd_Pwm_G2_TzCh8Isr</IMPLEMENTED-ENTRY-REF>
                [!IF "as:modconf('Cdd_Pwm')[1]/CddPwmGeneral/CddPwmTypeofInterruptFunction = 'CDD_PWM_ISR_CAT2'"!][!//
                  <INTERRUPT-CATEGORY>CAT-2</INTERRUPT-CATEGORY>
                [!ELSE!][!//
                  <INTERRUPT-CATEGORY>CAT-1</INTERRUPT-CATEGORY>
                [!ENDIF!][!//
                  <INTERRUPT-SOURCE>Hardware</INTERRUPT-SOURCE>
                </BSW-INTERRUPT-ENTITY>
              [!ENDIF!][!//
              [!IF "num:i($CddChannel) = '9'"!][!//
                <BSW-INTERRUPT-ENTITY UUID="3d640760-c1e6-4b32-b72d-e12b940ad879">
                  <SHORT-NAME>Cdd_Pwm_G2_TzCh9Isr</SHORT-NAME>
                  <MINIMUM-START-INTERVAL>0.0</MINIMUM-START-INTERVAL>
                  <REENTRANCY-LEVEL>NON-REENTRANT</REENTRANCY-LEVEL>
                  <IMPLEMENTED-ENTRY-REF DEST="BSW-MODULE-ENTRY">/Cdd_Pwm_TI_AM263x/Cdd_Pwm_ModuleEntry/Cdd_Pwm_G2_TzCh9Isr</IMPLEMENTED-ENTRY-REF>
                [!IF "as:modconf('Cdd_Pwm')[1]/CddPwmGeneral/CddPwmTypeofInterruptFunction = 'CDD_PWM_ISR_CAT2'"!][!//
                  <INTERRUPT-CATEGORY>CAT-2</INTERRUPT-CATEGORY>
                [!ELSE!][!//
                  <INTERRUPT-CATEGORY>CAT-1</INTERRUPT-CATEGORY>
                [!ENDIF!][!//
                  <INTERRUPT-SOURCE>Hardware</INTERRUPT-SOURCE>
                </BSW-INTERRUPT-ENTITY>
              [!ENDIF!][!//
              [!ELSE!][!//
              [!IF "num:i($CddChannel) = '0'"!][!//
                <BSW-INTERRUPT-ENTITY UUID="be7a8640-4101-40f7-9065-88a54e459fac">
                  <SHORT-NAME>Cdd_Pwm_G3_Ch0Isr</SHORT-NAME>
                  <MINIMUM-START-INTERVAL>0.0</MINIMUM-START-INTERVAL>
                  <REENTRANCY-LEVEL>NON-REENTRANT</REENTRANCY-LEVEL>
                  <IMPLEMENTED-ENTRY-REF DEST="BSW-MODULE-ENTRY">/Cdd_Pwm_TI_AM263x/Cdd_Pwm_ModuleEntry/Cdd_Pwm_G3_Ch0Isr</IMPLEMENTED-ENTRY-REF>
                [!IF "as:modconf('Cdd_Pwm')[1]/CddPwmGeneral/CddPwmTypeofInterruptFunction = 'CDD_PWM_ISR_CAT2'"!][!//
                  <INTERRUPT-CATEGORY>CAT-2</INTERRUPT-CATEGORY>
                [!ELSE!][!//
                  <INTERRUPT-CATEGORY>CAT-1</INTERRUPT-CATEGORY>
                [!ENDIF!][!//
                  <INTERRUPT-SOURCE>Hardware</INTERRUPT-SOURCE>
                </BSW-INTERRUPT-ENTITY>
              [!ENDIF!][!//
              [!IF "num:i($CddChannel) = '10'"!][!//
                <BSW-INTERRUPT-ENTITY UUID="d26767b3-58ed-45d5-af9d-aa52c1c60361">
                  <SHORT-NAME>Cdd_Pwm_G3_Ch10Isr</SHORT-NAME>
                  <MINIMUM-START-INTERVAL>0.0</MINIMUM-START-INTERVAL>
                  <REENTRANCY-LEVEL>NON-REENTRANT</REENTRANCY-LEVEL>
                  <IMPLEMENTED-ENTRY-REF DEST="BSW-MODULE-ENTRY">/Cdd_Pwm_TI_AM263x/Cdd_Pwm_ModuleEntry/Cdd_Pwm_G3_Ch10Isr</IMPLEMENTED-ENTRY-REF>
                [!IF "as:modconf('Cdd_Pwm')[1]/CddPwmGeneral/CddPwmTypeofInterruptFunction = 'CDD_PWM_ISR_CAT2'"!][!//
                  <INTERRUPT-CATEGORY>CAT-2</INTERRUPT-CATEGORY>
                [!ELSE!][!//
                  <INTERRUPT-CATEGORY>CAT-1</INTERRUPT-CATEGORY>
                [!ENDIF!][!//
                  <INTERRUPT-SOURCE>Hardware</INTERRUPT-SOURCE>
                </BSW-INTERRUPT-ENTITY>
              [!ENDIF!][!//
              [!IF "num:i($CddChannel) = '11'"!][!//
                <BSW-INTERRUPT-ENTITY UUID="1575610b-3f4e-4c28-9c38-8bf975f5bb39">
                  <SHORT-NAME>Cdd_Pwm_G3_Ch11Isr</SHORT-NAME>
                  <MINIMUM-START-INTERVAL>0.0</MINIMUM-START-INTERVAL>
                  <REENTRANCY-LEVEL>NON-REENTRANT</REENTRANCY-LEVEL>
                  <IMPLEMENTED-ENTRY-REF DEST="BSW-MODULE-ENTRY">/Cdd_Pwm_TI_AM263x/Cdd_Pwm_ModuleEntry/Cdd_Pwm_G3_Ch11Isr</IMPLEMENTED-ENTRY-REF>
                [!IF "as:modconf('Cdd_Pwm')[1]/CddPwmGeneral/CddPwmTypeofInterruptFunction = 'CDD_PWM_ISR_CAT2'"!][!//
                  <INTERRUPT-CATEGORY>CAT-2</INTERRUPT-CATEGORY>
                [!ELSE!][!//
                  <INTERRUPT-CATEGORY>CAT-1</INTERRUPT-CATEGORY>
                [!ENDIF!][!//
                  <INTERRUPT-SOURCE>Hardware</INTERRUPT-SOURCE>
                </BSW-INTERRUPT-ENTITY>
              [!ENDIF!][!//
              [!IF "num:i($CddChannel) = '12'"!][!//
                <BSW-INTERRUPT-ENTITY UUID="c229b2a9-fa63-4b12-be6e-65ca9eb76b9a">
                  <SHORT-NAME>Cdd_Pwm_G3_Ch12Isr</SHORT-NAME>
                  <MINIMUM-START-INTERVAL>0.0</MINIMUM-START-INTERVAL>
                  <REENTRANCY-LEVEL>NON-REENTRANT</REENTRANCY-LEVEL>
                  <IMPLEMENTED-ENTRY-REF DEST="BSW-MODULE-ENTRY">/Cdd_Pwm_TI_AM263x/Cdd_Pwm_ModuleEntry/Cdd_Pwm_G3_Ch12Isr</IMPLEMENTED-ENTRY-REF>
                [!IF "as:modconf('Cdd_Pwm')[1]/CddPwmGeneral/CddPwmTypeofInterruptFunction = 'CDD_PWM_ISR_CAT2'"!][!//
                  <INTERRUPT-CATEGORY>CAT-2</INTERRUPT-CATEGORY>
                [!ELSE!][!//
                  <INTERRUPT-CATEGORY>CAT-1</INTERRUPT-CATEGORY>
                [!ENDIF!][!//
                  <INTERRUPT-SOURCE>Hardware</INTERRUPT-SOURCE>
                </BSW-INTERRUPT-ENTITY>
              [!ENDIF!][!//
              [!IF "num:i($CddChannel) = '13'"!][!//
                <BSW-INTERRUPT-ENTITY UUID="f5d72c1d-4109-4b0b-bdee-94de0bfbb870">
                  <SHORT-NAME>Cdd_Pwm_G3_Ch13Isr</SHORT-NAME>
                  <MINIMUM-START-INTERVAL>0.0</MINIMUM-START-INTERVAL>
                  <REENTRANCY-LEVEL>NON-REENTRANT</REENTRANCY-LEVEL>
                  <IMPLEMENTED-ENTRY-REF DEST="BSW-MODULE-ENTRY">/Cdd_Pwm_TI_AM263x/Cdd_Pwm_ModuleEntry/Cdd_Pwm_G3_Ch13Isr</IMPLEMENTED-ENTRY-REF>
                [!IF "as:modconf('Cdd_Pwm')[1]/CddPwmGeneral/CddPwmTypeofInterruptFunction = 'CDD_PWM_ISR_CAT2'"!][!//
                  <INTERRUPT-CATEGORY>CAT-2</INTERRUPT-CATEGORY>
                [!ELSE!][!//
                  <INTERRUPT-CATEGORY>CAT-1</INTERRUPT-CATEGORY>
                [!ENDIF!][!//
                  <INTERRUPT-SOURCE>Hardware</INTERRUPT-SOURCE>
                </BSW-INTERRUPT-ENTITY>
              [!ENDIF!][!//
              [!IF "num:i($CddChannel) = '14'"!][!//
                <BSW-INTERRUPT-ENTITY UUID="c374f757-bdf5-4951-8ede-706afb18d42e">
                  <SHORT-NAME>Cdd_Pwm_G3_Ch14Isr</SHORT-NAME>
                  <MINIMUM-START-INTERVAL>0.0</MINIMUM-START-INTERVAL>
                  <REENTRANCY-LEVEL>NON-REENTRANT</REENTRANCY-LEVEL>
                  <IMPLEMENTED-ENTRY-REF DEST="BSW-MODULE-ENTRY">/Cdd_Pwm_TI_AM263x/Cdd_Pwm_ModuleEntry/Cdd_Pwm_G3_Ch14Isr</IMPLEMENTED-ENTRY-REF>
                [!IF "as:modconf('Cdd_Pwm')[1]/CddPwmGeneral/CddPwmTypeofInterruptFunction = 'CDD_PWM_ISR_CAT2'"!][!//
                  <INTERRUPT-CATEGORY>CAT-2</INTERRUPT-CATEGORY>
                [!ELSE!][!//
                  <INTERRUPT-CATEGORY>CAT-1</INTERRUPT-CATEGORY>
                [!ENDIF!][!//
                  <INTERRUPT-SOURCE>Hardware</INTERRUPT-SOURCE>
                </BSW-INTERRUPT-ENTITY>
              [!ENDIF!][!//
              [!IF "num:i($CddChannel) = '15'"!][!//
                <BSW-INTERRUPT-ENTITY UUID="6f673e24-0b44-4878-af3f-524fcba0bcdd">
                  <SHORT-NAME>Cdd_Pwm_G3_Ch15Isr</SHORT-NAME>
                  <MINIMUM-START-INTERVAL>0.0</MINIMUM-START-INTERVAL>
                  <REENTRANCY-LEVEL>NON-REENTRANT</REENTRANCY-LEVEL>
                  <IMPLEMENTED-ENTRY-REF DEST="BSW-MODULE-ENTRY">/Cdd_Pwm_TI_AM263x/Cdd_Pwm_ModuleEntry/Cdd_Pwm_G3_Ch15Isr</IMPLEMENTED-ENTRY-REF>
                [!IF "as:modconf('Cdd_Pwm')[1]/CddPwmGeneral/CddPwmTypeofInterruptFunction = 'CDD_PWM_ISR_CAT2'"!][!//
                  <INTERRUPT-CATEGORY>CAT-2</INTERRUPT-CATEGORY>
                [!ELSE!][!//
                  <INTERRUPT-CATEGORY>CAT-1</INTERRUPT-CATEGORY>
                [!ENDIF!][!//
                  <INTERRUPT-SOURCE>Hardware</INTERRUPT-SOURCE>
                </BSW-INTERRUPT-ENTITY>
              [!ENDIF!][!//
              [!IF "num:i($CddChannel) = '16'"!][!//
                <BSW-INTERRUPT-ENTITY UUID="d8ad739b-5e33-479a-a722-209a699f2b90">
                  <SHORT-NAME>Cdd_Pwm_G3_Ch16Isr</SHORT-NAME>
                  <MINIMUM-START-INTERVAL>0.0</MINIMUM-START-INTERVAL>
                  <REENTRANCY-LEVEL>NON-REENTRANT</REENTRANCY-LEVEL>
                  <IMPLEMENTED-ENTRY-REF DEST="BSW-MODULE-ENTRY">/Cdd_Pwm_TI_AM263x/Cdd_Pwm_ModuleEntry/Cdd_Pwm_G3_Ch16Isr</IMPLEMENTED-ENTRY-REF>
                [!IF "as:modconf('Cdd_Pwm')[1]/CddPwmGeneral/CddPwmTypeofInterruptFunction = 'CDD_PWM_ISR_CAT2'"!][!//
                  <INTERRUPT-CATEGORY>CAT-2</INTERRUPT-CATEGORY>
                [!ELSE!][!//
                  <INTERRUPT-CATEGORY>CAT-1</INTERRUPT-CATEGORY>
                [!ENDIF!][!//
                  <INTERRUPT-SOURCE>Hardware</INTERRUPT-SOURCE>
                </BSW-INTERRUPT-ENTITY>
              [!ENDIF!][!//
              [!IF "num:i($CddChannel) = '17'"!][!//
                <BSW-INTERRUPT-ENTITY UUID="31b1838f-17d3-410f-98de-f915c49ccad1">
                  <SHORT-NAME>Cdd_Pwm_G3_Ch17Isr</SHORT-NAME>
                  <MINIMUM-START-INTERVAL>0.0</MINIMUM-START-INTERVAL>
                  <REENTRANCY-LEVEL>NON-REENTRANT</REENTRANCY-LEVEL>
                  <IMPLEMENTED-ENTRY-REF DEST="BSW-MODULE-ENTRY">/Cdd_Pwm_TI_AM263x/Cdd_Pwm_ModuleEntry/Cdd_Pwm_G3_Ch17Isr</IMPLEMENTED-ENTRY-REF>
                [!IF "as:modconf('Cdd_Pwm')[1]/CddPwmGeneral/CddPwmTypeofInterruptFunction = 'CDD_PWM_ISR_CAT2'"!][!//
                  <INTERRUPT-CATEGORY>CAT-2</INTERRUPT-CATEGORY>
                [!ELSE!][!//
                  <INTERRUPT-CATEGORY>CAT-1</INTERRUPT-CATEGORY>
                [!ENDIF!][!//
                  <INTERRUPT-SOURCE>Hardware</INTERRUPT-SOURCE>
                </BSW-INTERRUPT-ENTITY>
              [!ENDIF!][!//
              [!IF "num:i($CddChannel) = '18'"!][!//
                <BSW-INTERRUPT-ENTITY UUID="96614e11-0495-498a-bef1-0c6a542fc60d">
                  <SHORT-NAME>Cdd_Pwm_G3_Ch18Isr</SHORT-NAME>
                  <MINIMUM-START-INTERVAL>0.0</MINIMUM-START-INTERVAL>
                  <REENTRANCY-LEVEL>NON-REENTRANT</REENTRANCY-LEVEL>
                  <IMPLEMENTED-ENTRY-REF DEST="BSW-MODULE-ENTRY">/Cdd_Pwm_TI_AM263x/Cdd_Pwm_ModuleEntry/Cdd_Pwm_G3_Ch18Isr</IMPLEMENTED-ENTRY-REF>
                [!IF "as:modconf('Cdd_Pwm')[1]/CddPwmGeneral/CddPwmTypeofInterruptFunction = 'CDD_PWM_ISR_CAT2'"!][!//
                  <INTERRUPT-CATEGORY>CAT-2</INTERRUPT-CATEGORY>
                [!ELSE!][!//
                  <INTERRUPT-CATEGORY>CAT-1</INTERRUPT-CATEGORY>
                [!ENDIF!][!//
                  <INTERRUPT-SOURCE>Hardware</INTERRUPT-SOURCE>
                </BSW-INTERRUPT-ENTITY>
              [!ENDIF!][!//
              [!IF "num:i($CddChannel) = '19'"!][!//
                <BSW-INTERRUPT-ENTITY UUID="b8f4777c-76d3-4648-a597-0c17f48a975f">
                  <SHORT-NAME>Cdd_Pwm_G3_Ch19Isr</SHORT-NAME>
                  <MINIMUM-START-INTERVAL>0.0</MINIMUM-START-INTERVAL>
                  <REENTRANCY-LEVEL>NON-REENTRANT</REENTRANCY-LEVEL>
                  <IMPLEMENTED-ENTRY-REF DEST="BSW-MODULE-ENTRY">/Cdd_Pwm_TI_AM263x/Cdd_Pwm_ModuleEntry/Cdd_Pwm_G3_Ch19Isr</IMPLEMENTED-ENTRY-REF>
                [!IF "as:modconf('Cdd_Pwm')[1]/CddPwmGeneral/CddPwmTypeofInterruptFunction = 'CDD_PWM_ISR_CAT2'"!][!//
                  <INTERRUPT-CATEGORY>CAT-2</INTERRUPT-CATEGORY>
                [!ELSE!][!//
                  <INTERRUPT-CATEGORY>CAT-1</INTERRUPT-CATEGORY>
                [!ENDIF!][!//
                  <INTERRUPT-SOURCE>Hardware</INTERRUPT-SOURCE>
                </BSW-INTERRUPT-ENTITY>
              [!ENDIF!][!//
              [!IF "num:i($CddChannel) = '1'"!][!//
                <BSW-INTERRUPT-ENTITY UUID="3deb0e35-5515-42de-9a65-25f21e43b60a">
                  <SHORT-NAME>Cdd_Pwm_G3_Ch1Isr</SHORT-NAME>
                  <MINIMUM-START-INTERVAL>0.0</MINIMUM-START-INTERVAL>
                  <REENTRANCY-LEVEL>NON-REENTRANT</REENTRANCY-LEVEL>
                  <IMPLEMENTED-ENTRY-REF DEST="BSW-MODULE-ENTRY">/Cdd_Pwm_TI_AM263x/Cdd_Pwm_ModuleEntry/Cdd_Pwm_G3_Ch1Isr</IMPLEMENTED-ENTRY-REF>
                [!IF "as:modconf('Cdd_Pwm')[1]/CddPwmGeneral/CddPwmTypeofInterruptFunction = 'CDD_PWM_ISR_CAT2'"!][!//
                  <INTERRUPT-CATEGORY>CAT-2</INTERRUPT-CATEGORY>
                [!ELSE!][!//
                  <INTERRUPT-CATEGORY>CAT-1</INTERRUPT-CATEGORY>
                [!ENDIF!][!//
                  <INTERRUPT-SOURCE>Hardware</INTERRUPT-SOURCE>
                </BSW-INTERRUPT-ENTITY>
              [!ENDIF!][!//
              [!IF "num:i($CddChannel) = '20'"!][!//
                <BSW-INTERRUPT-ENTITY UUID="48252684-68ab-4d2d-ac92-1e05f5cfdcc7">
                  <SHORT-NAME>Cdd_Pwm_G3_Ch20Isr</SHORT-NAME>
                  <MINIMUM-START-INTERVAL>0.0</MINIMUM-START-INTERVAL>
                  <REENTRANCY-LEVEL>NON-REENTRANT</REENTRANCY-LEVEL>
                  <IMPLEMENTED-ENTRY-REF DEST="BSW-MODULE-ENTRY">/Cdd_Pwm_TI_AM263x/Cdd_Pwm_ModuleEntry/Cdd_Pwm_G3_Ch20Isr</IMPLEMENTED-ENTRY-REF>
                [!IF "as:modconf('Cdd_Pwm')[1]/CddPwmGeneral/CddPwmTypeofInterruptFunction = 'CDD_PWM_ISR_CAT2'"!][!//
                  <INTERRUPT-CATEGORY>CAT-2</INTERRUPT-CATEGORY>
                [!ELSE!][!//
                  <INTERRUPT-CATEGORY>CAT-1</INTERRUPT-CATEGORY>
                [!ENDIF!][!//
                  <INTERRUPT-SOURCE>Hardware</INTERRUPT-SOURCE>
                </BSW-INTERRUPT-ENTITY>
              [!ENDIF!][!//
              [!IF "num:i($CddChannel) = '21'"!][!//
                <BSW-INTERRUPT-ENTITY UUID="64599e22-6668-4116-972f-dfb5be743fe5">
                  <SHORT-NAME>Cdd_Pwm_G3_Ch21Isr</SHORT-NAME>
                  <MINIMUM-START-INTERVAL>0.0</MINIMUM-START-INTERVAL>
                  <REENTRANCY-LEVEL>NON-REENTRANT</REENTRANCY-LEVEL>
                  <IMPLEMENTED-ENTRY-REF DEST="BSW-MODULE-ENTRY">/Cdd_Pwm_TI_AM263x/Cdd_Pwm_ModuleEntry/Cdd_Pwm_G3_Ch21Isr</IMPLEMENTED-ENTRY-REF>
                [!IF "as:modconf('Cdd_Pwm')[1]/CddPwmGeneral/CddPwmTypeofInterruptFunction = 'CDD_PWM_ISR_CAT2'"!][!//
                  <INTERRUPT-CATEGORY>CAT-2</INTERRUPT-CATEGORY>
                [!ELSE!][!//
                  <INTERRUPT-CATEGORY>CAT-1</INTERRUPT-CATEGORY>
                [!ENDIF!][!//
                  <INTERRUPT-SOURCE>Hardware</INTERRUPT-SOURCE>
                </BSW-INTERRUPT-ENTITY>
              [!ENDIF!][!//
              [!IF "num:i($CddChannel) = '22'"!][!//
                <BSW-INTERRUPT-ENTITY UUID="9257aa92-b397-45ef-a98a-0d01f38f8b29">
                  <SHORT-NAME>Cdd_Pwm_G3_Ch22Isr</SHORT-NAME>
                  <MINIMUM-START-INTERVAL>0.0</MINIMUM-START-INTERVAL>
                  <REENTRANCY-LEVEL>NON-REENTRANT</REENTRANCY-LEVEL>
                  <IMPLEMENTED-ENTRY-REF DEST="BSW-MODULE-ENTRY">/Cdd_Pwm_TI_AM263x/Cdd_Pwm_ModuleEntry/Cdd_Pwm_G3_Ch22Isr</IMPLEMENTED-ENTRY-REF>
                [!IF "as:modconf('Cdd_Pwm')[1]/CddPwmGeneral/CddPwmTypeofInterruptFunction = 'CDD_PWM_ISR_CAT2'"!][!//
                  <INTERRUPT-CATEGORY>CAT-2</INTERRUPT-CATEGORY>
                [!ELSE!][!//
                  <INTERRUPT-CATEGORY>CAT-1</INTERRUPT-CATEGORY>
                [!ENDIF!][!//
                  <INTERRUPT-SOURCE>Hardware</INTERRUPT-SOURCE>
                </BSW-INTERRUPT-ENTITY>
              [!ENDIF!][!//
              [!IF "num:i($CddChannel) = '23'"!][!//
                <BSW-INTERRUPT-ENTITY UUID="f02ec89e-37e6-4ae6-87ed-507e9958feb1">
                  <SHORT-NAME>Cdd_Pwm_G3_Ch23Isr</SHORT-NAME>
                  <MINIMUM-START-INTERVAL>0.0</MINIMUM-START-INTERVAL>
                  <REENTRANCY-LEVEL>NON-REENTRANT</REENTRANCY-LEVEL>
                  <IMPLEMENTED-ENTRY-REF DEST="BSW-MODULE-ENTRY">/Cdd_Pwm_TI_AM263x/Cdd_Pwm_ModuleEntry/Cdd_Pwm_G3_Ch23Isr</IMPLEMENTED-ENTRY-REF>
                [!IF "as:modconf('Cdd_Pwm')[1]/CddPwmGeneral/CddPwmTypeofInterruptFunction = 'CDD_PWM_ISR_CAT2'"!][!//
                  <INTERRUPT-CATEGORY>CAT-2</INTERRUPT-CATEGORY>
                [!ELSE!][!//
                  <INTERRUPT-CATEGORY>CAT-1</INTERRUPT-CATEGORY>
                [!ENDIF!][!//
                  <INTERRUPT-SOURCE>Hardware</INTERRUPT-SOURCE>
                </BSW-INTERRUPT-ENTITY>
              [!ENDIF!][!//
              [!IF "num:i($CddChannel) = '24'"!][!//
                <BSW-INTERRUPT-ENTITY UUID="8cb63b3a-c858-4ce7-aa73-bf8d91c336b1">
                  <SHORT-NAME>Cdd_Pwm_G3_Ch24Isr</SHORT-NAME>
                  <MINIMUM-START-INTERVAL>0.0</MINIMUM-START-INTERVAL>
                  <REENTRANCY-LEVEL>NON-REENTRANT</REENTRANCY-LEVEL>
                  <IMPLEMENTED-ENTRY-REF DEST="BSW-MODULE-ENTRY">/Cdd_Pwm_TI_AM263x/Cdd_Pwm_ModuleEntry/Cdd_Pwm_G3_Ch24Isr</IMPLEMENTED-ENTRY-REF>
                [!IF "as:modconf('Cdd_Pwm')[1]/CddPwmGeneral/CddPwmTypeofInterruptFunction = 'CDD_PWM_ISR_CAT2'"!][!//
                  <INTERRUPT-CATEGORY>CAT-2</INTERRUPT-CATEGORY>
                [!ELSE!][!//
                  <INTERRUPT-CATEGORY>CAT-1</INTERRUPT-CATEGORY>
                [!ENDIF!][!//
                  <INTERRUPT-SOURCE>Hardware</INTERRUPT-SOURCE>
                </BSW-INTERRUPT-ENTITY>
              [!ENDIF!][!//
              [!IF "num:i($CddChannel) = '25'"!][!//
                <BSW-INTERRUPT-ENTITY UUID="391cdb4a-b9cd-4d6e-986c-f4c328d51daf">
                  <SHORT-NAME>Cdd_Pwm_G3_Ch25Isr</SHORT-NAME>
                  <MINIMUM-START-INTERVAL>0.0</MINIMUM-START-INTERVAL>
                  <REENTRANCY-LEVEL>NON-REENTRANT</REENTRANCY-LEVEL>
                  <IMPLEMENTED-ENTRY-REF DEST="BSW-MODULE-ENTRY">/Cdd_Pwm_TI_AM263x/Cdd_Pwm_ModuleEntry/Cdd_Pwm_G3_Ch25Isr</IMPLEMENTED-ENTRY-REF>
                [!IF "as:modconf('Cdd_Pwm')[1]/CddPwmGeneral/CddPwmTypeofInterruptFunction = 'CDD_PWM_ISR_CAT2'"!][!//
                  <INTERRUPT-CATEGORY>CAT-2</INTERRUPT-CATEGORY>
                [!ELSE!][!//
                  <INTERRUPT-CATEGORY>CAT-1</INTERRUPT-CATEGORY>
                [!ENDIF!][!//
                  <INTERRUPT-SOURCE>Hardware</INTERRUPT-SOURCE>
                </BSW-INTERRUPT-ENTITY>
              [!ENDIF!][!//
              [!IF "num:i($CddChannel) = '26'"!][!//
                <BSW-INTERRUPT-ENTITY UUID="d1a4ecba-0797-41fe-b3b6-ad304442fc7b">
                  <SHORT-NAME>Cdd_Pwm_G3_Ch26Isr</SHORT-NAME>
                  <MINIMUM-START-INTERVAL>0.0</MINIMUM-START-INTERVAL>
                  <REENTRANCY-LEVEL>NON-REENTRANT</REENTRANCY-LEVEL>
                  <IMPLEMENTED-ENTRY-REF DEST="BSW-MODULE-ENTRY">/Cdd_Pwm_TI_AM263x/Cdd_Pwm_ModuleEntry/Cdd_Pwm_G3_Ch26Isr</IMPLEMENTED-ENTRY-REF>
                [!IF "as:modconf('Cdd_Pwm')[1]/CddPwmGeneral/CddPwmTypeofInterruptFunction = 'CDD_PWM_ISR_CAT2'"!][!//
                  <INTERRUPT-CATEGORY>CAT-2</INTERRUPT-CATEGORY>
                [!ELSE!][!//
                  <INTERRUPT-CATEGORY>CAT-1</INTERRUPT-CATEGORY>
                [!ENDIF!][!//
                  <INTERRUPT-SOURCE>Hardware</INTERRUPT-SOURCE>
                </BSW-INTERRUPT-ENTITY>
              [!ENDIF!][!//
              [!IF "num:i($CddChannel) = '27'"!][!//
                <BSW-INTERRUPT-ENTITY UUID="4807aa6e-ff56-4fb6-af40-18325e202c7b">
                  <SHORT-NAME>Cdd_Pwm_G3_Ch27Isr</SHORT-NAME>
                  <MINIMUM-START-INTERVAL>0.0</MINIMUM-START-INTERVAL>
                  <REENTRANCY-LEVEL>NON-REENTRANT</REENTRANCY-LEVEL>
                  <IMPLEMENTED-ENTRY-REF DEST="BSW-MODULE-ENTRY">/Cdd_Pwm_TI_AM263x/Cdd_Pwm_ModuleEntry/Cdd_Pwm_G3_Ch27Isr</IMPLEMENTED-ENTRY-REF>
                [!IF "as:modconf('Cdd_Pwm')[1]/CddPwmGeneral/CddPwmTypeofInterruptFunction = 'CDD_PWM_ISR_CAT2'"!][!//
                  <INTERRUPT-CATEGORY>CAT-2</INTERRUPT-CATEGORY>
                [!ELSE!][!//
                  <INTERRUPT-CATEGORY>CAT-1</INTERRUPT-CATEGORY>
                [!ENDIF!][!//
                  <INTERRUPT-SOURCE>Hardware</INTERRUPT-SOURCE>
                </BSW-INTERRUPT-ENTITY>
              [!ENDIF!][!//
              [!IF "num:i($CddChannel) = '28'"!][!//
                <BSW-INTERRUPT-ENTITY UUID="dbf80bde-1a3e-42ca-aac7-5895db6c5d59">
                  <SHORT-NAME>Cdd_Pwm_G3_Ch28Isr</SHORT-NAME>
                  <MINIMUM-START-INTERVAL>0.0</MINIMUM-START-INTERVAL>
                  <REENTRANCY-LEVEL>NON-REENTRANT</REENTRANCY-LEVEL>
                  <IMPLEMENTED-ENTRY-REF DEST="BSW-MODULE-ENTRY">/Cdd_Pwm_TI_AM263x/Cdd_Pwm_ModuleEntry/Cdd_Pwm_G3_Ch28Isr</IMPLEMENTED-ENTRY-REF>
                [!IF "as:modconf('Cdd_Pwm')[1]/CddPwmGeneral/CddPwmTypeofInterruptFunction = 'CDD_PWM_ISR_CAT2'"!][!//
                  <INTERRUPT-CATEGORY>CAT-2</INTERRUPT-CATEGORY>
                [!ELSE!][!//
                  <INTERRUPT-CATEGORY>CAT-1</INTERRUPT-CATEGORY>
                [!ENDIF!][!//
                  <INTERRUPT-SOURCE>Hardware</INTERRUPT-SOURCE>
                </BSW-INTERRUPT-ENTITY>
              [!ENDIF!][!//
              [!IF "num:i($CddChannel) = '29'"!][!//
                <BSW-INTERRUPT-ENTITY UUID="eb25a2f4-a858-406b-8daa-c54bf5f8f86b">
                  <SHORT-NAME>Cdd_Pwm_G3_Ch29Isr</SHORT-NAME>
                  <MINIMUM-START-INTERVAL>0.0</MINIMUM-START-INTERVAL>
                  <REENTRANCY-LEVEL>NON-REENTRANT</REENTRANCY-LEVEL>
                  <IMPLEMENTED-ENTRY-REF DEST="BSW-MODULE-ENTRY">/Cdd_Pwm_TI_AM263x/Cdd_Pwm_ModuleEntry/Cdd_Pwm_G3_Ch29Isr</IMPLEMENTED-ENTRY-REF>
                [!IF "as:modconf('Cdd_Pwm')[1]/CddPwmGeneral/CddPwmTypeofInterruptFunction = 'CDD_PWM_ISR_CAT2'"!][!//
                  <INTERRUPT-CATEGORY>CAT-2</INTERRUPT-CATEGORY>
                [!ELSE!][!//
                  <INTERRUPT-CATEGORY>CAT-1</INTERRUPT-CATEGORY>
                [!ENDIF!][!//
                  <INTERRUPT-SOURCE>Hardware</INTERRUPT-SOURCE>
                </BSW-INTERRUPT-ENTITY>
              [!ENDIF!][!//
              [!IF "num:i($CddChannel) = '2'"!][!//
                <BSW-INTERRUPT-ENTITY UUID="d395c9b8-91e3-481d-9a29-2a31b6fd1148">
                  <SHORT-NAME>Cdd_Pwm_G3_Ch2Isr</SHORT-NAME>
                  <MINIMUM-START-INTERVAL>0.0</MINIMUM-START-INTERVAL>
                  <REENTRANCY-LEVEL>NON-REENTRANT</REENTRANCY-LEVEL>
                  <IMPLEMENTED-ENTRY-REF DEST="BSW-MODULE-ENTRY">/Cdd_Pwm_TI_AM263x/Cdd_Pwm_ModuleEntry/Cdd_Pwm_G3_Ch2Isr</IMPLEMENTED-ENTRY-REF>
                [!IF "as:modconf('Cdd_Pwm')[1]/CddPwmGeneral/CddPwmTypeofInterruptFunction = 'CDD_PWM_ISR_CAT2'"!][!//
                  <INTERRUPT-CATEGORY>CAT-2</INTERRUPT-CATEGORY>
                [!ELSE!][!//
                  <INTERRUPT-CATEGORY>CAT-1</INTERRUPT-CATEGORY>
                [!ENDIF!][!//
                  <INTERRUPT-SOURCE>Hardware</INTERRUPT-SOURCE>
                </BSW-INTERRUPT-ENTITY>
              [!ENDIF!][!//
              [!IF "num:i($CddChannel) = '30'"!][!//
                <BSW-INTERRUPT-ENTITY UUID="bed5c7e0-25cb-4403-a149-75634c8396fb">
                  <SHORT-NAME>Cdd_Pwm_G3_Ch30Isr</SHORT-NAME>
                  <MINIMUM-START-INTERVAL>0.0</MINIMUM-START-INTERVAL>
                  <REENTRANCY-LEVEL>NON-REENTRANT</REENTRANCY-LEVEL>
                  <IMPLEMENTED-ENTRY-REF DEST="BSW-MODULE-ENTRY">/Cdd_Pwm_TI_AM263x/Cdd_Pwm_ModuleEntry/Cdd_Pwm_G3_Ch30Isr</IMPLEMENTED-ENTRY-REF>
                [!IF "as:modconf('Cdd_Pwm')[1]/CddPwmGeneral/CddPwmTypeofInterruptFunction = 'CDD_PWM_ISR_CAT2'"!][!//
                  <INTERRUPT-CATEGORY>CAT-2</INTERRUPT-CATEGORY>
                [!ELSE!][!//
                  <INTERRUPT-CATEGORY>CAT-1</INTERRUPT-CATEGORY>
                [!ENDIF!][!//
                  <INTERRUPT-SOURCE>Hardware</INTERRUPT-SOURCE>
                </BSW-INTERRUPT-ENTITY>
              [!ENDIF!][!//
              [!IF "num:i($CddChannel) = '31'"!][!//
                <BSW-INTERRUPT-ENTITY UUID="15a4cfcf-c777-4423-a9a6-3edae4714c17">
                  <SHORT-NAME>Cdd_Pwm_G3_Ch31Isr</SHORT-NAME>
                  <MINIMUM-START-INTERVAL>0.0</MINIMUM-START-INTERVAL>
                  <REENTRANCY-LEVEL>NON-REENTRANT</REENTRANCY-LEVEL>
                  <IMPLEMENTED-ENTRY-REF DEST="BSW-MODULE-ENTRY">/Cdd_Pwm_TI_AM263x/Cdd_Pwm_ModuleEntry/Cdd_Pwm_G3_Ch31Isr</IMPLEMENTED-ENTRY-REF>
                [!IF "as:modconf('Cdd_Pwm')[1]/CddPwmGeneral/CddPwmTypeofInterruptFunction = 'CDD_PWM_ISR_CAT2'"!][!//
                  <INTERRUPT-CATEGORY>CAT-2</INTERRUPT-CATEGORY>
                [!ELSE!][!//
                  <INTERRUPT-CATEGORY>CAT-1</INTERRUPT-CATEGORY>
                [!ENDIF!][!//
                  <INTERRUPT-SOURCE>Hardware</INTERRUPT-SOURCE>
                </BSW-INTERRUPT-ENTITY>
              [!ENDIF!][!//
              [!IF "num:i($CddChannel) = '3'"!][!//
                <BSW-INTERRUPT-ENTITY UUID="77faf35a-0a78-44f5-98ab-db7492b09930">
                  <SHORT-NAME>Cdd_Pwm_G3_Ch3Isr</SHORT-NAME>
                  <MINIMUM-START-INTERVAL>0.0</MINIMUM-START-INTERVAL>
                  <REENTRANCY-LEVEL>NON-REENTRANT</REENTRANCY-LEVEL>
                  <IMPLEMENTED-ENTRY-REF DEST="BSW-MODULE-ENTRY">/Cdd_Pwm_TI_AM263x/Cdd_Pwm_ModuleEntry/Cdd_Pwm_G3_Ch3Isr</IMPLEMENTED-ENTRY-REF>
                [!IF "as:modconf('Cdd_Pwm')[1]/CddPwmGeneral/CddPwmTypeofInterruptFunction = 'CDD_PWM_ISR_CAT2'"!][!//
                  <INTERRUPT-CATEGORY>CAT-2</INTERRUPT-CATEGORY>
                [!ELSE!][!//
                  <INTERRUPT-CATEGORY>CAT-1</INTERRUPT-CATEGORY>
                [!ENDIF!][!//
                  <INTERRUPT-SOURCE>Hardware</INTERRUPT-SOURCE>
                </BSW-INTERRUPT-ENTITY>
              [!ENDIF!][!//
              [!IF "num:i($CddChannel) = '4'"!][!//
                <BSW-INTERRUPT-ENTITY UUID="a743510b-7066-488a-b0f8-5f521d7a07e9">
                  <SHORT-NAME>Cdd_Pwm_G3_Ch4Isr</SHORT-NAME>
                  <MINIMUM-START-INTERVAL>0.0</MINIMUM-START-INTERVAL>
                  <REENTRANCY-LEVEL>NON-REENTRANT</REENTRANCY-LEVEL>
                  <IMPLEMENTED-ENTRY-REF DEST="BSW-MODULE-ENTRY">/Cdd_Pwm_TI_AM263x/Cdd_Pwm_ModuleEntry/Cdd_Pwm_G3_Ch4Isr</IMPLEMENTED-ENTRY-REF>
                [!IF "as:modconf('Cdd_Pwm')[1]/CddPwmGeneral/CddPwmTypeofInterruptFunction = 'CDD_PWM_ISR_CAT2'"!][!//
                  <INTERRUPT-CATEGORY>CAT-2</INTERRUPT-CATEGORY>
                [!ELSE!][!//
                  <INTERRUPT-CATEGORY>CAT-1</INTERRUPT-CATEGORY>
                [!ENDIF!][!//
                  <INTERRUPT-SOURCE>Hardware</INTERRUPT-SOURCE>
                </BSW-INTERRUPT-ENTITY>
              [!ENDIF!][!//
              [!IF "num:i($CddChannel) = '5'"!][!//
                <BSW-INTERRUPT-ENTITY UUID="862f65fc-10fe-482c-bf4d-1ecceb48dc2f">
                  <SHORT-NAME>Cdd_Pwm_G3_Ch5Isr</SHORT-NAME>
                  <MINIMUM-START-INTERVAL>0.0</MINIMUM-START-INTERVAL>
                  <REENTRANCY-LEVEL>NON-REENTRANT</REENTRANCY-LEVEL>
                  <IMPLEMENTED-ENTRY-REF DEST="BSW-MODULE-ENTRY">/Cdd_Pwm_TI_AM263x/Cdd_Pwm_ModuleEntry/Cdd_Pwm_G3_Ch5Isr</IMPLEMENTED-ENTRY-REF>
                [!IF "as:modconf('Cdd_Pwm')[1]/CddPwmGeneral/CddPwmTypeofInterruptFunction = 'CDD_PWM_ISR_CAT2'"!][!//
                  <INTERRUPT-CATEGORY>CAT-2</INTERRUPT-CATEGORY>
                [!ELSE!][!//
                  <INTERRUPT-CATEGORY>CAT-1</INTERRUPT-CATEGORY>
                [!ENDIF!][!//
                  <INTERRUPT-SOURCE>Hardware</INTERRUPT-SOURCE>
                </BSW-INTERRUPT-ENTITY>
              [!ENDIF!][!//
              [!IF "num:i($CddChannel) = '6'"!][!//
                <BSW-INTERRUPT-ENTITY UUID="c0a67883-0b3c-4924-ab43-eda604713ff6">
                  <SHORT-NAME>Cdd_Pwm_G3_Ch6Isr</SHORT-NAME>
                  <MINIMUM-START-INTERVAL>0.0</MINIMUM-START-INTERVAL>
                  <REENTRANCY-LEVEL>NON-REENTRANT</REENTRANCY-LEVEL>
                  <IMPLEMENTED-ENTRY-REF DEST="BSW-MODULE-ENTRY">/Cdd_Pwm_TI_AM263x/Cdd_Pwm_ModuleEntry/Cdd_Pwm_G3_Ch6Isr</IMPLEMENTED-ENTRY-REF>
                [!IF "as:modconf('Cdd_Pwm')[1]/CddPwmGeneral/CddPwmTypeofInterruptFunction = 'CDD_PWM_ISR_CAT2'"!][!//
                  <INTERRUPT-CATEGORY>CAT-2</INTERRUPT-CATEGORY>
                [!ELSE!][!//
                  <INTERRUPT-CATEGORY>CAT-1</INTERRUPT-CATEGORY>
                [!ENDIF!][!//
                  <INTERRUPT-SOURCE>Hardware</INTERRUPT-SOURCE>
                </BSW-INTERRUPT-ENTITY>
              [!ENDIF!][!//
              [!IF "num:i($CddChannel) = '7'"!][!//
                <BSW-INTERRUPT-ENTITY UUID="ca3444ab-23f6-417f-b097-def674d6e0a3">
                  <SHORT-NAME>Cdd_Pwm_G3_Ch7Isr</SHORT-NAME>
                  <MINIMUM-START-INTERVAL>0.0</MINIMUM-START-INTERVAL>
                  <REENTRANCY-LEVEL>NON-REENTRANT</REENTRANCY-LEVEL>
                  <IMPLEMENTED-ENTRY-REF DEST="BSW-MODULE-ENTRY">/Cdd_Pwm_TI_AM263x/Cdd_Pwm_ModuleEntry/Cdd_Pwm_G3_Ch7Isr</IMPLEMENTED-ENTRY-REF>
                [!IF "as:modconf('Cdd_Pwm')[1]/CddPwmGeneral/CddPwmTypeofInterruptFunction = 'CDD_PWM_ISR_CAT2'"!][!//
                  <INTERRUPT-CATEGORY>CAT-2</INTERRUPT-CATEGORY>
                [!ELSE!][!//
                  <INTERRUPT-CATEGORY>CAT-1</INTERRUPT-CATEGORY>
                [!ENDIF!][!//
                  <INTERRUPT-SOURCE>Hardware</INTERRUPT-SOURCE>
                </BSW-INTERRUPT-ENTITY>
              [!ENDIF!][!//
              [!IF "num:i($CddChannel) = '8'"!][!//
                <BSW-INTERRUPT-ENTITY UUID="27870ce3-b281-45fc-84db-ebe83b43f6f7">
                  <SHORT-NAME>Cdd_Pwm_G3_Ch8Isr</SHORT-NAME>
                  <MINIMUM-START-INTERVAL>0.0</MINIMUM-START-INTERVAL>
                  <REENTRANCY-LEVEL>NON-REENTRANT</REENTRANCY-LEVEL>
                  <IMPLEMENTED-ENTRY-REF DEST="BSW-MODULE-ENTRY">/Cdd_Pwm_TI_AM263x/Cdd_Pwm_ModuleEntry/Cdd_Pwm_G3_Ch8Isr</IMPLEMENTED-ENTRY-REF>
                [!IF "as:modconf('Cdd_Pwm')[1]/CddPwmGeneral/CddPwmTypeofInterruptFunction = 'CDD_PWM_ISR_CAT2'"!][!//
                  <INTERRUPT-CATEGORY>CAT-2</INTERRUPT-CATEGORY>
                [!ELSE!][!//
                  <INTERRUPT-CATEGORY>CAT-1</INTERRUPT-CATEGORY>
                [!ENDIF!][!//
                  <INTERRUPT-SOURCE>Hardware</INTERRUPT-SOURCE>
                </BSW-INTERRUPT-ENTITY>
              [!ENDIF!][!//
              [!IF "num:i($CddChannel) = '9'"!][!//
                <BSW-INTERRUPT-ENTITY UUID="fce94f45-8feb-4811-b0f1-2e580301e618">
                  <SHORT-NAME>Cdd_Pwm_G3_Ch9Isr</SHORT-NAME>
                  <MINIMUM-START-INTERVAL>0.0</MINIMUM-START-INTERVAL>
                  <REENTRANCY-LEVEL>NON-REENTRANT</REENTRANCY-LEVEL>
                  <IMPLEMENTED-ENTRY-REF DEST="BSW-MODULE-ENTRY">/Cdd_Pwm_TI_AM263x/Cdd_Pwm_ModuleEntry/Cdd_Pwm_G3_Ch9Isr</IMPLEMENTED-ENTRY-REF>
                [!IF "as:modconf('Cdd_Pwm')[1]/CddPwmGeneral/CddPwmTypeofInterruptFunction = 'CDD_PWM_ISR_CAT2'"!][!//
                  <INTERRUPT-CATEGORY>CAT-2</INTERRUPT-CATEGORY>
                [!ELSE!][!//
                  <INTERRUPT-CATEGORY>CAT-1</INTERRUPT-CATEGORY>
                [!ENDIF!][!//
                  <INTERRUPT-SOURCE>Hardware</INTERRUPT-SOURCE>
                </BSW-INTERRUPT-ENTITY>
              [!ENDIF!][!//
              [!IF "num:i($CddChannel) = '0'"!][!//
                <BSW-INTERRUPT-ENTITY UUID="9b5af225-8871-4c42-8c25-aeda8584d639">
                  <SHORT-NAME>Cdd_Pwm_G3_TzCh0Isr</SHORT-NAME>
                  <MINIMUM-START-INTERVAL>0.0</MINIMUM-START-INTERVAL>
                  <REENTRANCY-LEVEL>NON-REENTRANT</REENTRANCY-LEVEL>
                  <IMPLEMENTED-ENTRY-REF DEST="BSW-MODULE-ENTRY">/Cdd_Pwm_TI_AM263x/Cdd_Pwm_ModuleEntry/Cdd_Pwm_G3_TzCh0Isr</IMPLEMENTED-ENTRY-REF>
                [!IF "as:modconf('Cdd_Pwm')[1]/CddPwmGeneral/CddPwmTypeofInterruptFunction = 'CDD_PWM_ISR_CAT2'"!][!//
                  <INTERRUPT-CATEGORY>CAT-2</INTERRUPT-CATEGORY>
                [!ELSE!][!//
                  <INTERRUPT-CATEGORY>CAT-1</INTERRUPT-CATEGORY>
                [!ENDIF!][!//
                  <INTERRUPT-SOURCE>Hardware</INTERRUPT-SOURCE>
                </BSW-INTERRUPT-ENTITY>
              [!ENDIF!][!//
              [!IF "num:i($CddChannel) = '10'"!][!//
                <BSW-INTERRUPT-ENTITY UUID="a69c7553-2c55-4af6-a687-cbe92930548d">
                  <SHORT-NAME>Cdd_Pwm_G3_TzCh10Isr</SHORT-NAME>
                  <MINIMUM-START-INTERVAL>0.0</MINIMUM-START-INTERVAL>
                  <REENTRANCY-LEVEL>NON-REENTRANT</REENTRANCY-LEVEL>
                  <IMPLEMENTED-ENTRY-REF DEST="BSW-MODULE-ENTRY">/Cdd_Pwm_TI_AM263x/Cdd_Pwm_ModuleEntry/Cdd_Pwm_G3_TzCh10Isr</IMPLEMENTED-ENTRY-REF>
                [!IF "as:modconf('Cdd_Pwm')[1]/CddPwmGeneral/CddPwmTypeofInterruptFunction = 'CDD_PWM_ISR_CAT2'"!][!//
                  <INTERRUPT-CATEGORY>CAT-2</INTERRUPT-CATEGORY>
                [!ELSE!][!//
                  <INTERRUPT-CATEGORY>CAT-1</INTERRUPT-CATEGORY>
                [!ENDIF!][!//
                  <INTERRUPT-SOURCE>Hardware</INTERRUPT-SOURCE>
                </BSW-INTERRUPT-ENTITY>
              [!ENDIF!][!//
              [!IF "num:i($CddChannel) = '11'"!][!//
                <BSW-INTERRUPT-ENTITY UUID="8627d3fa-6d5a-4245-8f2b-4d9450b99482">
                  <SHORT-NAME>Cdd_Pwm_G3_TzCh11Isr</SHORT-NAME>
                  <MINIMUM-START-INTERVAL>0.0</MINIMUM-START-INTERVAL>
                  <REENTRANCY-LEVEL>NON-REENTRANT</REENTRANCY-LEVEL>
                  <IMPLEMENTED-ENTRY-REF DEST="BSW-MODULE-ENTRY">/Cdd_Pwm_TI_AM263x/Cdd_Pwm_ModuleEntry/Cdd_Pwm_G3_TzCh11Isr</IMPLEMENTED-ENTRY-REF>
                [!IF "as:modconf('Cdd_Pwm')[1]/CddPwmGeneral/CddPwmTypeofInterruptFunction = 'CDD_PWM_ISR_CAT2'"!][!//
                  <INTERRUPT-CATEGORY>CAT-2</INTERRUPT-CATEGORY>
                [!ELSE!][!//
                  <INTERRUPT-CATEGORY>CAT-1</INTERRUPT-CATEGORY>
                [!ENDIF!][!//
                  <INTERRUPT-SOURCE>Hardware</INTERRUPT-SOURCE>
                </BSW-INTERRUPT-ENTITY>
              [!ENDIF!][!//
              [!IF "num:i($CddChannel) = '12'"!][!//
                <BSW-INTERRUPT-ENTITY UUID="e36cc151-d96f-445b-a600-104d20b8b96a">
                  <SHORT-NAME>Cdd_Pwm_G3_TzCh12Isr</SHORT-NAME>
                  <MINIMUM-START-INTERVAL>0.0</MINIMUM-START-INTERVAL>
                  <REENTRANCY-LEVEL>NON-REENTRANT</REENTRANCY-LEVEL>
                  <IMPLEMENTED-ENTRY-REF DEST="BSW-MODULE-ENTRY">/Cdd_Pwm_TI_AM263x/Cdd_Pwm_ModuleEntry/Cdd_Pwm_G3_TzCh12Isr</IMPLEMENTED-ENTRY-REF>
                [!IF "as:modconf('Cdd_Pwm')[1]/CddPwmGeneral/CddPwmTypeofInterruptFunction = 'CDD_PWM_ISR_CAT2'"!][!//
                  <INTERRUPT-CATEGORY>CAT-2</INTERRUPT-CATEGORY>
                [!ELSE!][!//
                  <INTERRUPT-CATEGORY>CAT-1</INTERRUPT-CATEGORY>
                [!ENDIF!][!//
                  <INTERRUPT-SOURCE>Hardware</INTERRUPT-SOURCE>
                </BSW-INTERRUPT-ENTITY>
              [!ENDIF!][!//
              [!IF "num:i($CddChannel) = '13'"!][!//
                <BSW-INTERRUPT-ENTITY UUID="27b8417f-82c4-4483-abd7-6177ab837eb0">
                  <SHORT-NAME>Cdd_Pwm_G3_TzCh13Isr</SHORT-NAME>
                  <MINIMUM-START-INTERVAL>0.0</MINIMUM-START-INTERVAL>
                  <REENTRANCY-LEVEL>NON-REENTRANT</REENTRANCY-LEVEL>
                  <IMPLEMENTED-ENTRY-REF DEST="BSW-MODULE-ENTRY">/Cdd_Pwm_TI_AM263x/Cdd_Pwm_ModuleEntry/Cdd_Pwm_G3_TzCh13Isr</IMPLEMENTED-ENTRY-REF>
                [!IF "as:modconf('Cdd_Pwm')[1]/CddPwmGeneral/CddPwmTypeofInterruptFunction = 'CDD_PWM_ISR_CAT2'"!][!//
                  <INTERRUPT-CATEGORY>CAT-2</INTERRUPT-CATEGORY>
                [!ELSE!][!//
                  <INTERRUPT-CATEGORY>CAT-1</INTERRUPT-CATEGORY>
                [!ENDIF!][!//
                  <INTERRUPT-SOURCE>Hardware</INTERRUPT-SOURCE>
                </BSW-INTERRUPT-ENTITY>
              [!ENDIF!][!//
              [!IF "num:i($CddChannel) = '14'"!][!//
                <BSW-INTERRUPT-ENTITY UUID="9d92c59f-b9d1-4a9e-ae04-eed4b348ef15">
                  <SHORT-NAME>Cdd_Pwm_G3_TzCh14Isr</SHORT-NAME>
                  <MINIMUM-START-INTERVAL>0.0</MINIMUM-START-INTERVAL>
                  <REENTRANCY-LEVEL>NON-REENTRANT</REENTRANCY-LEVEL>
                  <IMPLEMENTED-ENTRY-REF DEST="BSW-MODULE-ENTRY">/Cdd_Pwm_TI_AM263x/Cdd_Pwm_ModuleEntry/Cdd_Pwm_G3_TzCh14Isr</IMPLEMENTED-ENTRY-REF>
                [!IF "as:modconf('Cdd_Pwm')[1]/CddPwmGeneral/CddPwmTypeofInterruptFunction = 'CDD_PWM_ISR_CAT2'"!][!//
                  <INTERRUPT-CATEGORY>CAT-2</INTERRUPT-CATEGORY>
                [!ELSE!][!//
                  <INTERRUPT-CATEGORY>CAT-1</INTERRUPT-CATEGORY>
                [!ENDIF!][!//
                  <INTERRUPT-SOURCE>Hardware</INTERRUPT-SOURCE>
                </BSW-INTERRUPT-ENTITY>
              [!ENDIF!][!//
              [!IF "num:i($CddChannel) = '15'"!][!//
                <BSW-INTERRUPT-ENTITY UUID="b0872891-cf0d-44a1-8dfc-d3442e72699a">
                  <SHORT-NAME>Cdd_Pwm_G3_TzCh15Isr</SHORT-NAME>
                  <MINIMUM-START-INTERVAL>0.0</MINIMUM-START-INTERVAL>
                  <REENTRANCY-LEVEL>NON-REENTRANT</REENTRANCY-LEVEL>
                  <IMPLEMENTED-ENTRY-REF DEST="BSW-MODULE-ENTRY">/Cdd_Pwm_TI_AM263x/Cdd_Pwm_ModuleEntry/Cdd_Pwm_G3_TzCh15Isr</IMPLEMENTED-ENTRY-REF>
                [!IF "as:modconf('Cdd_Pwm')[1]/CddPwmGeneral/CddPwmTypeofInterruptFunction = 'CDD_PWM_ISR_CAT2'"!][!//
                  <INTERRUPT-CATEGORY>CAT-2</INTERRUPT-CATEGORY>
                [!ELSE!][!//
                  <INTERRUPT-CATEGORY>CAT-1</INTERRUPT-CATEGORY>
                [!ENDIF!][!//
                  <INTERRUPT-SOURCE>Hardware</INTERRUPT-SOURCE>
                </BSW-INTERRUPT-ENTITY>
              [!ENDIF!][!//
              [!IF "num:i($CddChannel) = '16'"!][!//
                <BSW-INTERRUPT-ENTITY UUID="859bc7fe-6986-47a0-a4a5-de5df81bcdc2">
                  <SHORT-NAME>Cdd_Pwm_G3_TzCh16Isr</SHORT-NAME>
                  <MINIMUM-START-INTERVAL>0.0</MINIMUM-START-INTERVAL>
                  <REENTRANCY-LEVEL>NON-REENTRANT</REENTRANCY-LEVEL>
                  <IMPLEMENTED-ENTRY-REF DEST="BSW-MODULE-ENTRY">/Cdd_Pwm_TI_AM263x/Cdd_Pwm_ModuleEntry/Cdd_Pwm_G3_TzCh16Isr</IMPLEMENTED-ENTRY-REF>
                [!IF "as:modconf('Cdd_Pwm')[1]/CddPwmGeneral/CddPwmTypeofInterruptFunction = 'CDD_PWM_ISR_CAT2'"!][!//
                  <INTERRUPT-CATEGORY>CAT-2</INTERRUPT-CATEGORY>
                [!ELSE!][!//
                  <INTERRUPT-CATEGORY>CAT-1</INTERRUPT-CATEGORY>
                [!ENDIF!][!//
                  <INTERRUPT-SOURCE>Hardware</INTERRUPT-SOURCE>
                </BSW-INTERRUPT-ENTITY>
              [!ENDIF!][!//
              [!IF "num:i($CddChannel) = '17'"!][!//
                <BSW-INTERRUPT-ENTITY UUID="d659f602-de2c-4f33-8dca-ce8f375adf13">
                  <SHORT-NAME>Cdd_Pwm_G3_TzCh17Isr</SHORT-NAME>
                  <MINIMUM-START-INTERVAL>0.0</MINIMUM-START-INTERVAL>
                  <REENTRANCY-LEVEL>NON-REENTRANT</REENTRANCY-LEVEL>
                  <IMPLEMENTED-ENTRY-REF DEST="BSW-MODULE-ENTRY">/Cdd_Pwm_TI_AM263x/Cdd_Pwm_ModuleEntry/Cdd_Pwm_G3_TzCh17Isr</IMPLEMENTED-ENTRY-REF>
                [!IF "as:modconf('Cdd_Pwm')[1]/CddPwmGeneral/CddPwmTypeofInterruptFunction = 'CDD_PWM_ISR_CAT2'"!][!//
                  <INTERRUPT-CATEGORY>CAT-2</INTERRUPT-CATEGORY>
                [!ELSE!][!//
                  <INTERRUPT-CATEGORY>CAT-1</INTERRUPT-CATEGORY>
                [!ENDIF!][!//
                  <INTERRUPT-SOURCE>Hardware</INTERRUPT-SOURCE>
                </BSW-INTERRUPT-ENTITY>
              [!ENDIF!][!//
              [!IF "num:i($CddChannel) = '18'"!][!//
                <BSW-INTERRUPT-ENTITY UUID="1a696907-c108-40ee-b86e-1e704b65ee1e">
                  <SHORT-NAME>Cdd_Pwm_G3_TzCh18Isr</SHORT-NAME>
                  <MINIMUM-START-INTERVAL>0.0</MINIMUM-START-INTERVAL>
                  <REENTRANCY-LEVEL>NON-REENTRANT</REENTRANCY-LEVEL>
                  <IMPLEMENTED-ENTRY-REF DEST="BSW-MODULE-ENTRY">/Cdd_Pwm_TI_AM263x/Cdd_Pwm_ModuleEntry/Cdd_Pwm_G3_TzCh18Isr</IMPLEMENTED-ENTRY-REF>
                [!IF "as:modconf('Cdd_Pwm')[1]/CddPwmGeneral/CddPwmTypeofInterruptFunction = 'CDD_PWM_ISR_CAT2'"!][!//
                  <INTERRUPT-CATEGORY>CAT-2</INTERRUPT-CATEGORY>
                [!ELSE!][!//
                  <INTERRUPT-CATEGORY>CAT-1</INTERRUPT-CATEGORY>
                [!ENDIF!][!//
                  <INTERRUPT-SOURCE>Hardware</INTERRUPT-SOURCE>
                </BSW-INTERRUPT-ENTITY>
              [!ENDIF!][!//
              [!IF "num:i($CddChannel) = '19'"!][!//
                <BSW-INTERRUPT-ENTITY UUID="d101931f-b0a9-4799-8bd1-8122721b41ca">
                  <SHORT-NAME>Cdd_Pwm_G3_TzCh19Isr</SHORT-NAME>
                  <MINIMUM-START-INTERVAL>0.0</MINIMUM-START-INTERVAL>
                  <REENTRANCY-LEVEL>NON-REENTRANT</REENTRANCY-LEVEL>
                  <IMPLEMENTED-ENTRY-REF DEST="BSW-MODULE-ENTRY">/Cdd_Pwm_TI_AM263x/Cdd_Pwm_ModuleEntry/Cdd_Pwm_G3_TzCh19Isr</IMPLEMENTED-ENTRY-REF>
                [!IF "as:modconf('Cdd_Pwm')[1]/CddPwmGeneral/CddPwmTypeofInterruptFunction = 'CDD_PWM_ISR_CAT2'"!][!//
                  <INTERRUPT-CATEGORY>CAT-2</INTERRUPT-CATEGORY>
                [!ELSE!][!//
                  <INTERRUPT-CATEGORY>CAT-1</INTERRUPT-CATEGORY>
                [!ENDIF!][!//
                  <INTERRUPT-SOURCE>Hardware</INTERRUPT-SOURCE>
                </BSW-INTERRUPT-ENTITY>
              [!ENDIF!][!//
              [!IF "num:i($CddChannel) = '1'"!][!//
                <BSW-INTERRUPT-ENTITY UUID="1171c724-5932-4dcb-8774-402e33c5f776">
                  <SHORT-NAME>Cdd_Pwm_G3_TzCh1Isr</SHORT-NAME>
                  <MINIMUM-START-INTERVAL>0.0</MINIMUM-START-INTERVAL>
                  <REENTRANCY-LEVEL>NON-REENTRANT</REENTRANCY-LEVEL>
                  <IMPLEMENTED-ENTRY-REF DEST="BSW-MODULE-ENTRY">/Cdd_Pwm_TI_AM263x/Cdd_Pwm_ModuleEntry/Cdd_Pwm_G3_TzCh1Isr</IMPLEMENTED-ENTRY-REF>
                [!IF "as:modconf('Cdd_Pwm')[1]/CddPwmGeneral/CddPwmTypeofInterruptFunction = 'CDD_PWM_ISR_CAT2'"!][!//
                  <INTERRUPT-CATEGORY>CAT-2</INTERRUPT-CATEGORY>
                [!ELSE!][!//
                  <INTERRUPT-CATEGORY>CAT-1</INTERRUPT-CATEGORY>
                [!ENDIF!][!//
                  <INTERRUPT-SOURCE>Hardware</INTERRUPT-SOURCE>
                </BSW-INTERRUPT-ENTITY>
              [!ENDIF!][!//
              [!IF "num:i($CddChannel) = '20'"!][!//
                <BSW-INTERRUPT-ENTITY UUID="1112d618-0307-4ebc-90f7-0ef677d90459">
                  <SHORT-NAME>Cdd_Pwm_G3_TzCh20Isr</SHORT-NAME>
                  <MINIMUM-START-INTERVAL>0.0</MINIMUM-START-INTERVAL>
                  <REENTRANCY-LEVEL>NON-REENTRANT</REENTRANCY-LEVEL>
                  <IMPLEMENTED-ENTRY-REF DEST="BSW-MODULE-ENTRY">/Cdd_Pwm_TI_AM263x/Cdd_Pwm_ModuleEntry/Cdd_Pwm_G3_TzCh20Isr</IMPLEMENTED-ENTRY-REF>
                [!IF "as:modconf('Cdd_Pwm')[1]/CddPwmGeneral/CddPwmTypeofInterruptFunction = 'CDD_PWM_ISR_CAT2'"!][!//
                  <INTERRUPT-CATEGORY>CAT-2</INTERRUPT-CATEGORY>
                [!ELSE!][!//
                  <INTERRUPT-CATEGORY>CAT-1</INTERRUPT-CATEGORY>
                [!ENDIF!][!//
                  <INTERRUPT-SOURCE>Hardware</INTERRUPT-SOURCE>
                </BSW-INTERRUPT-ENTITY>
              [!ENDIF!][!//
              [!IF "num:i($CddChannel) = '21'"!][!//
                <BSW-INTERRUPT-ENTITY UUID="4333a3d4-7d5b-4913-b465-b406d192e220">
                  <SHORT-NAME>Cdd_Pwm_G3_TzCh21Isr</SHORT-NAME>
                  <MINIMUM-START-INTERVAL>0.0</MINIMUM-START-INTERVAL>
                  <REENTRANCY-LEVEL>NON-REENTRANT</REENTRANCY-LEVEL>
                  <IMPLEMENTED-ENTRY-REF DEST="BSW-MODULE-ENTRY">/Cdd_Pwm_TI_AM263x/Cdd_Pwm_ModuleEntry/Cdd_Pwm_G3_TzCh21Isr</IMPLEMENTED-ENTRY-REF>
                [!IF "as:modconf('Cdd_Pwm')[1]/CddPwmGeneral/CddPwmTypeofInterruptFunction = 'CDD_PWM_ISR_CAT2'"!][!//
                  <INTERRUPT-CATEGORY>CAT-2</INTERRUPT-CATEGORY>
                [!ELSE!][!//
                  <INTERRUPT-CATEGORY>CAT-1</INTERRUPT-CATEGORY>
                [!ENDIF!][!//
                  <INTERRUPT-SOURCE>Hardware</INTERRUPT-SOURCE>
                </BSW-INTERRUPT-ENTITY>
              [!ENDIF!][!//
              [!IF "num:i($CddChannel) = '22'"!][!//
                <BSW-INTERRUPT-ENTITY UUID="ceecc620-131c-4efe-a6c6-e500d32a344c">
                  <SHORT-NAME>Cdd_Pwm_G3_TzCh22Isr</SHORT-NAME>
                  <MINIMUM-START-INTERVAL>0.0</MINIMUM-START-INTERVAL>
                  <REENTRANCY-LEVEL>NON-REENTRANT</REENTRANCY-LEVEL>
                  <IMPLEMENTED-ENTRY-REF DEST="BSW-MODULE-ENTRY">/Cdd_Pwm_TI_AM263x/Cdd_Pwm_ModuleEntry/Cdd_Pwm_G3_TzCh22Isr</IMPLEMENTED-ENTRY-REF>
                [!IF "as:modconf('Cdd_Pwm')[1]/CddPwmGeneral/CddPwmTypeofInterruptFunction = 'CDD_PWM_ISR_CAT2'"!][!//
                  <INTERRUPT-CATEGORY>CAT-2</INTERRUPT-CATEGORY>
                [!ELSE!][!//
                  <INTERRUPT-CATEGORY>CAT-1</INTERRUPT-CATEGORY>
                [!ENDIF!][!//
                  <INTERRUPT-SOURCE>Hardware</INTERRUPT-SOURCE>
                </BSW-INTERRUPT-ENTITY>
              [!ENDIF!][!//
              [!IF "num:i($CddChannel) = '23'"!][!//
                <BSW-INTERRUPT-ENTITY UUID="a1ec8690-3c00-4da7-bb45-8c04760b4378">
                  <SHORT-NAME>Cdd_Pwm_G3_TzCh23Isr</SHORT-NAME>
                  <MINIMUM-START-INTERVAL>0.0</MINIMUM-START-INTERVAL>
                  <REENTRANCY-LEVEL>NON-REENTRANT</REENTRANCY-LEVEL>
                  <IMPLEMENTED-ENTRY-REF DEST="BSW-MODULE-ENTRY">/Cdd_Pwm_TI_AM263x/Cdd_Pwm_ModuleEntry/Cdd_Pwm_G3_TzCh23Isr</IMPLEMENTED-ENTRY-REF>
                [!IF "as:modconf('Cdd_Pwm')[1]/CddPwmGeneral/CddPwmTypeofInterruptFunction = 'CDD_PWM_ISR_CAT2'"!][!//
                  <INTERRUPT-CATEGORY>CAT-2</INTERRUPT-CATEGORY>
                [!ELSE!][!//
                  <INTERRUPT-CATEGORY>CAT-1</INTERRUPT-CATEGORY>
                [!ENDIF!][!//
                  <INTERRUPT-SOURCE>Hardware</INTERRUPT-SOURCE>
                </BSW-INTERRUPT-ENTITY>
              [!ENDIF!][!//
              [!IF "num:i($CddChannel) = '24'"!][!//
                <BSW-INTERRUPT-ENTITY UUID="d17a1a25-3d1f-4815-9599-55bc24349a28">
                  <SHORT-NAME>Cdd_Pwm_G3_TzCh24Isr</SHORT-NAME>
                  <MINIMUM-START-INTERVAL>0.0</MINIMUM-START-INTERVAL>
                  <REENTRANCY-LEVEL>NON-REENTRANT</REENTRANCY-LEVEL>
                  <IMPLEMENTED-ENTRY-REF DEST="BSW-MODULE-ENTRY">/Cdd_Pwm_TI_AM263x/Cdd_Pwm_ModuleEntry/Cdd_Pwm_G3_TzCh24Isr</IMPLEMENTED-ENTRY-REF>
                [!IF "as:modconf('Cdd_Pwm')[1]/CddPwmGeneral/CddPwmTypeofInterruptFunction = 'CDD_PWM_ISR_CAT2'"!][!//
                  <INTERRUPT-CATEGORY>CAT-2</INTERRUPT-CATEGORY>
                [!ELSE!][!//
                  <INTERRUPT-CATEGORY>CAT-1</INTERRUPT-CATEGORY>
                [!ENDIF!][!//
                  <INTERRUPT-SOURCE>Hardware</INTERRUPT-SOURCE>
                </BSW-INTERRUPT-ENTITY>
              [!ENDIF!][!//
              [!IF "num:i($CddChannel) = '25'"!][!//
                <BSW-INTERRUPT-ENTITY UUID="af077cb2-8d18-43ff-bbd0-1628d6b554a0">
                  <SHORT-NAME>Cdd_Pwm_G3_TzCh25Isr</SHORT-NAME>
                  <MINIMUM-START-INTERVAL>0.0</MINIMUM-START-INTERVAL>
                  <REENTRANCY-LEVEL>NON-REENTRANT</REENTRANCY-LEVEL>
                  <IMPLEMENTED-ENTRY-REF DEST="BSW-MODULE-ENTRY">/Cdd_Pwm_TI_AM263x/Cdd_Pwm_ModuleEntry/Cdd_Pwm_G3_TzCh25Isr</IMPLEMENTED-ENTRY-REF>
                [!IF "as:modconf('Cdd_Pwm')[1]/CddPwmGeneral/CddPwmTypeofInterruptFunction = 'CDD_PWM_ISR_CAT2'"!][!//
                  <INTERRUPT-CATEGORY>CAT-2</INTERRUPT-CATEGORY>
                [!ELSE!][!//
                  <INTERRUPT-CATEGORY>CAT-1</INTERRUPT-CATEGORY>
                [!ENDIF!][!//
                  <INTERRUPT-SOURCE>Hardware</INTERRUPT-SOURCE>
                </BSW-INTERRUPT-ENTITY>
              [!ENDIF!][!//
              [!IF "num:i($CddChannel) = '26'"!][!//
                <BSW-INTERRUPT-ENTITY UUID="2836d6a4-cd06-4cd7-a40d-c5e351d632c6">
                  <SHORT-NAME>Cdd_Pwm_G3_TzCh26Isr</SHORT-NAME>
                  <MINIMUM-START-INTERVAL>0.0</MINIMUM-START-INTERVAL>
                  <REENTRANCY-LEVEL>NON-REENTRANT</REENTRANCY-LEVEL>
                  <IMPLEMENTED-ENTRY-REF DEST="BSW-MODULE-ENTRY">/Cdd_Pwm_TI_AM263x/Cdd_Pwm_ModuleEntry/Cdd_Pwm_G3_TzCh26Isr</IMPLEMENTED-ENTRY-REF>
                [!IF "as:modconf('Cdd_Pwm')[1]/CddPwmGeneral/CddPwmTypeofInterruptFunction = 'CDD_PWM_ISR_CAT2'"!][!//
                  <INTERRUPT-CATEGORY>CAT-2</INTERRUPT-CATEGORY>
                [!ELSE!][!//
                  <INTERRUPT-CATEGORY>CAT-1</INTERRUPT-CATEGORY>
                [!ENDIF!][!//
                  <INTERRUPT-SOURCE>Hardware</INTERRUPT-SOURCE>
                </BSW-INTERRUPT-ENTITY>
              [!ENDIF!][!//
              [!IF "num:i($CddChannel) = '27'"!][!//
                <BSW-INTERRUPT-ENTITY UUID="e2920f7b-42d3-4b99-b164-d462cb917e65">
                  <SHORT-NAME>Cdd_Pwm_G3_TzCh27Isr</SHORT-NAME>
                  <MINIMUM-START-INTERVAL>0.0</MINIMUM-START-INTERVAL>
                  <REENTRANCY-LEVEL>NON-REENTRANT</REENTRANCY-LEVEL>
                  <IMPLEMENTED-ENTRY-REF DEST="BSW-MODULE-ENTRY">/Cdd_Pwm_TI_AM263x/Cdd_Pwm_ModuleEntry/Cdd_Pwm_G3_TzCh27Isr</IMPLEMENTED-ENTRY-REF>
                [!IF "as:modconf('Cdd_Pwm')[1]/CddPwmGeneral/CddPwmTypeofInterruptFunction = 'CDD_PWM_ISR_CAT2'"!][!//
                  <INTERRUPT-CATEGORY>CAT-2</INTERRUPT-CATEGORY>
                [!ELSE!][!//
                  <INTERRUPT-CATEGORY>CAT-1</INTERRUPT-CATEGORY>
                [!ENDIF!][!//
                  <INTERRUPT-SOURCE>Hardware</INTERRUPT-SOURCE>
                </BSW-INTERRUPT-ENTITY>
              [!ENDIF!][!//
              [!IF "num:i($CddChannel) = '28'"!][!//
                <BSW-INTERRUPT-ENTITY UUID="15d743d5-8dba-4ebc-a236-c2e78bcc3039">
                  <SHORT-NAME>Cdd_Pwm_G3_TzCh28Isr</SHORT-NAME>
                  <MINIMUM-START-INTERVAL>0.0</MINIMUM-START-INTERVAL>
                  <REENTRANCY-LEVEL>NON-REENTRANT</REENTRANCY-LEVEL>
                  <IMPLEMENTED-ENTRY-REF DEST="BSW-MODULE-ENTRY">/Cdd_Pwm_TI_AM263x/Cdd_Pwm_ModuleEntry/Cdd_Pwm_G3_TzCh28Isr</IMPLEMENTED-ENTRY-REF>
                [!IF "as:modconf('Cdd_Pwm')[1]/CddPwmGeneral/CddPwmTypeofInterruptFunction = 'CDD_PWM_ISR_CAT2'"!][!//
                  <INTERRUPT-CATEGORY>CAT-2</INTERRUPT-CATEGORY>
                [!ELSE!][!//
                  <INTERRUPT-CATEGORY>CAT-1</INTERRUPT-CATEGORY>
                [!ENDIF!][!//
                  <INTERRUPT-SOURCE>Hardware</INTERRUPT-SOURCE>
                </BSW-INTERRUPT-ENTITY>
              [!ENDIF!][!//
              [!IF "num:i($CddChannel) = '29'"!][!//
                <BSW-INTERRUPT-ENTITY UUID="f9a43fc5-4301-4a0a-a34d-6a63438b414e">
                  <SHORT-NAME>Cdd_Pwm_G3_TzCh29Isr</SHORT-NAME>
                  <MINIMUM-START-INTERVAL>0.0</MINIMUM-START-INTERVAL>
                  <REENTRANCY-LEVEL>NON-REENTRANT</REENTRANCY-LEVEL>
                  <IMPLEMENTED-ENTRY-REF DEST="BSW-MODULE-ENTRY">/Cdd_Pwm_TI_AM263x/Cdd_Pwm_ModuleEntry/Cdd_Pwm_G3_TzCh29Isr</IMPLEMENTED-ENTRY-REF>
                [!IF "as:modconf('Cdd_Pwm')[1]/CddPwmGeneral/CddPwmTypeofInterruptFunction = 'CDD_PWM_ISR_CAT2'"!][!//
                  <INTERRUPT-CATEGORY>CAT-2</INTERRUPT-CATEGORY>
                [!ELSE!][!//
                  <INTERRUPT-CATEGORY>CAT-1</INTERRUPT-CATEGORY>
                [!ENDIF!][!//
                  <INTERRUPT-SOURCE>Hardware</INTERRUPT-SOURCE>
                </BSW-INTERRUPT-ENTITY>
              [!ENDIF!][!//
              [!IF "num:i($CddChannel) = '2'"!][!//
                <BSW-INTERRUPT-ENTITY UUID="c8f4866f-c6dd-4e29-a1ff-ed406f7687d9">
                  <SHORT-NAME>Cdd_Pwm_G3_TzCh2Isr</SHORT-NAME>
                  <MINIMUM-START-INTERVAL>0.0</MINIMUM-START-INTERVAL>
                  <REENTRANCY-LEVEL>NON-REENTRANT</REENTRANCY-LEVEL>
                  <IMPLEMENTED-ENTRY-REF DEST="BSW-MODULE-ENTRY">/Cdd_Pwm_TI_AM263x/Cdd_Pwm_ModuleEntry/Cdd_Pwm_G3_TzCh2Isr</IMPLEMENTED-ENTRY-REF>
                [!IF "as:modconf('Cdd_Pwm')[1]/CddPwmGeneral/CddPwmTypeofInterruptFunction = 'CDD_PWM_ISR_CAT2'"!][!//
                  <INTERRUPT-CATEGORY>CAT-2</INTERRUPT-CATEGORY>
                [!ELSE!][!//
                  <INTERRUPT-CATEGORY>CAT-1</INTERRUPT-CATEGORY>
                [!ENDIF!][!//
                  <INTERRUPT-SOURCE>Hardware</INTERRUPT-SOURCE>
                </BSW-INTERRUPT-ENTITY>
              [!ENDIF!][!//
              [!IF "num:i($CddChannel) = '30'"!][!//
                <BSW-INTERRUPT-ENTITY UUID="579a39c7-1646-4369-a728-e7a6767efc38">
                  <SHORT-NAME>Cdd_Pwm_G3_TzCh30Isr</SHORT-NAME>
                  <MINIMUM-START-INTERVAL>0.0</MINIMUM-START-INTERVAL>
                  <REENTRANCY-LEVEL>NON-REENTRANT</REENTRANCY-LEVEL>
                  <IMPLEMENTED-ENTRY-REF DEST="BSW-MODULE-ENTRY">/Cdd_Pwm_TI_AM263x/Cdd_Pwm_ModuleEntry/Cdd_Pwm_G3_TzCh30Isr</IMPLEMENTED-ENTRY-REF>
                [!IF "as:modconf('Cdd_Pwm')[1]/CddPwmGeneral/CddPwmTypeofInterruptFunction = 'CDD_PWM_ISR_CAT2'"!][!//
                  <INTERRUPT-CATEGORY>CAT-2</INTERRUPT-CATEGORY>
                [!ELSE!][!//
                  <INTERRUPT-CATEGORY>CAT-1</INTERRUPT-CATEGORY>
                [!ENDIF!][!//
                  <INTERRUPT-SOURCE>Hardware</INTERRUPT-SOURCE>
                </BSW-INTERRUPT-ENTITY>
              [!ENDIF!][!//
              [!IF "num:i($CddChannel) = '31'"!][!//
                <BSW-INTERRUPT-ENTITY UUID="7e05b2bd-461b-4a10-8fc1-21787c029aea">
                  <SHORT-NAME>Cdd_Pwm_G3_TzCh31Isr</SHORT-NAME>
                  <MINIMUM-START-INTERVAL>0.0</MINIMUM-START-INTERVAL>
                  <REENTRANCY-LEVEL>NON-REENTRANT</REENTRANCY-LEVEL>
                  <IMPLEMENTED-ENTRY-REF DEST="BSW-MODULE-ENTRY">/Cdd_Pwm_TI_AM263x/Cdd_Pwm_ModuleEntry/Cdd_Pwm_G3_TzCh31Isr</IMPLEMENTED-ENTRY-REF>
                [!IF "as:modconf('Cdd_Pwm')[1]/CddPwmGeneral/CddPwmTypeofInterruptFunction = 'CDD_PWM_ISR_CAT2'"!][!//
                  <INTERRUPT-CATEGORY>CAT-2</INTERRUPT-CATEGORY>
                [!ELSE!][!//
                  <INTERRUPT-CATEGORY>CAT-1</INTERRUPT-CATEGORY>
                [!ENDIF!][!//
                  <INTERRUPT-SOURCE>Hardware</INTERRUPT-SOURCE>
                </BSW-INTERRUPT-ENTITY>
              [!ENDIF!][!//
              [!IF "num:i($CddChannel) = '3'"!][!//
                <BSW-INTERRUPT-ENTITY UUID="be1f2f5a-bab8-474d-8b3b-50b42db54eb8">
                  <SHORT-NAME>Cdd_Pwm_G3_TzCh3Isr</SHORT-NAME>
                  <MINIMUM-START-INTERVAL>0.0</MINIMUM-START-INTERVAL>
                  <REENTRANCY-LEVEL>NON-REENTRANT</REENTRANCY-LEVEL>
                  <IMPLEMENTED-ENTRY-REF DEST="BSW-MODULE-ENTRY">/Cdd_Pwm_TI_AM263x/Cdd_Pwm_ModuleEntry/Cdd_Pwm_G3_TzCh3Isr</IMPLEMENTED-ENTRY-REF>
                [!IF "as:modconf('Cdd_Pwm')[1]/CddPwmGeneral/CddPwmTypeofInterruptFunction = 'CDD_PWM_ISR_CAT2'"!][!//
                  <INTERRUPT-CATEGORY>CAT-2</INTERRUPT-CATEGORY>
                [!ELSE!][!//
                  <INTERRUPT-CATEGORY>CAT-1</INTERRUPT-CATEGORY>
                [!ENDIF!][!//
                  <INTERRUPT-SOURCE>Hardware</INTERRUPT-SOURCE>
                </BSW-INTERRUPT-ENTITY>
              [!ENDIF!][!//
              [!IF "num:i($CddChannel) = '4'"!][!//
                <BSW-INTERRUPT-ENTITY UUID="0ae13f85-8d55-4757-833e-efa7302dcada">
                  <SHORT-NAME>Cdd_Pwm_G3_TzCh4Isr</SHORT-NAME>
                  <MINIMUM-START-INTERVAL>0.0</MINIMUM-START-INTERVAL>
                  <REENTRANCY-LEVEL>NON-REENTRANT</REENTRANCY-LEVEL>
                  <IMPLEMENTED-ENTRY-REF DEST="BSW-MODULE-ENTRY">/Cdd_Pwm_TI_AM263x/Cdd_Pwm_ModuleEntry/Cdd_Pwm_G3_TzCh4Isr</IMPLEMENTED-ENTRY-REF>
                [!IF "as:modconf('Cdd_Pwm')[1]/CddPwmGeneral/CddPwmTypeofInterruptFunction = 'CDD_PWM_ISR_CAT2'"!][!//
                  <INTERRUPT-CATEGORY>CAT-2</INTERRUPT-CATEGORY>
                [!ELSE!][!//
                  <INTERRUPT-CATEGORY>CAT-1</INTERRUPT-CATEGORY>
                [!ENDIF!][!//
                  <INTERRUPT-SOURCE>Hardware</INTERRUPT-SOURCE>
                </BSW-INTERRUPT-ENTITY>
              [!ENDIF!][!//
              [!IF "num:i($CddChannel) = '5'"!][!//
                <BSW-INTERRUPT-ENTITY UUID="ff3393ec-9787-4f45-87cf-2c07f8d621dd">
                  <SHORT-NAME>Cdd_Pwm_G3_TzCh5Isr</SHORT-NAME>
                  <MINIMUM-START-INTERVAL>0.0</MINIMUM-START-INTERVAL>
                  <REENTRANCY-LEVEL>NON-REENTRANT</REENTRANCY-LEVEL>
                  <IMPLEMENTED-ENTRY-REF DEST="BSW-MODULE-ENTRY">/Cdd_Pwm_TI_AM263x/Cdd_Pwm_ModuleEntry/Cdd_Pwm_G3_TzCh5Isr</IMPLEMENTED-ENTRY-REF>
                [!IF "as:modconf('Cdd_Pwm')[1]/CddPwmGeneral/CddPwmTypeofInterruptFunction = 'CDD_PWM_ISR_CAT2'"!][!//
                  <INTERRUPT-CATEGORY>CAT-2</INTERRUPT-CATEGORY>
                [!ELSE!][!//
                  <INTERRUPT-CATEGORY>CAT-1</INTERRUPT-CATEGORY>
                [!ENDIF!][!//
                  <INTERRUPT-SOURCE>Hardware</INTERRUPT-SOURCE>
                </BSW-INTERRUPT-ENTITY>
              [!ENDIF!][!//
              [!IF "num:i($CddChannel) = '6'"!][!//
                <BSW-INTERRUPT-ENTITY UUID="baf44b9d-5313-4e1b-9832-c948bdaaf7fa">
                  <SHORT-NAME>Cdd_Pwm_G3_TzCh6Isr</SHORT-NAME>
                  <MINIMUM-START-INTERVAL>0.0</MINIMUM-START-INTERVAL>
                  <REENTRANCY-LEVEL>NON-REENTRANT</REENTRANCY-LEVEL>
                  <IMPLEMENTED-ENTRY-REF DEST="BSW-MODULE-ENTRY">/Cdd_Pwm_TI_AM263x/Cdd_Pwm_ModuleEntry/Cdd_Pwm_G3_TzCh6Isr</IMPLEMENTED-ENTRY-REF>
                [!IF "as:modconf('Cdd_Pwm')[1]/CddPwmGeneral/CddPwmTypeofInterruptFunction = 'CDD_PWM_ISR_CAT2'"!][!//
                  <INTERRUPT-CATEGORY>CAT-2</INTERRUPT-CATEGORY>
                [!ELSE!][!//
                  <INTERRUPT-CATEGORY>CAT-1</INTERRUPT-CATEGORY>
                [!ENDIF!][!//
                  <INTERRUPT-SOURCE>Hardware</INTERRUPT-SOURCE>
                </BSW-INTERRUPT-ENTITY>
              [!ENDIF!][!//
              [!IF "num:i($CddChannel) = '7'"!][!//
                <BSW-INTERRUPT-ENTITY UUID="cac741e1-f756-46bf-9816-558a94ea4265">
                  <SHORT-NAME>Cdd_Pwm_G3_TzCh7Isr</SHORT-NAME>
                  <MINIMUM-START-INTERVAL>0.0</MINIMUM-START-INTERVAL>
                  <REENTRANCY-LEVEL>NON-REENTRANT</REENTRANCY-LEVEL>
                  <IMPLEMENTED-ENTRY-REF DEST="BSW-MODULE-ENTRY">/Cdd_Pwm_TI_AM263x/Cdd_Pwm_ModuleEntry/Cdd_Pwm_G3_TzCh7Isr</IMPLEMENTED-ENTRY-REF>
                [!IF "as:modconf('Cdd_Pwm')[1]/CddPwmGeneral/CddPwmTypeofInterruptFunction = 'CDD_PWM_ISR_CAT2'"!][!//
                  <INTERRUPT-CATEGORY>CAT-2</INTERRUPT-CATEGORY>
                [!ELSE!][!//
                  <INTERRUPT-CATEGORY>CAT-1</INTERRUPT-CATEGORY>
                [!ENDIF!][!//
                  <INTERRUPT-SOURCE>Hardware</INTERRUPT-SOURCE>
                </BSW-INTERRUPT-ENTITY>
              [!ENDIF!][!//
              [!IF "num:i($CddChannel) = '8'"!][!//
                <BSW-INTERRUPT-ENTITY UUID="58cc9221-74af-46d3-9714-af1253b20229">
                  <SHORT-NAME>Cdd_Pwm_G3_TzCh8Isr</SHORT-NAME>
                  <MINIMUM-START-INTERVAL>0.0</MINIMUM-START-INTERVAL>
                  <REENTRANCY-LEVEL>NON-REENTRANT</REENTRANCY-LEVEL>
                  <IMPLEMENTED-ENTRY-REF DEST="BSW-MODULE-ENTRY">/Cdd_Pwm_TI_AM263x/Cdd_Pwm_ModuleEntry/Cdd_Pwm_G3_TzCh8Isr</IMPLEMENTED-ENTRY-REF>
                [!IF "as:modconf('Cdd_Pwm')[1]/CddPwmGeneral/CddPwmTypeofInterruptFunction = 'CDD_PWM_ISR_CAT2'"!][!//
                  <INTERRUPT-CATEGORY>CAT-2</INTERRUPT-CATEGORY>
                [!ELSE!][!//
                  <INTERRUPT-CATEGORY>CAT-1</INTERRUPT-CATEGORY>
                [!ENDIF!][!//
                  <INTERRUPT-SOURCE>Hardware</INTERRUPT-SOURCE>
                </BSW-INTERRUPT-ENTITY>
              [!ENDIF!][!//
              [!IF "num:i($CddChannel) = '9'"!][!//
                <BSW-INTERRUPT-ENTITY UUID="ebdec7df-3e7a-416a-87c9-91de0893b38b">
                  <SHORT-NAME>Cdd_Pwm_G3_TzCh9Isr</SHORT-NAME>
                  <MINIMUM-START-INTERVAL>0.0</MINIMUM-START-INTERVAL>
                  <REENTRANCY-LEVEL>NON-REENTRANT</REENTRANCY-LEVEL>
                  <IMPLEMENTED-ENTRY-REF DEST="BSW-MODULE-ENTRY">/Cdd_Pwm_TI_AM263x/Cdd_Pwm_ModuleEntry/Cdd_Pwm_G3_TzCh9Isr</IMPLEMENTED-ENTRY-REF>
                [!IF "as:modconf('Cdd_Pwm')[1]/CddPwmGeneral/CddPwmTypeofInterruptFunction = 'CDD_PWM_ISR_CAT2'"!][!//
                  <INTERRUPT-CATEGORY>CAT-2</INTERRUPT-CATEGORY>
                [!ELSE!][!//
                  <INTERRUPT-CATEGORY>CAT-1</INTERRUPT-CATEGORY>
                [!ENDIF!][!//
                  <INTERRUPT-SOURCE>Hardware</INTERRUPT-SOURCE>
                </BSW-INTERRUPT-ENTITY>
              [!ENDIF!][!//
              [!ENDIF!][!//
              [!ENDLOOP!][!//
              [!IF "as:modconf('Cdd_Pwm')[1]/CddPwmConfigurationOfOptionalApis/CddPwmGetCounterApi"!][!//
                <BSW-CALLED-ENTITY UUID="d730e5d8-b174-412c-826a-a77a44e365b7">
                  <SHORT-NAME>Cdd_Pwm_GetCounter</SHORT-NAME>
                  <CAN-ENTER-EXCLUSIVE-AREA-REFS>
                    <CAN-ENTER-EXCLUSIVE-AREA-REF DEST="EXCLUSIVE-AREA">/Cdd_Pwm_TI_AM263x/Cdd_Pwm/Cdd_Pwm_Behavior/PWM_EXCLUSIVE_AREA_0</CAN-ENTER-EXCLUSIVE-AREA-REF>
                  </CAN-ENTER-EXCLUSIVE-AREA-REFS>
                  <MINIMUM-START-INTERVAL>0.0</MINIMUM-START-INTERVAL>
                  <REENTRANCY-LEVEL>SINGLE-CORE-REENTRANT</REENTRANCY-LEVEL>
                [!IF "as:modconf('Cdd_Pwm')[1]/CddPwmGeneral/CddPwmDevErrorDetect"!][!//
                  <CALL-POINTS>
                    <BSW-DIRECT-CALL-POINT>
                      <SHORT-NAME>Det</SHORT-NAME>
                      <CALLED-ENTRY-REF DEST="BSW-MODULE-ENTRY">/AUTOSAR_Det/BSWModuleEntry/Det_ReportError</CALLED-ENTRY-REF>
                    </BSW-DIRECT-CALL-POINT>
                  </CALL-POINTS>
                [!ENDIF!][!//
                  <IMPLEMENTED-ENTRY-REF DEST="BSW-MODULE-ENTRY">/Cdd_Pwm_TI_AM263x/Cdd_Pwm_ModuleEntry/Cdd_Pwm_GetCounter</IMPLEMENTED-ENTRY-REF>
                </BSW-CALLED-ENTITY>
              [!ENDIF!][!//
              [!IF "as:modconf('Cdd_Pwm')[1]/CddPwmConfigurationOfOptionalApis/CddPwmGetCounterStatus"!][!//
                <BSW-CALLED-ENTITY UUID="c33584b1-670d-4d2b-8330-553b3761c1c2">
                  <SHORT-NAME>Cdd_Pwm_GetCounterStatus</SHORT-NAME>
                  <MINIMUM-START-INTERVAL>0.0</MINIMUM-START-INTERVAL>
                  <REENTRANCY-LEVEL>SINGLE-CORE-REENTRANT</REENTRANCY-LEVEL>
                  <IMPLEMENTED-ENTRY-REF DEST="BSW-MODULE-ENTRY">/Cdd_Pwm_TI_AM263x/Cdd_Pwm_ModuleEntry/Cdd_Pwm_GetCounterStatus</IMPLEMENTED-ENTRY-REF>
                </BSW-CALLED-ENTITY>
              [!ENDIF!][!//
              [!IF "as:modconf('Cdd_Pwm')[1]/CddPwmConfigurationOfOptionalApis/CddPwmVersionInfoApi"!][!//
                <BSW-CALLED-ENTITY UUID="ce9f1085-0342-48cb-9bdb-4384b49e13dd">
                  <SHORT-NAME>Cdd_Pwm_GetVersionInfo</SHORT-NAME>
                  <MINIMUM-START-INTERVAL>0.0</MINIMUM-START-INTERVAL>
                  <REENTRANCY-LEVEL>SINGLE-CORE-REENTRANT</REENTRANCY-LEVEL>
                [!IF "as:modconf('Cdd_Pwm')[1]/CddPwmGeneral/CddPwmDevErrorDetect"!][!//
                  <CALL-POINTS>
                    <BSW-DIRECT-CALL-POINT>
                      <SHORT-NAME>Det</SHORT-NAME>
                      <CALLED-ENTRY-REF DEST="BSW-MODULE-ENTRY">/AUTOSAR_Det/BSWModuleEntry/Det_ReportError</CALLED-ENTRY-REF>
                    </BSW-DIRECT-CALL-POINT>
                  </CALL-POINTS>
                [!ENDIF!][!//
                  <IMPLEMENTED-ENTRY-REF DEST="BSW-MODULE-ENTRY">/Cdd_Pwm_TI_AM263x/Cdd_Pwm_ModuleEntry/Cdd_Pwm_GetVersionInfo</IMPLEMENTED-ENTRY-REF>
                </BSW-CALLED-ENTITY>
              [!ENDIF!][!//
              [!IF "as:modconf('Cdd_Pwm')[1]/CddPwmGeneral/CddPwmHrSetPeriodDutyEnable"!][!//
                <BSW-CALLED-ENTITY UUID="ed6b2378-95b6-4671-9900-231e63b9b7dc">
                  <SHORT-NAME>Cdd_Pwm_HrSetPeriodDutyPhase</SHORT-NAME>
                  <CAN-ENTER-EXCLUSIVE-AREA-REFS>
                    <CAN-ENTER-EXCLUSIVE-AREA-REF DEST="EXCLUSIVE-AREA">/Cdd_Pwm_TI_AM263x/Cdd_Pwm/Cdd_Pwm_Behavior/PWM_EXCLUSIVE_AREA_0</CAN-ENTER-EXCLUSIVE-AREA-REF>
                  </CAN-ENTER-EXCLUSIVE-AREA-REFS>
                  <MINIMUM-START-INTERVAL>0.0</MINIMUM-START-INTERVAL>
                  <REENTRANCY-LEVEL>NON-REENTRANT</REENTRANCY-LEVEL>
                [!IF "as:modconf('Cdd_Pwm')[1]/CddPwmGeneral/CddPwmDevErrorDetect"!][!//
                  <CALL-POINTS>
                    <BSW-DIRECT-CALL-POINT>
                      <SHORT-NAME>Det</SHORT-NAME>
                      <CALLED-ENTRY-REF DEST="BSW-MODULE-ENTRY">/AUTOSAR_Det/BSWModuleEntry/Det_ReportError</CALLED-ENTRY-REF>
                    </BSW-DIRECT-CALL-POINT>
                  </CALL-POINTS>
                [!ENDIF!][!//
                  <IMPLEMENTED-ENTRY-REF DEST="BSW-MODULE-ENTRY">/Cdd_Pwm_TI_AM263x/Cdd_Pwm_ModuleEntry/Cdd_Pwm_HrSetPeriodDutyPhase</IMPLEMENTED-ENTRY-REF>
                </BSW-CALLED-ENTITY>
				<BSW-CALLED-ENTITY UUID="a0d56cd8-5d45-4c5b-82e6-abf1e98cf585">
				<SHORT-NAME>Cdd_Pwm_HrSetPhaseShift</SHORT-NAME>
                  <MINIMUM-START-INTERVAL>0.0</MINIMUM-START-INTERVAL>
                  <REENTRANCY-LEVEL>NON-REENTRANT</REENTRANCY-LEVEL>
                  <IMPLEMENTED-ENTRY-REF DEST="BSW-MODULE-ENTRY">/Cdd_Pwm_TI_AM263x/Cdd_Pwm_ModuleEntry/Cdd_Pwm_HrSetPhaseShift</IMPLEMENTED-ENTRY-REF>
                </BSW-CALLED-ENTITY>
				<BSW-CALLED-ENTITY UUID="d76eb16f-3dab-46b1-8c07-75fad38c7123">
                  <SHORT-NAME>Cdd_Pwm_HrSetTimeBasePeriod</SHORT-NAME>
                  <MINIMUM-START-INTERVAL>0.0</MINIMUM-START-INTERVAL>
                  <REENTRANCY-LEVEL>NON-REENTRANT</REENTRANCY-LEVEL>
                  <IMPLEMENTED-ENTRY-REF DEST="BSW-MODULE-ENTRY">/Cdd_Pwm_TI_AM263x/Cdd_Pwm_ModuleEntry/Cdd_Pwm_HrSetTimeBasePeriod</IMPLEMENTED-ENTRY-REF>
                </BSW-CALLED-ENTITY>
				<BSW-CALLED-ENTITY UUID="a42d4bba-edcb-4cc7-a735-352ff140a18e">
                  <SHORT-NAME>Cdd_Pwm_HrSetCounterCompareValue</SHORT-NAME>
                  <MINIMUM-START-INTERVAL>0.0</MINIMUM-START-INTERVAL>
                  <REENTRANCY-LEVEL>NON-REENTRANT</REENTRANCY-LEVEL>
                  <IMPLEMENTED-ENTRY-REF DEST="BSW-MODULE-ENTRY">/Cdd_Pwm_TI_AM263x/Cdd_Pwm_ModuleEntry/Cdd_Pwm_HrSetCounterCompareValue</IMPLEMENTED-ENTRY-REF>
                </BSW-CALLED-ENTITY>
				<BSW-CALLED-ENTITY UUID="55cb5784-a5c6-41ee-a04f-2daa7aa6516a">
                  <SHORT-NAME>Cdd_Pwm_HrSetXcmpRegValue</SHORT-NAME>
                  <MINIMUM-START-INTERVAL>0.0</MINIMUM-START-INTERVAL>
                  <REENTRANCY-LEVEL>NON-REENTRANT</REENTRANCY-LEVEL>
                  <IMPLEMENTED-ENTRY-REF DEST="BSW-MODULE-ENTRY">/Cdd_Pwm_TI_AM263x/Cdd_Pwm_ModuleEntry/Cdd_Pwm_HrSetXcmpRegValue</IMPLEMENTED-ENTRY-REF>
                </BSW-CALLED-ENTITY>
              [!ENDIF!][!//
              [!IF "as:modconf('Cdd_Pwm')[1]/CddPwmGeneral/CddPwmHrSfoCalibrationEnable"!][!//
                <BSW-CALLED-ENTITY UUID="4f8b6548-a156-4346-b1a7-dc7a0fcc6053">
                  <SHORT-NAME>Cdd_Pwm_HrSfoCalibration</SHORT-NAME>
                  <CAN-ENTER-EXCLUSIVE-AREA-REFS>
                    <CAN-ENTER-EXCLUSIVE-AREA-REF DEST="EXCLUSIVE-AREA">/Cdd_Pwm_TI_AM263x/Cdd_Pwm/Cdd_Pwm_Behavior/PWM_EXCLUSIVE_AREA_0</CAN-ENTER-EXCLUSIVE-AREA-REF>
                  </CAN-ENTER-EXCLUSIVE-AREA-REFS>
                  <MINIMUM-START-INTERVAL>0.0</MINIMUM-START-INTERVAL>
                  <REENTRANCY-LEVEL>NON-REENTRANT</REENTRANCY-LEVEL>
                [!IF "as:modconf('Cdd_Pwm')[1]/CddPwmGeneral/CddPwmDevErrorDetect"!][!//
                  <CALL-POINTS>
                    <BSW-DIRECT-CALL-POINT>
                      <SHORT-NAME>Det</SHORT-NAME>
                      <CALLED-ENTRY-REF DEST="BSW-MODULE-ENTRY">/AUTOSAR_Det/BSWModuleEntry/Det_ReportError</CALLED-ENTRY-REF>
                    </BSW-DIRECT-CALL-POINT>
                  </CALL-POINTS>
                [!ENDIF!][!//
                  <IMPLEMENTED-ENTRY-REF DEST="BSW-MODULE-ENTRY">/Cdd_Pwm_TI_AM263x/Cdd_Pwm_ModuleEntry/Cdd_Pwm_HrSfoCalibration</IMPLEMENTED-ENTRY-REF>
                </BSW-CALLED-ENTITY>
              [!ENDIF!][!//
              [!IF "as:modconf('Cdd_Pwm')[1]/CddPwmGeneral/CddPwmHrSfoStatusEnable"!][!//
                <BSW-CALLED-ENTITY UUID="3cc0b90f-1232-4bc3-9f51-85dfa70edf82">
                  <SHORT-NAME>Cdd_Pwm_HrSfoStatus</SHORT-NAME>
                  <CAN-ENTER-EXCLUSIVE-AREA-REFS>
                    <CAN-ENTER-EXCLUSIVE-AREA-REF DEST="EXCLUSIVE-AREA">/Cdd_Pwm_TI_AM263x/Cdd_Pwm/Cdd_Pwm_Behavior/PWM_EXCLUSIVE_AREA_0</CAN-ENTER-EXCLUSIVE-AREA-REF>
                  </CAN-ENTER-EXCLUSIVE-AREA-REFS>
                  <MINIMUM-START-INTERVAL>0.0</MINIMUM-START-INTERVAL>
                  <REENTRANCY-LEVEL>SINGLE-CORE-REENTRANT</REENTRANCY-LEVEL>
                [!IF "as:modconf('Cdd_Pwm')[1]/CddPwmGeneral/CddPwmDevErrorDetect"!][!//
                  <CALL-POINTS>
                    <BSW-DIRECT-CALL-POINT>
                      <SHORT-NAME>Det</SHORT-NAME>
                      <CALLED-ENTRY-REF DEST="BSW-MODULE-ENTRY">/AUTOSAR_Det/BSWModuleEntry/Det_ReportError</CALLED-ENTRY-REF>
                    </BSW-DIRECT-CALL-POINT>
                  </CALL-POINTS>
                [!ENDIF!][!//
                  <IMPLEMENTED-ENTRY-REF DEST="BSW-MODULE-ENTRY">/Cdd_Pwm_TI_AM263x/Cdd_Pwm_ModuleEntry/Cdd_Pwm_HrSfoStatus</IMPLEMENTED-ENTRY-REF>
                </BSW-CALLED-ENTITY>
              [!ENDIF!][!//
                <BSW-CALLED-ENTITY UUID="aea466cc-0f83-4ed0-829c-469b76c55237">
                  <SHORT-NAME>Cdd_Pwm_Init</SHORT-NAME>
                  <MINIMUM-START-INTERVAL>0.0</MINIMUM-START-INTERVAL>
                  <REENTRANCY-LEVEL>NON-REENTRANT</REENTRANCY-LEVEL>
                [!IF "as:modconf('Cdd_Pwm')[1]/CddPwmGeneral/CddPwmDevErrorDetect"!][!//
                  <CALL-POINTS>
                    <BSW-DIRECT-CALL-POINT>
                      <SHORT-NAME>Det</SHORT-NAME>
                      <CALLED-ENTRY-REF DEST="BSW-MODULE-ENTRY">/AUTOSAR_Det/BSWModuleEntry/Det_ReportError</CALLED-ENTRY-REF>
                    </BSW-DIRECT-CALL-POINT>
                  </CALL-POINTS>
                [!ENDIF!][!//
                  <IMPLEMENTED-ENTRY-REF DEST="BSW-MODULE-ENTRY">/Cdd_Pwm_TI_AM263x/Cdd_Pwm_ModuleEntry/Cdd_Pwm_Init</IMPLEMENTED-ENTRY-REF>
                </BSW-CALLED-ENTITY>
              [!IF "as:modconf('Cdd_Pwm')[1]/CddPwmConfigurationOfOptionalApis/CddPwmEnableRegisterReadbackApi"!][!//
                <BSW-CALLED-ENTITY UUID="508f086a-86ac-42a8-8568-a60e02ef9821">
                  <SHORT-NAME>Cdd_Pwm_RegisterReadback</SHORT-NAME>
                  <MINIMUM-START-INTERVAL>0.0</MINIMUM-START-INTERVAL>
                  <REENTRANCY-LEVEL>NON-REENTRANT</REENTRANCY-LEVEL>
                [!IF "as:modconf('Cdd_Pwm')[1]/CddPwmGeneral/CddPwmDevErrorDetect"!][!//
                  <CALL-POINTS>
                    <BSW-DIRECT-CALL-POINT>
                      <SHORT-NAME>Det</SHORT-NAME>
                      <CALLED-ENTRY-REF DEST="BSW-MODULE-ENTRY">/AUTOSAR_Det/BSWModuleEntry/Det_ReportError</CALLED-ENTRY-REF>
                    </BSW-DIRECT-CALL-POINT>
                  </CALL-POINTS>
                [!ENDIF!][!//
                  <IMPLEMENTED-ENTRY-REF DEST="BSW-MODULE-ENTRY">/Cdd_Pwm_TI_AM263x/Cdd_Pwm_ModuleEntry/Cdd_Pwm_RegisterReadback</IMPLEMENTED-ENTRY-REF>
                </BSW-CALLED-ENTITY>
              [!ENDIF!][!//
              [!IF "as:modconf('Cdd_Pwm')[1]/CddPwmConfigurationOfOptionalApis/CddPwmSetAbsoluteThreshold"!][!//
                <BSW-CALLED-ENTITY UUID="c158bc83-0e53-46c3-a40b-78e1fadb8b6c">
                  <SHORT-NAME>Cdd_Pwm_SetAbsoluteThreshold</SHORT-NAME>
                  <CAN-ENTER-EXCLUSIVE-AREA-REFS>
                    <CAN-ENTER-EXCLUSIVE-AREA-REF DEST="EXCLUSIVE-AREA">/Cdd_Pwm_TI_AM263x/Cdd_Pwm/Cdd_Pwm_Behavior/PWM_EXCLUSIVE_AREA_0</CAN-ENTER-EXCLUSIVE-AREA-REF>
                  </CAN-ENTER-EXCLUSIVE-AREA-REFS>
                  <MINIMUM-START-INTERVAL>0.0</MINIMUM-START-INTERVAL>
                  <REENTRANCY-LEVEL>NON-REENTRANT</REENTRANCY-LEVEL>
                [!IF "as:modconf('Cdd_Pwm')[1]/CddPwmGeneral/CddPwmDevErrorDetect"!][!//
                  <CALL-POINTS>
                    <BSW-DIRECT-CALL-POINT>
                      <SHORT-NAME>Det</SHORT-NAME>
                      <CALLED-ENTRY-REF DEST="BSW-MODULE-ENTRY">/AUTOSAR_Det/BSWModuleEntry/Det_ReportError</CALLED-ENTRY-REF>
                    </BSW-DIRECT-CALL-POINT>
                  </CALL-POINTS>
                [!ENDIF!][!//
                  <IMPLEMENTED-ENTRY-REF DEST="BSW-MODULE-ENTRY">/Cdd_Pwm_TI_AM263x/Cdd_Pwm_ModuleEntry/Cdd_Pwm_SetAbsoluteThreshold</IMPLEMENTED-ENTRY-REF>
                </BSW-CALLED-ENTITY>
              [!ENDIF!][!//
              [!IF "as:modconf('Cdd_Pwm')[1]/CddPwmConfigurationOfOptionalApis/CddPwmSetAdcTriggerApi"!][!//
                <BSW-CALLED-ENTITY UUID="f61256e6-7933-462d-b61d-52ecd549fb3a">
                  <SHORT-NAME>Cdd_Pwm_SetAdcTrigger</SHORT-NAME>
                  <CAN-ENTER-EXCLUSIVE-AREA-REFS>
                    <CAN-ENTER-EXCLUSIVE-AREA-REF DEST="EXCLUSIVE-AREA">/Cdd_Pwm_TI_AM263x/Cdd_Pwm/Cdd_Pwm_Behavior/PWM_EXCLUSIVE_AREA_0</CAN-ENTER-EXCLUSIVE-AREA-REF>
                  </CAN-ENTER-EXCLUSIVE-AREA-REFS>
                  <MINIMUM-START-INTERVAL>0.0</MINIMUM-START-INTERVAL>
                  <REENTRANCY-LEVEL>NON-REENTRANT</REENTRANCY-LEVEL>
                  <IMPLEMENTED-ENTRY-REF DEST="BSW-MODULE-ENTRY">/Cdd_Pwm_TI_AM263x/Cdd_Pwm_ModuleEntry/Cdd_Pwm_SetAdcTrigger</IMPLEMENTED-ENTRY-REF>
                </BSW-CALLED-ENTITY>
              [!ENDIF!][!//
              [!IF "as:modconf('Cdd_Pwm')[1]/CddPwmConfigurationOfOptionalApis/CddPwmSetOutputToIdle"!][!//
                <BSW-CALLED-ENTITY UUID="4f74e01d-ac43-4ee7-944f-d3cbfa13a690">
                  <SHORT-NAME>Cdd_Pwm_SetOutputToIdle</SHORT-NAME>
                  <CAN-ENTER-EXCLUSIVE-AREA-REFS>
                    <CAN-ENTER-EXCLUSIVE-AREA-REF DEST="EXCLUSIVE-AREA">/Cdd_Pwm_TI_AM263x/Cdd_Pwm/Cdd_Pwm_Behavior/PWM_EXCLUSIVE_AREA_0</CAN-ENTER-EXCLUSIVE-AREA-REF>
                  </CAN-ENTER-EXCLUSIVE-AREA-REFS>
                  <MINIMUM-START-INTERVAL>0.0</MINIMUM-START-INTERVAL>
                  <REENTRANCY-LEVEL>NON-REENTRANT</REENTRANCY-LEVEL>
                  <IMPLEMENTED-ENTRY-REF DEST="BSW-MODULE-ENTRY">/Cdd_Pwm_TI_AM263x/Cdd_Pwm_ModuleEntry/Cdd_Pwm_SetOutputToIdle</IMPLEMENTED-ENTRY-REF>
                </BSW-CALLED-ENTITY>
              [!ENDIF!][!//
              [!IF "as:modconf('Cdd_Pwm')[1]/CddPwmConfigurationOfOptionalApis/CddPwmSetPeriodDutyPhase"!][!//
                <BSW-CALLED-ENTITY UUID="d90607d3-fbd8-4420-bed7-1d6501b4c5be">
                  <SHORT-NAME>Cdd_Pwm_SetPeriodDutyPhase</SHORT-NAME>
                  <CAN-ENTER-EXCLUSIVE-AREA-REFS>
                    <CAN-ENTER-EXCLUSIVE-AREA-REF DEST="EXCLUSIVE-AREA">/Cdd_Pwm_TI_AM263x/Cdd_Pwm/Cdd_Pwm_Behavior/PWM_EXCLUSIVE_AREA_0</CAN-ENTER-EXCLUSIVE-AREA-REF>
                  </CAN-ENTER-EXCLUSIVE-AREA-REFS>
                  <MINIMUM-START-INTERVAL>0.0</MINIMUM-START-INTERVAL>
                  <REENTRANCY-LEVEL>NON-REENTRANT</REENTRANCY-LEVEL>
                  <IMPLEMENTED-ENTRY-REF DEST="BSW-MODULE-ENTRY">/Cdd_Pwm_TI_AM263x/Cdd_Pwm_ModuleEntry/Cdd_Pwm_SetPeriodDutyPhase</IMPLEMENTED-ENTRY-REF>
                </BSW-CALLED-ENTITY>
				<BSW-CALLED-ENTITY UUID="82f02cdb-5de9-49b5-b509-dbcbc3540e2b">
                  <SHORT-NAME>Cdd_Pwm_SetTimeBaseCounterMode</SHORT-NAME>
                  <CAN-ENTER-EXCLUSIVE-AREA-REFS>
                    <CAN-ENTER-EXCLUSIVE-AREA-REF DEST="EXCLUSIVE-AREA">/Cdd_Pwm_TI_AM263x/Cdd_Pwm/Cdd_Pwm_Behavior/PWM_EXCLUSIVE_AREA_0</CAN-ENTER-EXCLUSIVE-AREA-REF>
                  </CAN-ENTER-EXCLUSIVE-AREA-REFS>
                  <MINIMUM-START-INTERVAL>0.0</MINIMUM-START-INTERVAL>
                  <REENTRANCY-LEVEL>NON-REENTRANT</REENTRANCY-LEVEL>
                  <IMPLEMENTED-ENTRY-REF DEST="BSW-MODULE-ENTRY">/Cdd_Pwm_TI_AM263x/Cdd_Pwm_ModuleEntry/Cdd_Pwm_SetTimeBaseCounterMode</IMPLEMENTED-ENTRY-REF>
                </BSW-CALLED-ENTITY>
				<BSW-CALLED-ENTITY UUID="131289e5-89bc-4668-8775-2a01d8da2a54">
                  <SHORT-NAME>Cdd_Pwm_SetPhaseShift</SHORT-NAME>
                  <MINIMUM-START-INTERVAL>0.0</MINIMUM-START-INTERVAL>
                  <REENTRANCY-LEVEL>NON-REENTRANT</REENTRANCY-LEVEL>
                  <IMPLEMENTED-ENTRY-REF DEST="BSW-MODULE-ENTRY">/Cdd_Pwm_TI_AM263x/Cdd_Pwm_ModuleEntry/Cdd_Pwm_SetPhaseShift</IMPLEMENTED-ENTRY-REF>
                </BSW-CALLED-ENTITY>
				<BSW-CALLED-ENTITY UUID="9158c995-3205-4ee6-bddb-8a43aa2c4f1f">
                  <SHORT-NAME>Cdd_Pwm_SetTimeBasePeriod</SHORT-NAME>
                 <REENTRANCY-LEVEL>NON-REENTRANT</REENTRANCY-LEVEL>
                  <IMPLEMENTED-ENTRY-REF DEST="BSW-MODULE-ENTRY">/Cdd_Pwm_TI_AM263x/Cdd_Pwm_ModuleEntry/Cdd_Pwm_SetTimeBasePeriod</IMPLEMENTED-ENTRY-REF>
                </BSW-CALLED-ENTITY>
				<BSW-CALLED-ENTITY UUID="08e131fe-93cd-4312-940a-f26a84a73118">
                  <SHORT-NAME>Cdd_Pwm_SetCounterCompareValue</SHORT-NAME>
                  <MINIMUM-START-INTERVAL>0.0</MINIMUM-START-INTERVAL>
                  <REENTRANCY-LEVEL>NON-REENTRANT</REENTRANCY-LEVEL>
                  <IMPLEMENTED-ENTRY-REF DEST="BSW-MODULE-ENTRY">/Cdd_Pwm_TI_AM263x/Cdd_Pwm_ModuleEntry/Cdd_Pwm_SetCounterCompareValue</IMPLEMENTED-ENTRY-REF>
                </BSW-CALLED-ENTITY>
				<BSW-CALLED-ENTITY UUID="329188c1-f8d0-498c-9175-dbc200c16f45">
                  <SHORT-NAME>Cdd_Pwm_SetXcmpRegValue</SHORT-NAME>
                  <MINIMUM-START-INTERVAL>0.0</MINIMUM-START-INTERVAL>
                  <REENTRANCY-LEVEL>NON-REENTRANT</REENTRANCY-LEVEL>
                  <IMPLEMENTED-ENTRY-REF DEST="BSW-MODULE-ENTRY">/Cdd_Pwm_TI_AM263x/Cdd_Pwm_ModuleEntry/Cdd_Pwm_SetXcmpRegValue</IMPLEMENTED-ENTRY-REF>
                </BSW-CALLED-ENTITY>
				<BSW-CALLED-ENTITY UUID="79701442-d705-4552-9212-1477ef6419a2">
                  <SHORT-NAME>Cdd_Pwm_SetXMinMaxRegValue</SHORT-NAME>
                  <MINIMUM-START-INTERVAL>0.0</MINIMUM-START-INTERVAL>
                  <REENTRANCY-LEVEL>NON-REENTRANT</REENTRANCY-LEVEL>
                  <IMPLEMENTED-ENTRY-REF DEST="BSW-MODULE-ENTRY">/Cdd_Pwm_TI_AM263x/Cdd_Pwm_ModuleEntry/Cdd_Pwm_SetXMinMaxRegValue</IMPLEMENTED-ENTRY-REF>
                </BSW-CALLED-ENTITY>
				<BSW-CALLED-ENTITY UUID="710a7c0c-9ea2-46f5-9e64-d9469da77436">
                  <SHORT-NAME>Cdd_Pwm_SetCmpShadowRegValue</SHORT-NAME>
                  <MINIMUM-START-INTERVAL>0.0</MINIMUM-START-INTERVAL>
                  <REENTRANCY-LEVEL>NON-REENTRANT</REENTRANCY-LEVEL>
                  <IMPLEMENTED-ENTRY-REF DEST="BSW-MODULE-ENTRY">/Cdd_Pwm_TI_AM263x/Cdd_Pwm_ModuleEntry/Cdd_Pwm_SetCmpShadowRegValue</IMPLEMENTED-ENTRY-REF>
                </BSW-CALLED-ENTITY>
              [!ENDIF!][!//
              [!IF "as:modconf('Cdd_Pwm')[1]/CddPwmConfigurationOfOptionalApis/CddPwmSetPinAction"!][!//
                <BSW-CALLED-ENTITY UUID="9eca406e-d2c4-4641-bbce-300b2ce003bc">
                  <SHORT-NAME>Cdd_Pwm_SetPinAction</SHORT-NAME>
                  <CAN-ENTER-EXCLUSIVE-AREA-REFS>
                    <CAN-ENTER-EXCLUSIVE-AREA-REF DEST="EXCLUSIVE-AREA">/Cdd_Pwm_TI_AM263x/Cdd_Pwm/Cdd_Pwm_Behavior/PWM_EXCLUSIVE_AREA_0</CAN-ENTER-EXCLUSIVE-AREA-REF>
                  </CAN-ENTER-EXCLUSIVE-AREA-REFS>
                  <MINIMUM-START-INTERVAL>0.0</MINIMUM-START-INTERVAL>
                  <REENTRANCY-LEVEL>NON-REENTRANT</REENTRANCY-LEVEL>
                [!IF "as:modconf('Cdd_Pwm')[1]/CddPwmGeneral/CddPwmDevErrorDetect"!][!//
                  <CALL-POINTS>
                    <BSW-DIRECT-CALL-POINT>
                      <SHORT-NAME>Det</SHORT-NAME>
                      <CALLED-ENTRY-REF DEST="BSW-MODULE-ENTRY">/AUTOSAR_Det/BSWModuleEntry/Det_ReportError</CALLED-ENTRY-REF>
                    </BSW-DIRECT-CALL-POINT>
                  </CALL-POINTS>
                [!ENDIF!][!//
                  <IMPLEMENTED-ENTRY-REF DEST="BSW-MODULE-ENTRY">/Cdd_Pwm_TI_AM263x/Cdd_Pwm_ModuleEntry/Cdd_Pwm_SetPinAction</IMPLEMENTED-ENTRY-REF>
                </BSW-CALLED-ENTITY>
              [!ENDIF!][!//
              [!IF "as:modconf('Cdd_Pwm')[1]/CddPwmConfigurationOfOptionalApis/CddPwmSetRelativeThreshold"!][!//
                <BSW-CALLED-ENTITY UUID="7b025bd2-27e1-45cc-8165-c95f5f2bb02a">
                  <SHORT-NAME>Cdd_Pwm_SetRelativeThreshold</SHORT-NAME>
                  <CAN-ENTER-EXCLUSIVE-AREA-REFS>
                    <CAN-ENTER-EXCLUSIVE-AREA-REF DEST="EXCLUSIVE-AREA">/Cdd_Pwm_TI_AM263x/Cdd_Pwm/Cdd_Pwm_Behavior/PWM_EXCLUSIVE_AREA_0</CAN-ENTER-EXCLUSIVE-AREA-REF>
                  </CAN-ENTER-EXCLUSIVE-AREA-REFS>
                  <MINIMUM-START-INTERVAL>0.0</MINIMUM-START-INTERVAL>
                  <REENTRANCY-LEVEL>NON-REENTRANT</REENTRANCY-LEVEL>
                [!IF "as:modconf('Cdd_Pwm')[1]/CddPwmGeneral/CddPwmDevErrorDetect"!][!//
                  <CALL-POINTS>
                    <BSW-DIRECT-CALL-POINT>
                      <SHORT-NAME>Det</SHORT-NAME>
                      <CALLED-ENTRY-REF DEST="BSW-MODULE-ENTRY">/AUTOSAR_Det/BSWModuleEntry/Det_ReportError</CALLED-ENTRY-REF>
                    </BSW-DIRECT-CALL-POINT>
                  </CALL-POINTS>
                [!ENDIF!][!//
                  <IMPLEMENTED-ENTRY-REF DEST="BSW-MODULE-ENTRY">/Cdd_Pwm_TI_AM263x/Cdd_Pwm_ModuleEntry/Cdd_Pwm_SetRelativeThreshold</IMPLEMENTED-ENTRY-REF>
                </BSW-CALLED-ENTITY>
              [!ENDIF!][!//
                <BSW-CALLED-ENTITY UUID="40fcff0f-1b4b-4f45-bc6e-58340ab8716e">
                  <SHORT-NAME>Cdd_Pwm_StartChannelCounter</SHORT-NAME>
                  <CAN-ENTER-EXCLUSIVE-AREA-REFS>
                    <CAN-ENTER-EXCLUSIVE-AREA-REF DEST="EXCLUSIVE-AREA">/Cdd_Pwm_TI_AM263x/Cdd_Pwm/Cdd_Pwm_Behavior/PWM_EXCLUSIVE_AREA_0</CAN-ENTER-EXCLUSIVE-AREA-REF>
                  </CAN-ENTER-EXCLUSIVE-AREA-REFS>
                  <MINIMUM-START-INTERVAL>0.0</MINIMUM-START-INTERVAL>
                  <REENTRANCY-LEVEL>NON-REENTRANT</REENTRANCY-LEVEL>
                [!IF "as:modconf('Cdd_Pwm')[1]/CddPwmGeneral/CddPwmDevErrorDetect"!][!//
                  <CALL-POINTS>
                    <BSW-DIRECT-CALL-POINT>
                      <SHORT-NAME>Det</SHORT-NAME>
                      <CALLED-ENTRY-REF DEST="BSW-MODULE-ENTRY">/AUTOSAR_Det/BSWModuleEntry/Det_ReportError</CALLED-ENTRY-REF>
                    </BSW-DIRECT-CALL-POINT>
                  </CALL-POINTS>
                [!ENDIF!][!//
                  <IMPLEMENTED-ENTRY-REF DEST="BSW-MODULE-ENTRY">/Cdd_Pwm_TI_AM263x/Cdd_Pwm_ModuleEntry/Cdd_Pwm_StartChannelCounter</IMPLEMENTED-ENTRY-REF>
                </BSW-CALLED-ENTITY>
                <BSW-CALLED-ENTITY UUID="fe928960-e375-49b9-bb4c-e784faf7fa12">
                  <SHORT-NAME>Cdd_Pwm_StopChannelCounter</SHORT-NAME>
                  <CAN-ENTER-EXCLUSIVE-AREA-REFS>
                    <CAN-ENTER-EXCLUSIVE-AREA-REF DEST="EXCLUSIVE-AREA">/Cdd_Pwm_TI_AM263x/Cdd_Pwm/Cdd_Pwm_Behavior/PWM_EXCLUSIVE_AREA_0</CAN-ENTER-EXCLUSIVE-AREA-REF>
                  </CAN-ENTER-EXCLUSIVE-AREA-REFS>
                  <MINIMUM-START-INTERVAL>0.0</MINIMUM-START-INTERVAL>
                  <REENTRANCY-LEVEL>NON-REENTRANT</REENTRANCY-LEVEL>
                [!IF "as:modconf('Cdd_Pwm')[1]/CddPwmGeneral/CddPwmDevErrorDetect"!][!//
                  <CALL-POINTS>
                    <BSW-DIRECT-CALL-POINT>
                      <SHORT-NAME>Det</SHORT-NAME>
                      <CALLED-ENTRY-REF DEST="BSW-MODULE-ENTRY">/AUTOSAR_Det/BSWModuleEntry/Det_ReportError</CALLED-ENTRY-REF>
                    </BSW-DIRECT-CALL-POINT>
                  </CALL-POINTS>
                [!ENDIF!][!//
                  <IMPLEMENTED-ENTRY-REF DEST="BSW-MODULE-ENTRY">/Cdd_Pwm_TI_AM263x/Cdd_Pwm_ModuleEntry/Cdd_Pwm_StopChannelCounter</IMPLEMENTED-ENTRY-REF>
                </BSW-CALLED-ENTITY>
              [!IF "as:modconf('Cdd_Pwm')[1]/CddPwmGeneral/CddPwmChannelTimerBaseSyncEnable"!][!//
                <BSW-CALLED-ENTITY UUID="9663c1a2-f5d6-413f-b35f-1fbd2fdc941a">
                  <SHORT-NAME>Cdd_Pwm_SyncDisable</SHORT-NAME>
                  <CAN-ENTER-EXCLUSIVE-AREA-REFS>
                    <CAN-ENTER-EXCLUSIVE-AREA-REF DEST="EXCLUSIVE-AREA">/Cdd_Pwm_TI_AM263x/Cdd_Pwm/Cdd_Pwm_Behavior/PWM_EXCLUSIVE_AREA_0</CAN-ENTER-EXCLUSIVE-AREA-REF>
                  </CAN-ENTER-EXCLUSIVE-AREA-REFS>
                  <MINIMUM-START-INTERVAL>0.0</MINIMUM-START-INTERVAL>
                  <REENTRANCY-LEVEL>NON-REENTRANT</REENTRANCY-LEVEL>
                  <IMPLEMENTED-ENTRY-REF DEST="BSW-MODULE-ENTRY">/Cdd_Pwm_TI_AM263x/Cdd_Pwm_ModuleEntry/Cdd_Pwm_SyncDisable</IMPLEMENTED-ENTRY-REF>
                </BSW-CALLED-ENTITY>
                <BSW-CALLED-ENTITY UUID="523b37df-3e8b-4a58-be88-dab5d626c953">
                  <SHORT-NAME>Cdd_Pwm_SyncEnable</SHORT-NAME>
                  <CAN-ENTER-EXCLUSIVE-AREA-REFS>
                    <CAN-ENTER-EXCLUSIVE-AREA-REF DEST="EXCLUSIVE-AREA">/Cdd_Pwm_TI_AM263x/Cdd_Pwm/Cdd_Pwm_Behavior/PWM_EXCLUSIVE_AREA_0</CAN-ENTER-EXCLUSIVE-AREA-REF>
                  </CAN-ENTER-EXCLUSIVE-AREA-REFS>
                  <MINIMUM-START-INTERVAL>0.0</MINIMUM-START-INTERVAL>
                  <REENTRANCY-LEVEL>NON-REENTRANT</REENTRANCY-LEVEL>
                  <IMPLEMENTED-ENTRY-REF DEST="BSW-MODULE-ENTRY">/Cdd_Pwm_TI_AM263x/Cdd_Pwm_ModuleEntry/Cdd_Pwm_SyncEnable</IMPLEMENTED-ENTRY-REF>
                </BSW-CALLED-ENTITY>
              [!ENDIF!][!//
              [!IF "as:modconf('Cdd_Pwm')[1]/CddPwmGeneral/CddPwmTripZoneEnable"!][!//
                <BSW-CALLED-ENTITY UUID="951d00f8-94e9-4c70-ad39-03680c6c0768">
                  <SHORT-NAME>Cdd_Pwm_TzEventStatusClear</SHORT-NAME>
                  <CAN-ENTER-EXCLUSIVE-AREA-REFS>
                    <CAN-ENTER-EXCLUSIVE-AREA-REF DEST="EXCLUSIVE-AREA">/Cdd_Pwm_TI_AM263x/Cdd_Pwm/Cdd_Pwm_Behavior/PWM_EXCLUSIVE_AREA_0</CAN-ENTER-EXCLUSIVE-AREA-REF>
                  </CAN-ENTER-EXCLUSIVE-AREA-REFS>
                  <MINIMUM-START-INTERVAL>0.0</MINIMUM-START-INTERVAL>
                  <REENTRANCY-LEVEL>NON-REENTRANT</REENTRANCY-LEVEL>
                  <IMPLEMENTED-ENTRY-REF DEST="BSW-MODULE-ENTRY">/Cdd_Pwm_TI_AM263x/Cdd_Pwm_ModuleEntry/Cdd_Pwm_TzEventStatusClear</IMPLEMENTED-ENTRY-REF>
                </BSW-CALLED-ENTITY>
                <BSW-CALLED-ENTITY UUID="ae8f2add-349c-46e9-89ef-d5960da9dd5d">
                  <SHORT-NAME>Cdd_Pwm_TzGetEventStatus</SHORT-NAME>
                  <CAN-ENTER-EXCLUSIVE-AREA-REFS>
                    <CAN-ENTER-EXCLUSIVE-AREA-REF DEST="EXCLUSIVE-AREA">/Cdd_Pwm_TI_AM263x/Cdd_Pwm/Cdd_Pwm_Behavior/PWM_EXCLUSIVE_AREA_0</CAN-ENTER-EXCLUSIVE-AREA-REF>
                  </CAN-ENTER-EXCLUSIVE-AREA-REFS>
                  <MINIMUM-START-INTERVAL>0.0</MINIMUM-START-INTERVAL>
                  <REENTRANCY-LEVEL>NON-REENTRANT</REENTRANCY-LEVEL>
                  <IMPLEMENTED-ENTRY-REF DEST="BSW-MODULE-ENTRY">/Cdd_Pwm_TI_AM263x/Cdd_Pwm_ModuleEntry/Cdd_Pwm_TzGetEventStatus</IMPLEMENTED-ENTRY-REF>
                </BSW-CALLED-ENTITY>
                <BSW-CALLED-ENTITY UUID="68c4cf4b-264e-4d24-a6c3-5dab2fab6ebc">
                  <SHORT-NAME>Cdd_Pwm_TzIntrDisable</SHORT-NAME>
                  <CAN-ENTER-EXCLUSIVE-AREA-REFS>
                    <CAN-ENTER-EXCLUSIVE-AREA-REF DEST="EXCLUSIVE-AREA">/Cdd_Pwm_TI_AM263x/Cdd_Pwm/Cdd_Pwm_Behavior/PWM_EXCLUSIVE_AREA_0</CAN-ENTER-EXCLUSIVE-AREA-REF>
                  </CAN-ENTER-EXCLUSIVE-AREA-REFS>
                  <MINIMUM-START-INTERVAL>0.0</MINIMUM-START-INTERVAL>
                  <REENTRANCY-LEVEL>NON-REENTRANT</REENTRANCY-LEVEL>
                  <IMPLEMENTED-ENTRY-REF DEST="BSW-MODULE-ENTRY">/Cdd_Pwm_TI_AM263x/Cdd_Pwm_ModuleEntry/Cdd_Pwm_TzIntrDisable</IMPLEMENTED-ENTRY-REF>
                </BSW-CALLED-ENTITY>
                <BSW-CALLED-ENTITY UUID="5e35c388-c7c4-46d9-bc72-872a02ab9034">
                  <SHORT-NAME>Cdd_Pwm_TzIntrEnable</SHORT-NAME>
                  <CAN-ENTER-EXCLUSIVE-AREA-REFS>
                    <CAN-ENTER-EXCLUSIVE-AREA-REF DEST="EXCLUSIVE-AREA">/Cdd_Pwm_TI_AM263x/Cdd_Pwm/Cdd_Pwm_Behavior/PWM_EXCLUSIVE_AREA_0</CAN-ENTER-EXCLUSIVE-AREA-REF>
                  </CAN-ENTER-EXCLUSIVE-AREA-REFS>
                  <MINIMUM-START-INTERVAL>0.0</MINIMUM-START-INTERVAL>
                  <REENTRANCY-LEVEL>NON-REENTRANT</REENTRANCY-LEVEL>
                  <IMPLEMENTED-ENTRY-REF DEST="BSW-MODULE-ENTRY">/Cdd_Pwm_TI_AM263x/Cdd_Pwm_ModuleEntry/Cdd_Pwm_TzIntrEnable</IMPLEMENTED-ENTRY-REF>
                </BSW-CALLED-ENTITY>
                <BSW-CALLED-ENTITY UUID="aa65507d-6d88-4199-9648-2da92576bfeb">
                  <SHORT-NAME>Cdd_Pwm_TzTripEventDisable</SHORT-NAME>
                  <CAN-ENTER-EXCLUSIVE-AREA-REFS>
                    <CAN-ENTER-EXCLUSIVE-AREA-REF DEST="EXCLUSIVE-AREA">/Cdd_Pwm_TI_AM263x/Cdd_Pwm/Cdd_Pwm_Behavior/PWM_EXCLUSIVE_AREA_0</CAN-ENTER-EXCLUSIVE-AREA-REF>
                  </CAN-ENTER-EXCLUSIVE-AREA-REFS>
                  <MINIMUM-START-INTERVAL>0.0</MINIMUM-START-INTERVAL>
                  <REENTRANCY-LEVEL>NON-REENTRANT</REENTRANCY-LEVEL>
                  <IMPLEMENTED-ENTRY-REF DEST="BSW-MODULE-ENTRY">/Cdd_Pwm_TI_AM263x/Cdd_Pwm_ModuleEntry/Cdd_Pwm_TzTripEventDisable</IMPLEMENTED-ENTRY-REF>
                </BSW-CALLED-ENTITY>
                <BSW-CALLED-ENTITY UUID="85fa4a4c-6909-409b-ba7b-25c6b397edc3">
                  <SHORT-NAME>Cdd_Pwm_TzTripEventEnable</SHORT-NAME>
                  <CAN-ENTER-EXCLUSIVE-AREA-REFS>
                    <CAN-ENTER-EXCLUSIVE-AREA-REF DEST="EXCLUSIVE-AREA">/Cdd_Pwm_TI_AM263x/Cdd_Pwm/Cdd_Pwm_Behavior/PWM_EXCLUSIVE_AREA_0</CAN-ENTER-EXCLUSIVE-AREA-REF>
                  </CAN-ENTER-EXCLUSIVE-AREA-REFS>
                  <MINIMUM-START-INTERVAL>0.0</MINIMUM-START-INTERVAL>
                  <REENTRANCY-LEVEL>NON-REENTRANT</REENTRANCY-LEVEL>
                  <IMPLEMENTED-ENTRY-REF DEST="BSW-MODULE-ENTRY">/Cdd_Pwm_TI_AM263x/Cdd_Pwm_ModuleEntry/Cdd_Pwm_TzTripEventEnable</IMPLEMENTED-ENTRY-REF>
                </BSW-CALLED-ENTITY>
              [!ENDIF!][!//
              </ENTITYS>
            </BSW-INTERNAL-BEHAVIOR>
          </INTERNAL-BEHAVIORS>
        </BSW-MODULE-DESCRIPTION>
        <BSW-IMPLEMENTATION UUID="cc33dd8f-80cf-47fa-9ed8-e24a1db642c0">
          <SHORT-NAME>Cdd_Pwm_Impl</SHORT-NAME>
          <CODE-DESCRIPTORS>
            <CODE UUID="b02309de-2d1b-4e61-b9fa-000c32cda425">
              <SHORT-NAME>Files</SHORT-NAME>
              <ARTIFACT-DESCRIPTORS>
                <AUTOSAR-ENGINEERING-OBJECT>
                  <SHORT-LABEL>V0::Cdd_Pwm_Priv.c</SHORT-LABEL>
                  <CATEGORY>SWSRC</CATEGORY>
                </AUTOSAR-ENGINEERING-OBJECT>
                <AUTOSAR-ENGINEERING-OBJECT>
                  <SHORT-LABEL>V0::Cdd_Pwm_Priv.h</SHORT-LABEL>
                  <CATEGORY>SWHDR</CATEGORY>
                </AUTOSAR-ENGINEERING-OBJECT>
                <AUTOSAR-ENGINEERING-OBJECT>
                  <SHORT-LABEL>V0::Cdd_Pwm_Sfo.c</SHORT-LABEL>
                  <CATEGORY>SWSRC</CATEGORY>
                </AUTOSAR-ENGINEERING-OBJECT>
                <AUTOSAR-ENGINEERING-OBJECT>
                  <SHORT-LABEL>V0::Cdd_Pwm_Sfo.h</SHORT-LABEL>
                  <CATEGORY>SWHDR</CATEGORY>
                </AUTOSAR-ENGINEERING-OBJECT>
                <AUTOSAR-ENGINEERING-OBJECT>
                  <SHORT-LABEL>V0::Cdd_Pwm_Types.h</SHORT-LABEL>
                  <CATEGORY>SWHDR</CATEGORY>
                </AUTOSAR-ENGINEERING-OBJECT>
                <AUTOSAR-ENGINEERING-OBJECT>
                  <SHORT-LABEL>generate::include::Cdd_Pwm_Cfg.h</SHORT-LABEL>
                  <CATEGORY>SWHDR</CATEGORY>
                </AUTOSAR-ENGINEERING-OBJECT>
                <AUTOSAR-ENGINEERING-OBJECT>
                  <SHORT-LABEL>generate::src::Cdd_Pwm_Cfg.c</SHORT-LABEL>
                  <CATEGORY>SWSRC</CATEGORY>
                </AUTOSAR-ENGINEERING-OBJECT>
                <AUTOSAR-ENGINEERING-OBJECT>
                  <SHORT-LABEL>generate::src::Cdd_Pwm_PBcfg.c</SHORT-LABEL>
                  <CATEGORY>SWSRC</CATEGORY>
                </AUTOSAR-ENGINEERING-OBJECT>
                <AUTOSAR-ENGINEERING-OBJECT >
                  <SHORT-LABEL>include::Cdd_Pwm.h</SHORT-LABEL>
                  <CATEGORY>SWHDR</CATEGORY>
                </AUTOSAR-ENGINEERING-OBJECT>
                <AUTOSAR-ENGINEERING-OBJECT >
                  <SHORT-LABEL>include::Cdd_Pwm_Irq.h</SHORT-LABEL>
                  <CATEGORY>SWHDR</CATEGORY>
                </AUTOSAR-ENGINEERING-OBJECT>
                <AUTOSAR-ENGINEERING-OBJECT >
                  <SHORT-LABEL>src::Cdd_Pwm.c</SHORT-LABEL>
                  <CATEGORY>SWSRC</CATEGORY>
                </AUTOSAR-ENGINEERING-OBJECT>
                <AUTOSAR-ENGINEERING-OBJECT >
                  <SHORT-LABEL>src::Cdd_Pwm_Irq.c</SHORT-LABEL>
                  <CATEGORY>SWSRC</CATEGORY>
                </AUTOSAR-ENGINEERING-OBJECT>
              </ARTIFACT-DESCRIPTORS>
            </CODE>
          </CODE-DESCRIPTORS>
          <COMPILERS>
            <COMPILER UUID="7f61c28e-a1d4-4078-8bbf-b064cd0545c0">
              <SHORT-NAME>tiarmclang</SHORT-NAME>
              <NAME>TI ARM Clang</NAME>
              <OPTIONS>-mcpu=cortex-r5  -mfpu=vfpv3-d16  -mfloat-abi=hard  -c  -mlittle-endian  -ffunction-sections  -gdwarf-3  -Werror -Os  -x  -save-temps  -mthumb   -DAM263X_PLATFORM </OPTIONS>
              <VENDOR>Texas Instruments</VENDOR>
              <VERSION>4.0.0</VERSION>
            </COMPILER>
          </COMPILERS>
          <LINKERS>
            <LINKER UUID="05364379-d017-40bd-9eb9-1a2d126f452a">
              <SHORT-NAME>tiarmlnk</SHORT-NAME>
              <NAME>TI ARM Clang Linker</NAME>
              <OPTIONS>-mcpu=cortex-r5  -Wl,--ram_model  -Wl,--reread_libs  -Wl,--warn_sections  -qq -Wl,--emit_warnings_as_errors --diag_suppress=10068 --diag_suppress=10063 </OPTIONS>
              <VENDOR>Texas Instruments</VENDOR>
              <VERSION>4.0.0</VERSION>
            </LINKER>
          </LINKERS>
          <PROGRAMMING-LANGUAGE>C</PROGRAMMING-LANGUAGE>
          <RESOURCE-CONSUMPTION UUID="22128554-218b-4292-ac2b-1626b4763ead">
            <SHORT-NAME>ResourceConsumption</SHORT-NAME>
            <MEMORY-SECTIONS>
              <MEMORY-SECTION UUID="4c826e67-6476-4788-b058-fd92006b8ae5">
                <SHORT-NAME>CDD_PWM_CODE</SHORT-NAME>
                <ALIGNMENT>UNSPECIFIED</ALIGNMENT>
                <SW-ADDRMETHOD-REF DEST="SW-ADDR-METHOD">/AUTOSAR_MemMap/SwAddrMethods/CODE</SW-ADDRMETHOD-REF>
                <SYMBOL>CODE</SYMBOL>
              </MEMORY-SECTION>
              <MEMORY-SECTION UUID="d8338c0f-e61b-419f-83e4-03cc136cf0b7">
                <SHORT-NAME>CDD_PWM_CONFIG_DATA</SHORT-NAME>
                <ALIGNMENT>UNSPECIFIED</ALIGNMENT>
                <SW-ADDRMETHOD-REF DEST="SW-ADDR-METHOD">/AUTOSAR_MemMap/SwAddrMethods/CONFIG_DATA</SW-ADDRMETHOD-REF>
                <SYMBOL>CONFIG_DATA</SYMBOL>
              </MEMORY-SECTION>
              <MEMORY-SECTION UUID="93687055-40a3-4072-b10b-778f86629908">
                <SHORT-NAME>CDD_PWM_ISR_CODE</SHORT-NAME>
                <ALIGNMENT>UNSPECIFIED</ALIGNMENT>
                <SW-ADDRMETHOD-REF DEST="SW-ADDR-METHOD">/AUTOSAR_MemMap/SwAddrMethods/CODE</SW-ADDRMETHOD-REF>
                <SYMBOL>ISR_CODE</SYMBOL>
              </MEMORY-SECTION>
              <MEMORY-SECTION UUID="ec1fe966-a905-4888-9d74-1d1a0993b3f6">
                <SHORT-NAME>CDD_PWM_VAR_INIT_8</SHORT-NAME>
                <ALIGNMENT>8</ALIGNMENT>
                <SW-ADDRMETHOD-REF DEST="SW-ADDR-METHOD">/AUTOSAR_MemMap/SwAddrMethods/VAR_INIT</SW-ADDRMETHOD-REF>
                <SYMBOL>VAR_INIT_8</SYMBOL>
              </MEMORY-SECTION>
              <MEMORY-SECTION UUID="dd5db64e-5c4f-4fdd-9ec1-7919257d8e44">
                <SHORT-NAME>CDD_PWM_VAR_INIT_32</SHORT-NAME>
                <ALIGNMENT>32</ALIGNMENT>
                <SW-ADDRMETHOD-REF DEST="SW-ADDR-METHOD">/AUTOSAR_MemMap/SwAddrMethods/VAR_INIT</SW-ADDRMETHOD-REF>
                <SYMBOL>VAR_INIT_32</SYMBOL>
              </MEMORY-SECTION>
              <MEMORY-SECTION UUID="1cde4bec-c10a-4481-a08d-21e5a26af1bc">
                <SHORT-NAME>CDD_PWM_VAR_NO_INIT_16</SHORT-NAME>
                <ALIGNMENT>16</ALIGNMENT>
                <SW-ADDRMETHOD-REF DEST="SW-ADDR-METHOD">/AUTOSAR_MemMap/SwAddrMethods/VAR_NO_INIT</SW-ADDRMETHOD-REF>
                <SYMBOL>VAR_NO_INIT_16</SYMBOL>
              </MEMORY-SECTION>
              <MEMORY-SECTION UUID="1617d28c-19a1-49aa-898e-b310d4776473">
                <SHORT-NAME>CDD_PWM_VAR_NO_INIT_32</SHORT-NAME>
                <ALIGNMENT>32</ALIGNMENT>
                <SW-ADDRMETHOD-REF DEST="SW-ADDR-METHOD">/AUTOSAR_MemMap/SwAddrMethods/VAR_NO_INIT</SW-ADDRMETHOD-REF>
                <SYMBOL>VAR_NO_INIT_32</SYMBOL>
              </MEMORY-SECTION>
              <MEMORY-SECTION UUID="04ad2ea7-5be0-440f-9b0d-0fed27309530">
                <SHORT-NAME>CDD_PWM_VAR_NO_INIT_UNSPECIFIED</SHORT-NAME>
                <ALIGNMENT>UNSPECIFIED</ALIGNMENT>
                <SW-ADDRMETHOD-REF DEST="SW-ADDR-METHOD">/AUTOSAR_MemMap/SwAddrMethods/VAR_NO_INIT</SW-ADDRMETHOD-REF>
                <SYMBOL>VAR_NO_INIT_UNSPECIFIED</SYMBOL>
              </MEMORY-SECTION>
            </MEMORY-SECTIONS>
          </RESOURCE-CONSUMPTION>
          <SW-VERSION>10.01.00</SW-VERSION>
          <VENDOR-ID>44</VENDOR-ID>
          <AR-RELEASE-VERSION>4.3.1</AR-RELEASE-VERSION>
          <BEHAVIOR-REF DEST="BSW-INTERNAL-BEHAVIOR">/Cdd_Pwm_TI_AM263x/Cdd_Pwm/Cdd_Pwm_Behavior</BEHAVIOR-REF>
          <VENDOR-SPECIFIC-MODULE-DEF-REFS>
            <VENDOR-SPECIFIC-MODULE-DEF-REF DEST="ECUC-MODULE-DEF">/TI_AM263x/Cdd_Pwm</VENDOR-SPECIFIC-MODULE-DEF-REF>
          </VENDOR-SPECIFIC-MODULE-DEF-REFS>
        </BSW-IMPLEMENTATION>
      </ELEMENTS>
      <AR-PACKAGES>
        <AR-PACKAGE UUID="c9c81047-9c3c-4f57-9165-ee3f5f3aeb01">
          <SHORT-NAME>Cdd_Pwm_ModuleEntry</SHORT-NAME>
          <ELEMENTS>
            <BSW-MODULE-ENTRY UUID="47d99437-781a-45b2-ae46-e66d982aae30">
              <SHORT-NAME>Cdd_Pwm_ChopperCfg</SHORT-NAME>
              <SERVICE-ID>18</SERVICE-ID>
              <IS-REENTRANT>false</IS-REENTRANT>
              <IS-SYNCHRONOUS>true</IS-SYNCHRONOUS>
              <CALL-TYPE>REGULAR</CALL-TYPE>
              <EXECUTION-CONTEXT>UNSPECIFIED</EXECUTION-CONTEXT>
              <SW-SERVICE-IMPL-POLICY>STANDARD</SW-SERVICE-IMPL-POLICY>
              <BSW-ENTRY-KIND>CONCRETE</BSW-ENTRY-KIND>
            </BSW-MODULE-ENTRY>
            <BSW-MODULE-ENTRY UUID="13633508-73a4-41fa-8c0f-4cef2b920b02">
              <SHORT-NAME>Cdd_Pwm_ChopperEnable</SHORT-NAME>
              <SERVICE-ID>19</SERVICE-ID>
              <IS-REENTRANT>false</IS-REENTRANT>
              <IS-SYNCHRONOUS>true</IS-SYNCHRONOUS>
              <CALL-TYPE>REGULAR</CALL-TYPE>
              <EXECUTION-CONTEXT>UNSPECIFIED</EXECUTION-CONTEXT>
              <SW-SERVICE-IMPL-POLICY>STANDARD</SW-SERVICE-IMPL-POLICY>
              <BSW-ENTRY-KIND>CONCRETE</BSW-ENTRY-KIND>
            </BSW-MODULE-ENTRY>
            <BSW-MODULE-ENTRY UUID="4d820b96-18ad-4a10-a1af-743bbeec8044">
              <SHORT-NAME>Cdd_Pwm_ClearCounterStatus</SHORT-NAME>
              <SERVICE-ID>21</SERVICE-ID>
              <IS-REENTRANT>false</IS-REENTRANT>
              <IS-SYNCHRONOUS>true</IS-SYNCHRONOUS>
              <CALL-TYPE>REGULAR</CALL-TYPE>
              <EXECUTION-CONTEXT>UNSPECIFIED</EXECUTION-CONTEXT>
              <SW-SERVICE-IMPL-POLICY>STANDARD</SW-SERVICE-IMPL-POLICY>
              <BSW-ENTRY-KIND>CONCRETE</BSW-ENTRY-KIND>
            </BSW-MODULE-ENTRY>
            <BSW-MODULE-ENTRY UUID="98e2be5b-df87-4c4b-9764-3c93a9299e30">
              <SHORT-NAME>Cdd_Pwm_CounterComparatorCfg</SHORT-NAME>
              <SERVICE-ID>44</SERVICE-ID>
              <IS-REENTRANT>false</IS-REENTRANT>
              <IS-SYNCHRONOUS>true</IS-SYNCHRONOUS>
              <CALL-TYPE>REGULAR</CALL-TYPE>
              <EXECUTION-CONTEXT>UNSPECIFIED</EXECUTION-CONTEXT>
              <SW-SERVICE-IMPL-POLICY>STANDARD</SW-SERVICE-IMPL-POLICY>
              <BSW-ENTRY-KIND>CONCRETE</BSW-ENTRY-KIND>
            </BSW-MODULE-ENTRY>
            <BSW-MODULE-ENTRY UUID="b97bf225-0e88-4dbc-8645-2126fee39f4b">
              <SHORT-NAME>Cdd_Pwm_DeInit</SHORT-NAME>
              <SERVICE-ID>1</SERVICE-ID>
              <IS-REENTRANT>false</IS-REENTRANT>
              <IS-SYNCHRONOUS>true</IS-SYNCHRONOUS>
              <CALL-TYPE>REGULAR</CALL-TYPE>
              <EXECUTION-CONTEXT>UNSPECIFIED</EXECUTION-CONTEXT>
              <SW-SERVICE-IMPL-POLICY>STANDARD</SW-SERVICE-IMPL-POLICY>
              <BSW-ENTRY-KIND>CONCRETE</BSW-ENTRY-KIND>
            </BSW-MODULE-ENTRY>
            <BSW-MODULE-ENTRY UUID="b5203571-18ce-432f-83ac-240e94f334cb">
              <SHORT-NAME>Cdd_Pwm_DeadbandBypass</SHORT-NAME>
              <SERVICE-ID>17</SERVICE-ID>
              <IS-REENTRANT>false</IS-REENTRANT>
              <IS-SYNCHRONOUS>true</IS-SYNCHRONOUS>
              <CALL-TYPE>REGULAR</CALL-TYPE>
              <EXECUTION-CONTEXT>UNSPECIFIED</EXECUTION-CONTEXT>
              <SW-SERVICE-IMPL-POLICY>STANDARD</SW-SERVICE-IMPL-POLICY>
              <BSW-ENTRY-KIND>CONCRETE</BSW-ENTRY-KIND>
            </BSW-MODULE-ENTRY>
			<BSW-MODULE-ENTRY UUID="b4c3982d-ae8f-4157-9aa6-39ca21768c3b">
              <SHORT-NAME>Cdd_Pwm_SetRisingEdgeDelay</SHORT-NAME>
              <SERVICE-ID>40</SERVICE-ID>
              <IS-REENTRANT>false</IS-REENTRANT>
              <IS-SYNCHRONOUS>true</IS-SYNCHRONOUS>
              <CALL-TYPE>REGULAR</CALL-TYPE>
              <EXECUTION-CONTEXT>UNSPECIFIED</EXECUTION-CONTEXT>
              <SW-SERVICE-IMPL-POLICY>STANDARD</SW-SERVICE-IMPL-POLICY>
              <BSW-ENTRY-KIND>CONCRETE</BSW-ENTRY-KIND>
            </BSW-MODULE-ENTRY>
			<BSW-MODULE-ENTRY UUID="abb83a67-bd76-447b-80c2-77729f153175">
              <SHORT-NAME>Cdd_Pwm_SetFallingEdgeDelay</SHORT-NAME>
              <SERVICE-ID>41</SERVICE-ID>
              <IS-REENTRANT>false</IS-REENTRANT>
              <IS-SYNCHRONOUS>true</IS-SYNCHRONOUS>
              <CALL-TYPE>REGULAR</CALL-TYPE>
              <EXECUTION-CONTEXT>UNSPECIFIED</EXECUTION-CONTEXT>
              <SW-SERVICE-IMPL-POLICY>STANDARD</SW-SERVICE-IMPL-POLICY>
              <BSW-ENTRY-KIND>CONCRETE</BSW-ENTRY-KIND>
            </BSW-MODULE-ENTRY>
			<BSW-MODULE-ENTRY UUID="d096691f-00d2-410a-8936-6991180b111d">
              <SHORT-NAME>Cdd_Pwm_SetMinDeadbandDelay</SHORT-NAME>
              <SERVICE-ID>47</SERVICE-ID>
              <IS-REENTRANT>false</IS-REENTRANT>
              <IS-SYNCHRONOUS>true</IS-SYNCHRONOUS>
              <CALL-TYPE>REGULAR</CALL-TYPE>
              <EXECUTION-CONTEXT>UNSPECIFIED</EXECUTION-CONTEXT>
              <SW-SERVICE-IMPL-POLICY>STANDARD</SW-SERVICE-IMPL-POLICY>
              <BSW-ENTRY-KIND>CONCRETE</BSW-ENTRY-KIND>
            </BSW-MODULE-ENTRY>
			<BSW-MODULE-ENTRY UUID="1e92b1e3-6811-4d6d-bbe6-ee79d4385c08">
              <SHORT-NAME>Cdd_Pwm_HrSetRisingEdgeDelay</SHORT-NAME>
              <SERVICE-ID>45</SERVICE-ID>
              <IS-REENTRANT>false</IS-REENTRANT>
              <IS-SYNCHRONOUS>true</IS-SYNCHRONOUS>
              <CALL-TYPE>REGULAR</CALL-TYPE>
              <EXECUTION-CONTEXT>UNSPECIFIED</EXECUTION-CONTEXT>
              <SW-SERVICE-IMPL-POLICY>STANDARD</SW-SERVICE-IMPL-POLICY>
              <BSW-ENTRY-KIND>CONCRETE</BSW-ENTRY-KIND>
            </BSW-MODULE-ENTRY>
