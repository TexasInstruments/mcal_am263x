AUTOSAR XML (schema 00044)
package /TI_AM263x
  module definition Dio: refined-module-def=Dio, variants link-time/pre-compile  # Configuration of the Dio (Digital IO) module.
    container DioConfig  # This container contains the configuration parameters and sub containers of the AUTOSAR DIO module. This container is a MultipleConfigurationContainer, i.e. this container and its sub-containers exist once per configuration set.
      container DioPort [1..*]  # Configuration of individual DIO ports, consisting of channels and possible channel groups.
        integer DioPortId: 0..4, set at pre-compile, symbolic-name-value=true, default-value=0  # Numeric identifier of the DIO port. Not all MCU ports may be used for DIO, thus there may be "gaps" in the list of all IDs. This value will be
        container DioChannel [0..*]: requires-index=true  # Configuration of an individual DIO channel. Besides a HW specific channel name which is typically fixed for a specific micro controller, additional symbolic names can be defined per channel.
          integer DioChannelId: 0..138, scope=ECU, set at pre-compile, symbolic-name-value=true, default-value=0  # Channel Id of the DIO channel. This value will be assigned to the symbolic names.
        container DioChannelGroup [0..*]: requires-index=true  # Definition and configuration of DIO channel groups. A channel group represents several adjoining DIO channels represented by a logical group.
          string DioChannelGroupIdentification: scope=ECU, set at pre-compile, symbolic-name-value=true  # The DIO channel group is identified in DIO API by a pointer to a data structure (of type Dio_ChannelGroupType). That data structure contains the channel group information.
          integer DioPortMask: 0..4294967295, set at pre-compile  # This shall be the mask which defines the positions of the channel
          integer DioPortOffset: 0..31, set at pre-compile  # The position of the Channel Group on the port, counted
    container DioGeneral  # General DIO module configuration parameters.
      boolean DioDevErrorDetect: set at pre-compile, default-value=true  # Switches the Development Error Detection and Notification
      boolean DioDemEnable: origin=Texas Instruments, set at pre-compile, default-value=true  # Switches the Diagnostic event manager Notification
      boolean DioFlipChannelApi: set at pre-compile, default-value=true  # Adds / removes the service Dio_FlipChannel() from the code.
      boolean DioVersionInfoApi: set at pre-compile, default-value=true  # Adds / removes the service Dio_ GetVersionInfo() from the code.
      integer DioHostCoreId: 0..3, origin=Texas Instruments, set at pre-compile, default-value=0  # R5F CPU ownership of GPIO. 0 - R5FSS0 Core0, 1 - R5FSS0 Core1, 2 - R5FSS1 Core0, 3 - R5FSS1 Core1
      boolean DioRegisterReadbackApi: origin=Texas Instruments, set at pre-compile, default-value=true  # Adds / removes the service Dio_RegisterReadback() from the code.
    container DioPublishedInformation  # Additional published parameters not covered by "Common" Published Information. Note that these parameters have "PUBLISHED-INFORMATION" configuration class setting, since they are published information.
      enumeration DioDeviceVariant [0..1]: {AM263x}, origin=Texas Instruments, set at published-information, default-value=AM263x  # Select SOC AM263x variant
    container DioDemEventParameterRef
      symbolic name reference DIO_WRITE_CHANNEL_EVENT_ID [0..1]: multiplicity set at pre-compile, origin=Texas Instruments, set at pre-compile, destination=DemEventParameter  # This is the event ID for Dem event in the Dio_WriteChannel() API
      symbolic name reference DIO_WRITE_PORT_EVENT_ID [0..1]: multiplicity set at pre-compile, origin=Texas Instruments, set at pre-compile, destination=DemEventParameter  # This is the event ID for Dem event in the Dio_WritePort() API
      symbolic name reference DIO_E_HARDWARE_ERROR [0..1]: multiplicity set at pre-compile, origin=Texas Instruments, set at pre-compile, destination=DemEventParameter  # Reference to the DemEventParameter which shall be issued when the error "Timeout on blocking API call occurs " has occurred.
