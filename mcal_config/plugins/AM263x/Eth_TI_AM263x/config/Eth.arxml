AUTOSAR XML (schema 00044)
package /TI_AM263x
  module definition Eth [0..*]: post-build-variant-support=true, refined-module-def=Eth, variants link-time/post-build/pre-compile  # Configuration of the Eth (Ethernet Driver) module.
    container EthConfigSet  # This container contains the configuration parameters and sub containers of the AUTOSAR Eth module.
      container EthCtrlConfig [1..*]  # Configuration of the individual controller
        boolean EthCtrlEnableMii: set at pre-compile, default-value=true  # Enables / Disables Media Independent Interface (MII) for transceiver access
        boolean EthCtrlEnableRxInterrupt: set at pre-compile, default-value=true  # Enables / Disables receive interrupt
        boolean EthCtrlEnableTxInterrupt: set at pre-compile, default-value=true  # Enables / Disables transmit interrupt
        integer EthCtrlIdx: 0..1, scope=ECU, set at pre-compile, symbolic-name-value=true, default-value=0  # Specifies the instance ID of the configured controller.
        enumeration EthPort: {ETH_PORT1, ETH_PORT2}, scope=ECU, origin=Texas Instruments, post-build-variant-value=true, set at link in variant link-time / post-build in variant post-build / pre-compile in variant pre-compile, default-value=ETH_PORT1  # Specifies the port of the Ethernet.
        enumeration EthCtrlMacLayerSpeed [0..1]: {ETH_MAC_LAYER_SPEED_100M, ETH_MAC_LAYER_SPEED_10G, ETH_MAC_LAYER_SPEED_10M, ETH_MAC_LAYER_SPEED_1G}, scope=ECU, multiplicity set at link in variant link-time+post-build / pre-compile in variant pre-compile, post-build-variant-multiplicity=true, post-build-variant-value=true, set at link in variant link-time+post-build / pre-compile in variant pre-compile, default-value=ETH_MAC_LAYER_SPEED_1G  # Defines the baud rate of the MAC layer. This Autosar Parameter not used Eth_MacConnectionType TI parameter used for Speed.
        enumeration EthCtrlMacLayerSubType [0..1]: {REDUCED, REVERSED, SERIAL, STANDARD, UNIVERSAL_SERIAL}, scope=ECU, multiplicity set at link in variant link-time+post-build / pre-compile in variant pre-compile, post-build-variant-multiplicity=true, post-build-variant-value=true, set at link in variant link-time+post-build / pre-compile in variant pre-compile, default-value=REDUCED  # Defines the MAC layer subtype of a switch port.This Autosar Parameter not used Eth_MacConnectionType TI parameter used for Maclayer.
        enumeration EthCtrlMacLayerType: {ETH_MAC_LAYER_TYPE_XGMII, ETH_MAC_LAYER_TYPE_XMII, ETH_MAC_LAYER_TYPE_XXGMII}, scope=ECU, post-build-variant-value=true, set at link in variant link-time / post-build in variant post-build / pre-compile in variant pre-compile, default-value=ETH_MAC_LAYER_TYPE_XGMII  # Defines the MAC layer type of the ethernet controller.This Autosar Parameter not used Eth_MacConnectionType TI parameter used for Maclayer.
        string EthCtrlPhyAddress [0..1]: multiplicity set at link in variant link-time / post-build in variant post-build / pre-compile in variant pre-compile, post-build-variant-multiplicity=true, post-build-variant-value=true, set at link in variant link-time / post-build in variant post-build / pre-compile in variant pre-compile, default-value=11-22-33-44-55-66, max-length=17, min-length=17  # Specifies the unique 48-bit physical address (MAC address) of the controller in network byte order.
        function name EthCacheFlushOps: origin=Texas Instruments, set at pre-compile in variant pre-compile+link-time / post-build in variant post-build  # Cache flush function pointer
        function name EthInvalidateOps: origin=Texas Instruments, set at pre-compile in variant pre-compile+link-time / post-build in variant post-build  # Cache invalidate operation function pointer
        boolean EthEnableCacheOps: origin=Texas Instruments, set at pre-compile, default-value=false  # Enable/Disable cache operations in Ethernet Driver
        container EthCtrlConfigEgress  # Configuration of one Ethernet controler egress behavior.
          reference EthCtrlConfigEgressLastSchedulerRef: set at pre-compile, destination=EthCtrlConfigScheduler  # Reference to the scheduler which is the last in the egress structure.
          container EthCtrlConfigEgressFifo [0..*]: multiplicity set at link in variant link-time / post-build in variant post-build / pre-compile in variant pre-compile, post-build-variant-multiplicity=true  # Represents a Fifo at the egress side.
            integer EthCtrlConfigEgressFifoBufLenByte: 0..65535, post-build-variant-value=true, set at link in variant link-time / post-build in variant post-build / pre-compile in variant pre-compile, default-value=1522  # Length of Fifo elements in bytes.
            integer EthCtrlConfigEgressFifoBufTotal: 0..65535, post-build-variant-value=true, set at link in variant link-time / post-build in variant post-build / pre-compile in variant pre-compile, default-value=2  # Fifo buffer count.
            integer EthCtrlConfigEgressFifoIdx: 0..255, post-build-variant-value=true, set at link in variant link-time / post-build in variant post-build / pre-compile in variant pre-compile, default-value=0  # Egress Fifo index.
            integer EthCtrlConfigEgressFifoPriorityAssignment [0..*]: 0..7, multiplicity set at link in variant link-time / post-build in variant post-build / pre-compile in variant pre-compile, post-build-variant-multiplicity=true, post-build-variant-value=true, set at link in variant link-time / post-build in variant post-build / pre-compile in variant pre-compile, default-value=0  # Message egress prority assignment.
          container EthCtrlConfigScheduler [1..*]  # Represents a Scheduler on the egress side.
            container EthCtrlConfigSchedulerPredecessor [1..*]  # Defines an ordered list of predecessors for this scheduler.
              integer EthCtrlConfigSchedulerPredecessorOrder: 0..9223372036854775807, post-build-variant-value=true, set at link in variant link-time / post-build in variant post-build / pre-compile in variant pre-compile, default-value=0  # Defines the order of the scheduler predecessors.
              choice reference EthCtrlConfigSchedulerPredecessorRef: set at pre-compile, destination=[EthCtrlConfigEgressFifo, EthCtrlConfigScheduler, EthCtrlConfigShaper]  # Choice reference to the scheduler predecessor.
          container EthCtrlConfigShaper [0..*]  # Represents a Shaper an the egress side.
            integer EthCtrlConfigShaperIdleSlope [0..1]: 0..9223372036854775807, post-build-variant-value=true, set at link in variant link-time / post-build in variant post-build / pre-compile in variant pre-compile, default-value=0  # Defines the increase of credit in bits per second for the AVB shaper.
            reference EthCtrlConfigShaperPredecessorFifoRef: set at pre-compile, destination=EthCtrlConfigEgressFifo  # Reference to the fifo which is the predecessor for this shaper.
        container EthCtrlConfigIngress  # Configuration of one Ethernet controler ingress behavior.
          container EthCtrlConfigIngressFifo [0..*]: multiplicity set at link in variant link-time / post-build in variant post-build / pre-compile in variant pre-compile, post-build-variant-multiplicity=true  # Represents a Fifo at the ingress side.
            integer EthCtrlConfigIngressFifoBufLenByte: 0..65535, post-build-variant-value=true, set at link in variant link-time / post-build in variant post-build / pre-compile in variant pre-compile, default-value=1522  # Length of Fifo elements in bytes.
            integer EthCtrlConfigIngressFifoBufTotal: 0..65535, post-build-variant-value=true, set at link in variant link-time / post-build in variant post-build / pre-compile in variant pre-compile  # Fifo buffer count.
            integer EthCtrlConfigIngressFifoIdx: 0..255, post-build-variant-value=true, set at link in variant link-time / post-build in variant post-build / pre-compile in variant pre-compile, symbolic-name-value=true, default-value=2  # Ingress Fifo index.
            integer EthCtrlConfigIngressFifoPriorityAssignment [0..*]: 0..7, multiplicity set at link in variant link-time / post-build in variant post-build / pre-compile in variant pre-compile, post-build-variant-multiplicity=true, post-build-variant-value=true, set at link in variant link-time / post-build in variant post-build / pre-compile in variant pre-compile, default-value=0  # Message ingress prority assignment.
        container EthDemEventParameterRefs [0..1]  # Container for the references to DemEventParameter elements which shall be invoked using the API Dem_SetEventStatus in case the corresponding error occurs. The EventId is taken from the referenced DemEventParameter's DemEventId symbolic value. The standardized errors are provided in this container and can be extended by vendor-specific error references.
          symbolic name reference ETH_E_ACCESS [0..1]: multiplicity set at link in variant link-time / post-build in variant post-build / pre-compile in variant pre-compile, post-build-variant-multiplicity=true, post-build-variant-value=true, set at link in variant link-time / post-build in variant post-build / pre-compile in variant pre-compile, destination=DemEventParameter  # Reference to the DemEventParameter which shall be issued when the error "Controller access failed" has occured.
          symbolic name reference ETH_E_ALIGNMENT [0..1]: multiplicity set at link in variant link-time / post-build in variant post-build / pre-compile in variant pre-compile, post-build-variant-multiplicity=true, post-build-variant-value=true, set at link in variant link-time / post-build in variant post-build / pre-compile in variant pre-compile, destination=DemEventParameter  # Reference to the DemEventParameter which shall be issued when the error "Alignment Error" has occured.
          symbolic name reference ETH_E_CRC [0..1]: multiplicity set at link in variant link-time / post-build in variant post-build / pre-compile in variant pre-compile, post-build-variant-multiplicity=true, post-build-variant-value=true, set at link in variant link-time / post-build in variant post-build / pre-compile in variant pre-compile, destination=DemEventParameter  # Reference to the DemEventParameter which shall be issued when the error "CRC Failure" has occured.
          symbolic name reference ETH_E_LATECOLLISION [0..1]: multiplicity set at link in variant link-time / post-build in variant post-build / pre-compile in variant pre-compile, post-build-variant-multiplicity=true, post-build-variant-value=true, set at link in variant link-time / post-build in variant post-build / pre-compile in variant pre-compile, destination=DemEventParameter  # Reference to the DemEventParameter which shall be issued when the error "Late Collisions" has occured.
          symbolic name reference ETH_E_MULTIPLECOLLISION [0..1]: multiplicity set at link in variant link-time / post-build in variant post-build / pre-compile in variant pre-compile, post-build-variant-multiplicity=true, post-build-variant-value=true, set at link in variant link-time / post-build in variant post-build / pre-compile in variant pre-compile, destination=DemEventParameter  # Reference to the DemEventParameter which shall be issued when the error "Multiple Collisions" has occured.
          symbolic name reference ETH_E_OVERSIZEFRAME [0..1]: multiplicity set at link in variant link-time / post-build in variant post-build / pre-compile in variant pre-compile, post-build-variant-multiplicity=true, post-build-variant-value=true, set at link in variant link-time / post-build in variant post-build / pre-compile in variant pre-compile, destination=DemEventParameter  # Reference to the DemEventParameter which shall be issued when the error "Oversized Frame" has occured.
          symbolic name reference ETH_E_RX_FRAMES_LOST [0..1]: multiplicity set at link in variant link-time / post-build in variant post-build / pre-compile in variant pre-compile, post-build-variant-multiplicity=true, post-build-variant-value=true, set at link in variant link-time / post-build in variant post-build / pre-compile in variant pre-compile, destination=DemEventParameter  # Reference to the DemEventParameter which shall be issued when the error "receive frames lost" has occured.
          symbolic name reference ETH_E_SINGLECOLLISION [0..1]: multiplicity set at link in variant link-time / post-build in variant post-build / pre-compile in variant pre-compile, post-build-variant-multiplicity=true, post-build-variant-value=true, set at link in variant link-time / post-build in variant post-build / pre-compile in variant pre-compile, destination=DemEventParameter  # Reference to the DemEventParameter which shall be issued when the error "Single Collisions" has occured.
          symbolic name reference ETH_E_UNDERSIZEFRAME [0..1]: multiplicity set at link in variant link-time / post-build in variant post-build / pre-compile in variant pre-compile, post-build-variant-multiplicity=true, post-build-variant-value=true, set at link in variant link-time / post-build in variant post-build / pre-compile in variant pre-compile, destination=DemEventParameter  # Reference to the DemEventParameter which shall be issued when the error "Undersized Frame" has occured.
          symbolic name reference ETH_E_HARDWARE_ERROR [0..1]: multiplicity set at pre-compile, origin=Texas Instruments, set at pre-compile, destination=DemEventParameter  # Reference to the DemEventParameter which shall be issued when the error "Timeout on blocking API call occurs " has occurred.
        container EthPortConfig  # Structure for port configuration
          container EthMacConfig  # MAC Init Configurations
            enumeration EthMacModeFlags [0..2]: {ETH_CPSW_MAC_CONFIG_MODEFLG_TXFLOWCNTL, ETH_CPSW_MAC_CONFIG_MODEFLG_RXBUFFERFLOWCNTL}, multiplicity set at pre-compile in variant pre-compile+link-time / post-build in variant post-build, set at pre-compile in variant pre-compile+link-time / post-build in variant post-build
            enumeration EthMacConnectionType: {ETH_MAC_CONN_TYPE_MII_10_HALF, ETH_MAC_CONN_TYPE_MII_10_FULL, ETH_MAC_CONN_TYPE_MII_100_HALF, ETH_MAC_CONN_TYPE_MII_100_FULL, ETH_MAC_CONN_TYPE_RMII_10_HALF, ETH_MAC_CONN_TYPE_RMII_10_FULL, ETH_MAC_CONN_TYPE_RMII_100_HALF, ETH_MAC_CONN_TYPE_RMII_100_FULL, ETH_MAC_CONN_TYPE_RGMII_FORCE_10_HALF, ETH_MAC_CONN_TYPE_RGMII_FORCE_10_FULL, ETH_MAC_CONN_TYPE_RGMII_FORCE_100_HALF, ETH_MAC_CONN_TYPE_RGMII_FORCE_100_FULL, ETH_MAC_CONN_TYPE_RGMII_FORCE_1000, ETH_MAC_CONN_TYPE_RGMII_DETECT_INBAND}, set at pre-compile in variant pre-compile+link-time / post-build in variant post-build, default-value=ETH_MAC_CONN_TYPE_RGMII_DETECT_INBAND
            boolean EthMiiClkOutDisable: origin=Texas Instruments, set at pre-compile, default-value=true  # Disable/Enable MII reference clock output.
            boolean EthIdModeEnable: origin=Texas Instruments, set at pre-compile, default-value=true  # Enable/Disable internal delay mode (TX only).
        container EthCpdmaConfig
          integer EthPacingClkFreq: 0..4294967295, origin=Texas Instruments, set at post-build, default-value=200000000  # Port VID bit
          boolean EthRxInterruptPacingEnabled: origin=Texas Instruments, set at pre-compile, default-value=true  # Enable/Disable Rx interrupt pacing
          integer EthRxInterruptPerMsec: 0..4294967295, origin=Texas Instruments, set at post-build, default-value=2  # Port VID bit
          integer EthTxInterruptPerMsec: 0..4294967295, origin=Texas Instruments, set at post-build, default-value=2  # Port VID bit
          boolean EthTxInterruptPacingEnabled: origin=Texas Instruments, set at pre-compile, default-value=true  # Enable/Disable Rx interrupt pacing
          integer EthDmaModeFlags: 0..4294967295, origin=Texas Instruments, set at post-build, default-value=0  # Port VID bit
          integer EthRxThresholdCount: 0..4294967295, origin=Texas Instruments, set at post-build, default-value=15  # Port VID bit
        container EthMdioConfig [0..1]  # Structure for MDIO configuration
          integer EthMdioBusFreq: 0..4294967295, origin=Texas Instruments, set at post-build, default-value=2200000  # Bus frequency for the MII module
          integer EthMdioClockFreq: 0..4294967295, origin=Texas Instruments, set at post-build, default-value=200000000  # Clock frequency for MDIO link
        container EthCptsConfig [0..1]  # CPTS Module Init Configuration Structure for the CPTS modules provided during initialization
          integer EthCptsInputFreq: 0..4294967295, origin=Texas Instruments, set at link in variant link-time / post-build in variant post-build / pre-compile in variant pre-compile  # CPTS input clock frequency. Default CPTS input frequency is 266MHz. Please make sure to change ?CM_GMAC_GMAC_CLKCTRL[27:25 ] CLKSEL_RFT? to select different freq source of the CPTS_RFT_CLK
          enumeration EthCptsVlanType: {ETH_CPTS_VLAN_TYPE_NONE, ETH_CPTS_VLAN_TYPE_SINGLE_TAG, ETH_CPTS_VLAN_TYPE_STACKED_TAGS, ETH_CPTS_VLAN_TYPE_INVALID}, origin=Texas Instruments, set at link in variant link-time / post-build in variant post-build / pre-compile in variant pre-compile, default-value=ETH_CPTS_VLAN_TYPE_NONE  # Time sync HW supports 2 level tagging. Select appropriate level to enable time sync on VLAN tagged packet.
          container EthCptsMessageCfg [1..*]  # Structure for CPTS Ethernet Message Configuration
            enumeration EthCptsMessageCfgEnum: {ETH_CPTS_MESSAGE_SYNC, ETH_CPTS_MESSAGE_DELAY_REQ, ETH_CPTS_MESSAGE_PDELAY_REQ, ETH_CPTS_MESSAGE_PDELAY_RESP, ETH_CPTS_MESSAGE_FOLLOW_UP, ETH_CPTS_MESSAGE_DELAY_RESP, ETH_CPTS_MESSAGE_PDELAY_RESP_FOLLOW_UP, ETH_CPTS_MESSAGE_ANNOUNCE, ETH_CPTS_MESSAGE_SIGNALING, ETH_CPTS_MESSAGE_MANAGEMENT, ETH_CPTS_MESSAGE_ALL}, origin=Texas Instruments, set at link in variant link-time / post-build in variant post-build / pre-compile in variant pre-compile, default-value=ETH_CPTS_MESSAGE_SYNC  # Enumerates CPTS Ethernet Message Types
        container EthCpswQoSCfg [0..1]  # CPSW module : Configure Quality of Service (rate limiting and traffic shaping)
          container EthCpswRateLimitCfg [8..8]  # Structure for CPSW Rate Limit Configuration
            integer EthCpswRateLimitPrio: 0..200, origin=Texas Instruments, set at link in variant link-time / post-build in variant post-build / pre-compile in variant pre-compile, default-value=0  # Bandwidth for each of rate limited priority
    container EthGeneral  # General configuration of Ethernet Driver module
      boolean EthDevErrorDetect: set at pre-compile, default-value=false  # Switches the development error detection and notification on or off.
      boolean EthGetDropCountApi: set at pre-compile, default-value=false  # Enables / Disables Eth_GetCounterValues API.
      boolean EthGetEtherStatsApi: set at pre-compile, default-value=false  # Enables / Disables Eth_GetEtherStats API.
      boolean EthGetTxErrorCounterValuesApi: set at pre-compile, default-value=false  # Enables/Disables Eth_GetTxErrorCounterValues API.
      boolean EthGetTxStatsApi: set at pre-compile, default-value=false  # Enables/Disables Eth_GetTxStats API.
      boolean EthGlobalTimeSupport: set at pre-compile, default-value=false  # Enables/Disables the GlobalTime APIs used amongst others by Global Time Synchronization over Ethernet.
      integer EthIndex: 0..255, set at pre-compile, default-value=0  # Specifies the InstanceId of this module instance. If only one instance is present it shall have the Id 0.
      float EthMainFunctionPeriod: 0.0..INF, set at pre-compile, default-value=0.01  # Specifies the period of main function Eth_MainFunction in seconds. Ethernet driver does not require this information but the BSW scheduler.
      integer EthMaxCtrlsSupported: 1..255, set at pre-compile, default-value=1  # Limits the total number of supported controllers.
      boolean EthUpdatePhysAddrFilter [0..1]: set at pre-compile, default-value=false  # Enables/Disables optional API Eth_UpdatePhysAddrFilter. Tags: atp.Status=obsolete
      boolean EthVersionInfoApi: set at pre-compile, default-value=false  # Enables / Disables version info API
      boolean EthTrafficShapingSupport: origin=Texas Instruments, set at pre-compile, default-value=true  # Enables/Disables Traffic shaping feature
      boolean EthMdioManualOperation: origin=Texas Instruments, set at pre-compile, default-value=true  # Enables/Disables MDIO Manual Software BitBang Operation
      integer Eth_MdioLowDelay: 0..4294967295, scope=ECU, origin=Texas Instruments, set at pre-compile, default-value=36  # Write low signal delay in number of NOP instructions
      integer Eth_MdioHighDelay: 0..4294967295, scope=ECU, origin=Texas Instruments, set at pre-compile, default-value=33  # Write high signal delay in number of NOP instructions
      boolean EthUseDefaultMacAddr: origin=Texas Instruments, set at pre-compile, default-value=true  # Use default address for MAC ADDR
      enumeration EthIrqType: {ETH_ISR_VOID, ETH_ISR_CAT1, ETH_ISR_CAT2}, origin=Texas Instruments, set at pre-compile, default-value=ETH_ISR_CAT1  # Type of Isr function: void functionname(void) CAT1 : interrupt void func(void) CAT2 : ISR(func)
      integer EthNumTxBuffers: 8..1024, origin=Texas Instruments, set at pre-compile, default-value=256  # Number of TX buffers
      integer EthNumRxBuffers: 8..1024, origin=Texas Instruments, set at pre-compile, default-value=256  # Number of RX buffers
      integer EthBufLenByte: 0..1522, origin=Texas Instruments, set at pre-compile, default-value=1522  # Maximum rx/tx buffer length (frame length) in bytes
      boolean EthAutoBuffRotation: origin=Texas Instruments, set at pre-compile, default-value=true  # Enable/Disable automatic buffer rotation
      integer EthDefaultOSCounterId [0..1]: 0..16, multiplicity set at pre-compile, origin=Texas Instruments, set at pre-compile, default-value=0  # Default Os Counter Id if node reference to OsCounter ref EthOsCounterRef is not set
      integer EthTimeoutDuration: 1..4294967295, origin=Texas Instruments, set at pre-compile, default-value=3200  # ETH timeout - used in ETH busy wait. Configure the timeout according to the r5f clock frequency(400MHz/200MHz)
      reference EthOsCounterRef [0..1]: multiplicity set at pre-compile, origin=Texas Instruments, set at pre-compile, destination=OsCounter  # This parameter contains a reference to the OsCounter, which is used by the ETH driver.
      container EthInterruptConfig  # interrupt configuration- misc interrupts flags.
        boolean EthStatsInterruptEnable: origin=Texas Instruments, set at pre-compile, default-value=true  # Enables/Disables interrupt for ethernet stats.
        boolean EthUsrMdioInterruptEnable: origin=Texas Instruments, set at pre-compile, default-value=true  # Enables/Disables interrupt for mdio.
        boolean EthHostErrorInterruptEnable: origin=Texas Instruments, set at pre-compile, default-value=true  # Enables/Disables interrupt for host error.
      container EthCtrlOffloading  # Configuration of hardware offloading features.
        boolean EthCtrlEnableOffloadChecksumICMP: set at pre-compile  # Enables / Disables hardware offloading for ICMP checksums.
        boolean EthCtrlEnableOffloadChecksumIPv4: set at pre-compile  # Enables / Disables hardware offloading for IPv4 checksums.
        boolean EthCtrlEnableOffloadChecksumTCP: set at pre-compile  # Enables / Disables hardware offloading for TCP checksums.
        boolean EthCtrlEnableOffloadChecksumUDP: set at pre-compile  # Enables / Disables hardware offloading for UDP checksums.
    container EthPublishedInformation  # Additional published parameters not covered by "Common" Published Information. Note that these parameters have "PUBLISHED-INFORMATION" configuration class setting, since they are published information.
      enumeration EthDeviceVariant [0..1]: {AM263x}, origin=Texas Instruments, set at pre-compile, default-value=AM263x  # Select SOC variant .This parameter shall be used by driver to impose device specific constraints. The user guide shall detail the device specific constraints
