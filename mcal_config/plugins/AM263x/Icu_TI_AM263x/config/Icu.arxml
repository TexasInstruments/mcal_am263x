AUTOSAR XML (schema 00044)
package /TI_AM263x
  module definition Icu [0..1]: post-build-variant-support=true, refined-module-def=Icu, variants post-build/pre-compile  # Configuration of the Icu (Input Capture Unit) module.
    container IcuConfigSet  # This container contains the configuration parameters and sub containers of the AUTOSAR Icu module.
      integer IcuMaxChannel: 0..10, post-build-variant-value=true, set at post-build in variant post-build / pre-compile in variant pre-compile, default-value=1  # This parameter contains the number of Channels configured. It will be gathered by tools during the configuration stage.
      container IcuChannel [1..10]  # Configuration of an individual ICU channel.
        integer IcuChannelId: 0..10, scope=ECU, set at pre-compile, symbolic-name-value=true  # Channel Id of the ICU channel. This value will be assigned to the symbolic name derived of the IcuChannel container short name.
        enumeration IcuDefaultStartEdge: {ICU_BOTH_EDGES, ICU_FALLING_EDGE, ICU_RISING_EDGE}, post-build-variant-value=true, set at post-build in variant post-build / pre-compile in variant pre-compile  # Configures the default-activation-edge which shall be used for this channel if there was no activation-edge configured by the call of service Icu_SetActivationCondition().
        enumeration IntrCapSelect: {ECAP_CEVT1_INT, ECAP_CEVT2_INT, ECAP_CEVT3_INT, ECAP_CEVT4_INT, ECAP_CEVT1_CEVT2_INT, ECAP_CEVT1_CEVT3_INT, ECAP_CEVT1_CEVT4_INT, ECAP_CEVT2_CEVT3_INT, ECAP_CEVT2_CEVT4_INT, ECAP_CEVT3_CEVT4_INT, ECAP_CEVT1_CEVT2_CEVT3_INT, ECAP_CEVT1_CEVT2_CEVT4_INT, ECAP_CEVT1_CEVT3_CEVT4_INT, ECAP_CEVT2_CEVT3_CEVT4_INT, ECAP_INT_ALLCAPS}, origin=Texas Instruments, post-build-variant-value=true, set at post-build in variant post-build / pre-compile in variant pre-compile  # Configures the capture event to enable interupt on that capture event or not
        enumeration IcuMeasurementMode: {ICU_MODE_EDGE_COUNTER, ICU_MODE_SIGNAL_EDGE_DETECT, ICU_MODE_SIGNAL_MEASUREMENT, ICU_MODE_TIMESTAMP}, post-build-variant-value=true, set at post-build in variant post-build / pre-compile in variant pre-compile  # Configures the measurement mode of this channel.
        boolean IcuWakeupCapability [0..0]: post-build-variant-value=true, set at post-build in variant post-build / pre-compile in variant pre-compile  # Information about the wakeup-capability of this channel.
        integer IcuPrescaler: 0..62, origin=Texas Instruments, set at post-build in variant post-build / pre-compile in variant pre-compile, default-value=0  # Time-Base Clock Prescale Bits. Keep value as 0 to by-pass prescaler.
        integer IcuFunctionalClock: origin=Texas Instruments, post-build-variant-value=true, set at post-build in variant post-build / pre-compile in variant pre-compile, default-value=200  # Value of the System clock frequency in MHz Default frequency is 125MHz for ICU.
        reference IcuXbarSelect: origin=Texas Instruments, post-build-variant-value=true, set at post-build in variant post-build / pre-compile in variant pre-compile, destination=McuInputXbarChannelTriggerConfiguration  # Configures the input select xbar to be used in order to give icu the required input
        container IcuSignalEdgeDetection [0..1]  # This container contains the configuration (parameters) in case the measurement mode is "IcuSignalEdgeDetection"
          function name IcuSignalNotification [0..1]: multiplicity set at post-build in variant post-build / pre-compile in variant pre-compile, post-build-variant-multiplicity=true, post-build-variant-value=true, set at post-build in variant post-build / pre-compile in variant pre-compile  # Notification function for signal notification.
        container IcuSignalMeasurement [0..1]  # This container contains the configuration (parameters) in case the measurement mode is "IcuSignalMeasurement"
          enumeration IcuSignalMeasurementProperty: {ICU_DUTY_CYCLE, ICU_HIGH_TIME, ICU_LOW_TIME, ICU_PERIOD_TIME}, post-build-variant-value=true, set at post-build in variant post-build / pre-compile in variant pre-compile  # Configures the property that could be measured in case the mode is "IcuSignalMeasurement".
        container IcuTimestampMeasurement [0..1]  # This container contains the configuration (parameters) in case the measurement mode is "IcuTimestamp"
          enumeration IcuTimestampMeasurementProperty: {ICU_CIRCULAR_BUFFER, ICU_LINEAR_BUFFER}, post-build-variant-value=true, set at post-build in variant post-build / pre-compile in variant pre-compile  # Configures the handling of the buffer in case the mode is "Timestamp"
          function name IcuTimestampNotification [0..1]: multiplicity set at post-build in variant post-build / pre-compile in variant pre-compile, post-build-variant-multiplicity=true, post-build-variant-value=true, set at post-build in variant post-build / pre-compile in variant pre-compile  # Notification function if the number of requested timestamps
        container IcuWakeup [0..1]  # This container contains the configuration (parameters) needed to configure a wakeup capable channel
          symbolic name reference IcuChannelWakeupInfo [0..0]: multiplicity set at post-build in variant post-build / pre-compile in variant pre-compile, post-build-variant-multiplicity=true, post-build-variant-value=true, set at post-build in variant post-build / pre-compile in variant pre-compile, destination=EcuMWakeupSource  # If the wakeup-capability is true the wakeup source referenced is transmitted to the ECU State Manager (EcuM) .
    container IcuGeneral  # Configuration of general ICU parameters.
      boolean IcuDevErrorDetect: set at pre-compile, default-value=false  # Switches the development error detection and notification on or off.
      enumeration IcuIrqType: {ICU_ISR_VOID, ICU_ISR_CAT1, ICU_ISR_CAT2}, origin=Texas Instruments, set at pre-compile, default-value=ICU_ISR_CAT1  # Type of Isr function: void functionname(void) CAT1 see description in oil tool : interrupt void func(void) CAT2 see description in oil tool : ISR(func)
      enumeration IcuDeviceVariant: {AM263x}, origin=Texas Instruments, set at pre-compile, default-value=AM263x  # Select SOC variant
      boolean IcuReportWakeupSource [0..0]: set at pre-compile  # Switch for enabling Wakeup source reporting.
    container IcuOptionalApis  # This container contains all configuration switches for configuring optional API services of the ICU driver.
      boolean IcuDeInitApi: set at pre-compile, default-value=false  # Adds / removes the service Icu_DeInit() from the code.
      boolean IcuDisableWakeupApi: set at pre-compile, default-value=false  # Adds / removes the service Icu_DisableWakeup() from the code.
      boolean IcuEdgeCountApi: set at pre-compile, default-value=false  # Adds / removes all services related to the edge counting functionality as listed below, from the code: Icu_ResetEdgeCount(), Icu_EnableEdgeCount(), Icu_DisableEdgeCount(), Icu_GetEdgeNumbers().
      boolean IcuEdgeDetectApi: set at pre-compile, default-value=false  # Adds / removes the services related to the edge detection functionality, from the code:
      boolean IcuEnableWakeupApi: set at pre-compile, default-value=false  # Adds / removes the service Icu_EnableWakeup() from the code.
      boolean IcuGetDutyCycleValuesApi: set at pre-compile, default-value=false  # Adds / removes the service Icu_GetDutyCycleValues() from the code.
      boolean IcuGetInputStateApi: set at pre-compile, default-value=false  # Adds / removes the service Icu_GetInputState() from the code.
      boolean IcuGetTimeElapsedApi: set at pre-compile, default-value=false  # Adds / removes the service Icu_GetTimeElapsed() from the code.
      boolean IcuGetVersionInfoApi: set at pre-compile, default-value=false  # Adds / removes the service Icu_GetVersionInfo() from the code.
      boolean IcuSetModeApi: set at pre-compile, default-value=false  # Adds / removes the service Icu_SetMode() from the code.
      boolean IcuSignalMeasurementApi: set at pre-compile, default-value=false  # Adds / removes the services Icu_StartSignalMeasurement() and Icu_StopSignalMeasurement() from the code.
      boolean IcuTimestampApi: set at pre-compile, default-value=false  # Adds / removes all services related to the timestamping functionality as listed below from the code: Icu_StartTimestamp(), Icu_StopTimestamp(), Icu_GetTimestampIndex().
      boolean IcuWakeupFunctionalityApi: set at pre-compile, default-value=false  # Adds / removes the service Icu_CheckWakeup() from the code.
      boolean IcuEnableRegisterReadbackApi: origin=Texas Instruments, set at pre-compile, default-value=true  # Switch to indicate that the Icu_RegisterReadBack is supported
