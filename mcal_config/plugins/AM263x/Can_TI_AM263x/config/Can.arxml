AUTOSAR XML (schema 00044)
package /TI_AM263x
  module definition Can [1..*]: refined-module-def=Can, variants post-build/pre-compile  # This container holds the configuration of a single CAN Driver.
    container CanConfigSet  # This container contains the multiple configuration container and sub containers of the AUTOSAR Can module.
      container CanController [1..*]  # This container contains the configuration parameters of the CAN controller(s).
        integer CanControllerId: 0..255, scope=ECU, set at pre-compile, symbolic-name-value=true, default-value=0  # This parameter provides the controller ID which is unique in a given CAN Driver. The value for this parameter starts with 0 and continue without any gaps.
        enumeration CanControllerInstance: {MCAN0, MCAN1, MCAN2, MCAN3}, origin=Texas Instruments, set at pre-compile, default-value=MCAN0  # Selects Can Controller Instance.
        boolean CanControllerActivation: set at pre-compile, default-value=false  # Defines if a CAN controller is used in the configuration.
        integer CanControllerBaseAddress: 1382023168..1382219776, set at pre-compile, default-value=1382023168  # Specifies the CAN controller base address.
        function name CanErrorNotification: origin=Texas Instruments, set at post-build in variant post-build / pre-compile in variant pre-compile, default-value=NULL_PTR  # Callback function for ECC Error and Parity error in case of AM263x
        integer CanControllerType: 0..255, origin=Texas Instruments, set at pre-compile, default-value=0  # This parameter provides the controller Type. The value for this parameter is calculated by driver runtime.
        enumeration CanBusoffProcessing: {INTERRUPT, POLLING}, set at pre-compile, default-value=INTERRUPT  # Enables / disables API Can_MainFunction_BusOff() for handling busoff events in polling mode.
        enumeration CanRxProcessing: {INTERRUPT, MIXED, POLLING}, set at pre-compile, default-value=INTERRUPT  # Enables / disables API Can_MainFunction_Read() for handling PDU reception events in polling mode.
        enumeration CanTxProcessing: {INTERRUPT, MIXED, POLLING}, set at pre-compile, default-value=INTERRUPT  # Enables / disables API Can_MainFunction_Write() for handling PDU transmission events in polling mode.
        boolean CanWakeupFunctionalityAPI [0..1]: multiplicity set at pre-compile, set at pre-compile, default-value=false  # Adds / removes the service Can_CheckWakeup() from the code. To use this parameter, enable CanWakeupSupport
        boolean CanDisableAutoRetranmission: origin=Texas Instruments, set at pre-compile in variant pre-compile / post-build in variant post-build, default-value=true  # Disable auto retransmission on xmit error
        enumeration CanWakeupProcessing [0..1]: {INTERRUPT, POLLING}, multiplicity set at pre-compile, set at pre-compile, default-value=INTERRUPT  # Enables / disables API Can_MainFunction_Wakeup() for handling wakeup events in polling mode. To use this parameter, enable CanWakeupSupport
        boolean CanWakeupSupport: set at pre-compile, default-value=false  # CAN driver support for wakeup over CAN Bus.
        reference CanControllerDefaultBaudrate: set at post-build in variant post-build / pre-compile in variant pre-compile, destination=CanControllerBaudrateConfig  # Reference to baudrate configuration container configured for the Can Controller.
        reference CanCpuClockRef: set at pre-compile, destination=McuClockReferencePoint  # Reference to the CPU clock configuration, which is set in the MCU driver configuration
        symbolic name reference CanWakeupSourceRef [0..1]: multiplicity set at pre-compile, set at pre-compile, destination=EcuMWakeupSource  # This parameter contains a reference to the Wakeup Source for this controller as defined in the ECU State Manager.
        container CanControllerBaudrateConfig [1..*]  # This container contains bit timing related configuration parameters of the CAN controller(s).
          integer CanControllerBaudRate: 0..2000, set at post-build in variant post-build / pre-compile in variant pre-compile, default-value=500  # Specifies the baudrate of the controller in kbps.
          integer CanControllerBaudRateConfigID: 0..65535, scope=ECU, set at post-build in variant post-build / pre-compile in variant pre-compile, default-value=0  # Uniquely identifies a specific baud rate configuration. This ID is used by SetBaudrate API.
          integer CanControllerPropSeg: 0..255, set at post-build in variant post-build / pre-compile in variant pre-compile, default-value=8  # Specifies propagation delay in time quantas.
          integer CanControllerSeg1: 0..255, set at post-build in variant post-build / pre-compile in variant pre-compile, default-value=5  # Specifies phase segment 1 in time quantas.
          integer CanControllerSeg2: 0..255, set at post-build in variant post-build / pre-compile in variant pre-compile, default-value=4  # Specifies phase segment 2 in time quantas.
          integer CanControllerSyncJumpWidth: 0..255, set at post-build in variant post-build / pre-compile in variant pre-compile, default-value=1  # Specifies the synchronization jump width for the controller in time quantas.
          container CanControllerFdBaudrateConfig [0..1]  # This optional container contains bit timing related configuration parameters of the CAN controller(s) for payload and CRC of a CAN FD frame. If this container exists the controller supports CAN FD frames.
            integer CanControllerFdBaudRate: 0..16000, set at post-build in variant post-build / pre-compile in variant pre-compile, default-value=5000  # Specifies the data segment baud rate of the controller in kbps.
            integer CanControllerPropSeg: 0..255, set at post-build in variant post-build / pre-compile in variant pre-compile, default-value=2  # Specifies propagation delay in time quantas.
            integer CanControllerSeg1: 0..255, set at post-build in variant post-build / pre-compile in variant pre-compile, default-value=2  # Specifies phase segment 1 in time quantas.
            integer CanControllerSeg2: 0..255, set at post-build in variant post-build / pre-compile in variant pre-compile, default-value=3  # Specifies phase segment 2 in time quantas.
            integer CanControllerSyncJumpWidth: 0..255, set at post-build in variant post-build / pre-compile in variant pre-compile, default-value=2  # Specifies the synchronization jump width for the controller in time quantas.
            integer CanControllerTrcvDelayCompensationOffset [0..1]: 0..400, multiplicity set at post-build in variant post-build / pre-compile in variant pre-compile, set at post-build in variant post-build / pre-compile in variant pre-compile, default-value=180  # Specifies the Transceiver Delay Compensation Offset in ns. If not specified Transceiver Delay Compensation is disabled.
            boolean CanControllerTxBitRateSwitch: set at post-build in variant post-build / pre-compile in variant pre-compile, default-value=true  # Specifies if the bit rate switching shall be used for transmissions.
        container CanTTController [0..1]  # This container is only included and valid if TTCAN SWS is used and TTCAN is enabled.
          integer CanTTControllerApplWatchdogLimit [0..0]: 0..255, scope=ECU, set at post-build in variant post-build / pre-compile in variant pre-compile  # Defines the maximum time period (unit is 256 times NTU) after which the application has to serve the watchdog.
          integer CanTTControllerCycleCountMax [0..0]: 0..63, scope=ECU, set at post-build in variant post-build / pre-compile in variant pre-compile  # Defines the value for cycle_count_max.
          integer CanTTControllerExpectedTxTrigger [0..0]: 0..255, set at post-build in variant post-build / pre-compile in variant pre-compile  # Number of expected_tx_trigger.
          boolean CanTTControllerExternalClockSynchronisation [0..0]: scope=ECU, set at post-build in variant post-build / pre-compile in variant pre-compile  # Enables/disables the external clock synchronization.
          boolean CanTTControllerGlobalTimeFiltering: set at post-build in variant post-build / pre-compile in variant pre-compile  # Enables/disables the global time filtering.
          integer CanTTControllerInitialRefOffset [0..0]: 0..127, scope=ECU, set at post-build in variant post-build / pre-compile in variant pre-compile  # Defines the initial value for ref trigger offset.
          integer CanTTControllerInterruptEnable [0..0]: 0..1023, set at post-build in variant post-build / pre-compile in variant pre-compile  # Enables/disables the respective interrupts.
          boolean CanTTControllerLevel2: set at post-build in variant post-build / pre-compile in variant pre-compile  # Defines whether Level 2 or Level 1 is used.
          float CanTTControllerNTUConfig [0..0]: 0.0..100.0, scope=ECU, set at post-build in variant post-build / pre-compile in variant pre-compile  # Defines the config value for NTU (network time unit).
          enumeration CanTTControllerOperationMode [0..0]: {CAN_TT_EVENT_SYNC_TIME_TRIGGERED, CAN_TT_EVENT_TRIGGERED, CAN_TT_TIME_TRIGGERED}, scope=ECU, set at post-build in variant post-build / pre-compile in variant pre-compile  # Defines the operation mode.
          float CanTTControllerSyncDeviation [0..0]: 0.0..100.0, set at post-build in variant post-build / pre-compile in variant pre-compile  # Defines the maximum synchronization deviation:
          boolean CanTTControllerTURRestore [0..0]: set at post-build in variant post-build / pre-compile in variant pre-compile  # Enables/disables the TUR restore.
          boolean CanTTControllerTimeMaster [0..0]: scope=ECU, set at post-build in variant post-build / pre-compile in variant pre-compile  # Defines whether the controller acts as a potential time master.
          integer CanTTControllerTimeMasterPriority [0..0]: 0..7, scope=ECU, set at post-build in variant post-build / pre-compile in variant pre-compile  # Defines the time master priority.
          integer CanTTControllerTxEnableWindowLength [0..0]: 1..16, scope=ECU, set at post-build in variant post-build / pre-compile in variant pre-compile  # Length of the tx enable window given in CAN bit times.
          integer CanTTControllerWatchTriggerGapTimeMark [0..0]: 0..65535, set at post-build in variant post-build / pre-compile in variant pre-compile  # watch trigger time mark after a gap
          integer CanTTControllerWatchTriggerTimeMark [0..0]: 0..65535, set at post-build in variant post-build / pre-compile in variant pre-compile  # watch trigger time mark
          enumeration CanTTIRQProcessing [0..0]: {INTERRUPT, POLLING}, scope=ECU, set at post-build in variant post-build / pre-compile in variant pre-compile  # Enables / disables API Can_MainFunction_BusOff() for handling busoff events in polling mode.
      container CanHardwareObject [1..*]  # This container contains the configuration (parameters) of CAN Hardware Objects.
        integer CanFdPaddingValue [0..1]: 0..255, scope=ECU, multiplicity set at post-build in variant post-build / pre-compile in variant pre-compile, set at post-build in variant post-build / pre-compile in variant pre-compile, default-value=0  # Specifies the value which is used to pad unspecified data in CAN FD frames > 8 bytes for transmission. This is necessary due to the discrete possible values of the DLC if > 8 bytes.
        enumeration CanHandleType: {BASIC, FULL}, scope=ECU, set at post-build in variant post-build / pre-compile in variant pre-compile, default-value=FULL  # Specifies the type (Full-CAN or Basic-CAN) of a hardware object.
        boolean CanHardwareObjectUsesPolling [0..1]: default-value=false  # Enables polling of this hardware object.
        integer CanHwObjectCount [0..1]: 1..65535, scope=ECU, multiplicity set at post-build in variant post-build / pre-compile in variant pre-compile, set at post-build in variant post-build / pre-compile in variant pre-compile, default-value=1  # Number of hardware objects used to implement one HOH. In case of a HRH this parameter defines the number of elements in the hardware FIFO or the number of shadow buffers, in case of a HTH it defines the number of hardware objects used for multiplexed transmission or for a hardware FIFO used by a FullCAN HTH.
        enumeration CanIdType: {EXTENDED, MIXED, STANDARD}, scope=ECU, set at post-build in variant post-build / pre-compile in variant pre-compile, default-value=STANDARD  # Specifies whether the IdValue is of type
        integer CanObjectId: 0..65535, scope=ECU, set at pre-compile, symbolic-name-value=true, default-value=0  # Holds the handle ID of HRH or HTH. The value of this parameter is unique in a given CAN Driver, and it should start with 0 and continue without any gaps.
        integer CanHwHandle: 0..63, origin=Texas Instruments, set at pre-compile, default-value=0  # Holds the h/w Mailbox Number.
        enumeration CanObjectType: {RECEIVE, TRANSMIT}, scope=ECU, set at post-build in variant post-build / pre-compile in variant pre-compile, default-value=TRANSMIT  # Specifies if the HardwareObject is used as Transmit or as Receive object
        boolean CanTriggerTransmitEnable [0..1]: scope=ECU, multiplicity set at pre-compile, set at pre-compile, default-value=false  # This parameter defines if or if not Can supports the trigger-transmit API for this handle.
        reference CanControllerRef: set at post-build in variant post-build / pre-compile in variant pre-compile, destination=CanController  # Reference to CAN Controller to which the HOH is associated to.
        reference CanMainFunctionRWPeriodRef [0..1]: multiplicity set at post-build in variant post-build / pre-compile in variant pre-compile, set at post-build in variant post-build / pre-compile in variant pre-compile, destination=CanMainFunctionRWPeriods  # Reference to CanMainFunctionPeriod
        container CanHwFilter [0..*]  # This container is only valid for HRHs and contains the configuration (parameters) of one hardware filter.
          integer CanHwFilterCode: 0..4294967295, set at post-build in variant post-build / pre-compile in variant pre-compile, default-value=0  # Specifies (together with the filter mask) the identifiers range that passes the hardware filter.
          integer CanHwFilterMask: 0..4294967295, set at post-build in variant post-build / pre-compile in variant pre-compile, default-value=0  # Describes a mask for hardware-based filtering of CAN identifiers. The CAN identifiers of incoming messages are masked with the appropriate CanFilterMaskValue. Bits holding a 0 mean don't care, i.e. do not compare the message's identifier in the respective bit position.
        container CanTTHardwareObjectTrigger [0..*]  # This container is only included and valid if TTCAN SWS is used and TTCAN is enabled.
          integer CanTTHardwareObjectBaseCycle [0..0]: 0..63, scope=ECU, set at post-build in variant post-build / pre-compile in variant pre-compile  # Defines the cycle_offset.
          integer CanTTHardwareObjectCycleRepetition [0..0]: 1..64, scope=ECU, set at post-build in variant post-build / pre-compile in variant pre-compile  # Defines the repeat_factor.
          integer CanTTHardwareObjectTimeMark [0..0]: 0..65535, set at post-build in variant post-build / pre-compile in variant pre-compile  # Defines the point in time, when the trigger will be activated.
          integer CanTTHardwareObjectTriggerId [0..0]: 0..63, set at pre-compile, symbolic-name-value=true  # Sequential number which allows separation of different TTCAN triggers configured for one and the same hardware object.
          enumeration CanTTHardwareObjectTriggerType [0..0]: {CAN_TT_RX_TRIGGER, CAN_TT_TX_REF_TRIGGER, CAN_TT_TX_REF_TRIGGER_GAP, CAN_TT_TX_TRIGGER_EXCLUSIVE, CAN_TT_TX_TRIGGER_MERGED, CAN_TT_TX_TRIGGER_SINGLE}, set at post-build in variant post-build / pre-compile in variant pre-compile  # Defines the type of the trigger associated with the hardware object. This parameter depends on plain CAN parameter CAN_OBJECT_TYPE.
      container CanIcom [0..1]  # This container contains the parameters for configuring pretended networking
        container CanIcomConfig [1..*]  # This container contains the configuration parameters of the ICOM Configuration.
          integer CanIcomConfigId: 1..255, scope=ECU, set at pre-compile  # This parameter identifies the ID of the ICOM configuration.
          boolean CanIcomWakeOnBusOff: scope=ECU, set at pre-compile, default-value=true  # This parameter defines that the MCU shall wake if the bus off is detected or not.
          container CanIcomWakeupCauses  # This container contains the configuration parameters of the wakeup causes to leave the power saving mode.
            container CanIcomRxMessage [1..*]  # This container contains the configuration parameters for the wakeup causes for matching received messages. It has to be configured as often as received messages are defined as wakeup cause.
              integer CanIcomCounterValue [0..1]: 1..65536, scope=ECU, multiplicity set at pre-compile, set at pre-compile  # This parameter defines that the MCU shall wake if the message with the ID is received n times on the communication channel.
              integer CanIcomMessageId: 0..536870912, scope=ECU, set at pre-compile  # This parameter defines the message ID the wakeup causes of this CanIcomRxMessage are configured for. In addition a mask (CanIcomMessageIdMask) can be defined, in that case it is possible to define a range of rx messages, which can create a wakeup condition.
              integer CanIcomMessageIdMask [0..1]: 0..536870912, scope=ECU, multiplicity set at pre-compile, set at pre-compile  # Describes a mask for filtering of CAN identifiers. The CAN identifiers of incoming messages are masked with this CanIcomMessageIdMask. If the masked identifier matches the masked value of CanIcomMessageId, it can create a wakeup condition for this CanIcomRxMessage. Bits holding a 0 mean don't care, i.e. do not compare the message's identifier in the respective bit position. The mask shall be build by filling with leading 0.
              float CanIcomMissingMessageTimerValue [0..1]: scope=ECU, multiplicity set at pre-compile, set at pre-compile  # This parameter defines that the MCU shall wake if the message with the ID is not received for a specific time in s on the
              boolean CanIcomPayloadLengthError: scope=ECU, set at pre-compile, default-value=false  # This parameter defines that the MCU shall wake if a payload error occurs
              container CanIcomRxMessageSignalConfig [0..*]  # This container contains the configuration parameters for the wakeup causes for matching signals.
                integer CanIcomSignalMask: 0..18446744073709551615, set at pre-compile  # This parameter shall be used to mask a signal in the payload of a CAN message.
                enumeration CanIcomSignalOperation: {AND, EQUAL, GREATER, SMALLER, XOR}, scope=ECU, set at pre-compile  # This parameter defines the operation, which shall be used to verify the signal value creates a wakeup condition.
                integer CanIcomSignalValue: 0..18446744073709551615, set at pre-compile  # This parameter shall be used to define a signal value which shall be compared (CanIcomSignalOperation) with the masked CanIcomSignalMask value of the received signal (CanIcomSignalRef).
                reference CanIcomSignalRef [0..1]: scope=ECU, multiplicity set at pre-compile, set at pre-compile, destination=ComSignal  # This parameter defines a reference to the signal which shall be checked additional to the message id (CanIcomMessageId).
    container CanGeneral  # This container contains the parameters related each CAN Driver Unit.
      boolean CanDevErrorDetect: set at pre-compile, default-value=false  # Switches the Development Error Detection and Notification ON or OFF.
      boolean CanDeInitApi: origin=Texas Instruments, set at pre-compile, default-value=true  # Adds / removes the service Can_DeInit() from the code.
      boolean CanHardwareCancellation [0..0]: origin=Texas Instruments, set at pre-compile, default-value=false  # Specifies if hardware cancellation shall be supported.ON or OFF
      boolean CanIdenticalIdCancellation [0..0]: origin=Texas Instruments, set at pre-compile, default-value=false  # Enables/disables cancellation of pending PDUs with identical ID.
      integer CanIndex: 0..255, set at pre-compile, default-value=0  # Specifies the InstanceId of this module instance. If only one instance is present it shall have the Id 0.
      function name CanLPduReceiveCalloutFunction [0..1]: multiplicity set at pre-compile, set at pre-compile  # This parameter defines the existence and the name of a callout function that is called after a successful reception of a received CAN Rx L-PDU. If this parameter is omitted no callout shall take place.
      float CanMainFunctionBusoffPeriod [0..1]: 0.001..65.535, multiplicity set at pre-compile, set at pre-compile, default-value=10.0  # This parameter describes the period for cyclic call to Can_MainFunction_Busoff. Unit is seconds.
      float CanMainFunctionModePeriod: 0.001..65.535, set at pre-compile, default-value=10.0  # This parameter describes the period for cyclic call to Can_MainFunction_Mode. Unit is seconds.
      float CanMainFunctionReadPeriod: 0.001..65.535, origin=Texas Instruments, set at pre-compile  # This parameter describes the period for cyclic call to Can_MainFunction_Read. Unit is seconds.
      float CanMainFunctionWritePeriod: 0.001..65.535, origin=Texas Instruments, set at pre-compile  # This parameter describes the period for cyclic call to Can_MainFunction_Write. Unit is seconds.
      float CanMainFunctionWakeupPeriod [0..1]: 0.001..65.535, multiplicity set at pre-compile, set at pre-compile, default-value=10.0  # This parameter describes the period for cyclic call to Can_MainFunction_Wakeup. Unit is seconds.
      boolean CanMultiplexedTransmission [0..0]: scope=ECU, set at pre-compile, default-value=false  # Specifies if multiplexed transmission shall be supported.ON or OFF
      boolean CanPublicIcomSupport [0..0]: scope=ECU, set at pre-compile, default-value=false  # Selects support of Pretended Network features in Can driver.
      boolean CanSetBaudrateApi: scope=ECU, set at pre-compile, default-value=true  # The support of the Can_SetBaudrate API is optional.If this parameter is set to true the Can_SetBaudrate API shall be supported. Otherwise the API is not supported.
      float CanTimeoutDuration: 0.001..65.535, set at pre-compile, default-value=10.0  # Specifies the maximum time for blocking function until a timeout is detected. Unit is in clock ticks. Configure the timeout according to r5f clock frequency(200MHz/400MHz)
      integer CanDefaultOSCounterId [0..1]: 0..16, multiplicity set at pre-compile, origin=Texas Instruments, set at pre-compile, default-value=0  # Default Os Counter Id if node reference to OsCounter ref CanOsCounterRef is not set
      boolean CanVersionInfoApi: set at pre-compile, default-value=true  # Switches the Can_GetVersionInfo() API ON or OFF.
      integer CanMaxNrOfTxObjects: 0..3, origin=Texas Instruments, set at post-build in variant post-build / pre-compile in variant pre-compile, default-value=3  # Number of Transmit Objects
      enumeration CanTypeofInterruptFunction: {CAN_ISR_VOID, CAN_ISR_CAT1, CAN_ISR_CAT2}, origin=Texas Instruments, set at pre-compile, default-value=CAN_ISR_CAT2  # Type of ISR function
      boolean CanRegisterReadbackAPI: origin=Texas Instruments, set at pre-compile, default-value=true  # Enable/Disable configuration readback safe TI API.If this parameter is set to true the readback API shall be supported. Otherwise the API is not supported.
      boolean CanLoopBackTest_Enable: origin=Texas Instruments, set at pre-compile, default-value=true  # Enable/Disable LoopBack test API.If this parameter is set to true the LoopBack mode shall be supported which is used for internal testing. Otherwise the API is not supported.
      reference CanOsCounterRef [0..1]: multiplicity set at pre-compile, set at pre-compile, destination=OsCounter  # This parameter contains a reference to the OsCounter, which is used by the CAN driver.
      reference CanSupportTTCANRef [0..0]: scope=ECU, set at pre-compile, destination=CanIfPrivateCfg  # The parameter refers to CanIfSupportTTCAN parameter in the CAN Interface Module configuration.
      container CanIcomGeneral [0..1]  # This container contains the general configuration parameters of the ICOM Configuration.
        enumeration CanIcomLevel [0..1]: {CAN_ICOM_LEVEL_ONE, CAN_ICOM_LEVEL_TWO}, scope=ECU, multiplicity set at pre-compile, set at pre-compile, default-value=CAN_ICOM_LEVEL_ONE  # Defines the level of Pretended Networking.
        enumeration CanIcomVariant: {CAN_ICOM_VARIANT_HW, CAN_ICOM_VARIANT_NONE, CAN_ICOM_VARIANT_SW}, scope=ECU, set at pre-compile, default-value=CAN_ICOM_VARIANT_NONE  # Defines the variant, which is supported by this CanController
      container CanMainFunctionRWPeriods [0..0]  # This container contains the parameter for configuring the period for cyclic call to Can_MainFunction_Read or Can_MainFunction_Write depending on the referring item.
        float CanMainFunctionPeriod: 0.001..65.535, set at pre-compile, default-value=0.001  # This parameter describes the period for cyclic call to Can_MainFunction_Read or Can_MainFunction_Write depending on the referring item. Unit is seconds
    container CanPublishedInformation  # Additional published parameters not covered by "Common" Published Information. Note that these parameters have "PUBLISHED-INFORMATION" configuration class setting, since they are published information.
      enumeration CanDeviceVariant [0..1]: {AM263x}, origin=Texas Instruments, set at published-information, default-value=AM263x  # Select SOC variant .This parameter shall be used by driver to impose device specific constraints. The user guide shall detail the device specific constraints
    container CanDemEventParameterRefs [0..1]  # Container for the references to DemEventParameter elements which shall be invoked using the API Dem_ReportErrorStatus in case the corresponding error occurs. The EventId is taken from the referenced DemEventParameter's DemEventId value.
      symbolic name reference CAN_E_HARDWARE_ERROR [0..1]: multiplicity set at pre-compile, origin=Texas Instruments, set at pre-compile, destination=DemEventParameter  # Reference to the DemEventParameter which shall be issued when the error "Timeout on blocking API call occurs " has occurred.
